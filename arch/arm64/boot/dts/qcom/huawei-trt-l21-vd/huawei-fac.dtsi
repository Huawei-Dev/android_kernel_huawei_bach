/{
		huawei_fac_info {
		compatible = "huawei,hw_fac_info";
		fac,product_name = "TRT-L21";
		fac,hardware_ver = "HL1TRTM-L21";
		fac,software_ver = "TRT_L21_VD";
		fac,simcard_adapt = "support";
		status = "ok";
	};
};
