/{
		huawei_fac_info {
		compatible = "huawei,hw_fac_info";
		fac,product_name = "BAH-L09";
		fac,hardware_ver = "SH1BAHL09M";
		fac,software_ver = "BAH_L09_VA";
		fac,simcard_adapt = "support";
		status = "ok";
	};
};
