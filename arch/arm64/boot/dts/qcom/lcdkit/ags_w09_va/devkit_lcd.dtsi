/*---------------------------------------------------------------------------
 * This file is autogenerated file using huawei LCD parser. Please do not edit it.
 * Update input XML file to add a new entry or update variable in this file
 * Parser location: vendor/huawei/chipset_common/devkit/lcdkit/tools 
 *---------------------------------------------------------------------------*/


#include "ags_w09_va_boe_nt51017_9p6_800p_video.dtsi"
#include "ags_w09_va_boe_nt51017te_9p6_800p_video.dtsi"