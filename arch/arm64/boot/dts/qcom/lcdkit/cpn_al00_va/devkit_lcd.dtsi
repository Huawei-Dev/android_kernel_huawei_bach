/*---------------------------------------------------------------------------
 * This file is autogenerated file using huawei LCD parser. Please do not edit it.
 * Update input XML file to add a new entry or update variable in this file
 * Parser location: vendor/huawei/chipset_common/devkit/lcdkit/tools 
 *---------------------------------------------------------------------------*/


#include "cpn_al00_va_inx_nt51021_8p0_1200p_video.dtsi"
#include "cpn_al00_va_auo_nt51021_8p0_1200p_video.dtsi"