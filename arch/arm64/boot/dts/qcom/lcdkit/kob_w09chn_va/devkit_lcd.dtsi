/*---------------------------------------------------------------------------
 * This file is autogenerated file using huawei LCD parser. Please do not edit it.
 * Update input XML file to add a new entry or update variable in this file
 * Parser location: vendor/huawei/chipset_common/devkit/lcdkit/tools 
 *---------------------------------------------------------------------------*/


#include "kob_w09chn_va_boe_jd9366_8p0_800p_video.dtsi"
#include "kob_w09chn_va_inx_jd9367_8p0_800p_video.dtsi"