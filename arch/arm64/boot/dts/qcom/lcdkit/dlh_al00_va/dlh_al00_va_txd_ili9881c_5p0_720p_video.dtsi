/* Copyright (c) 2013, The Linux Foundation. All rights reserved.
 *
 * This program is free software; you can redistribute it and/or modify
 * it under the terms of the GNU General Public License version 2 and
 * only version 2 as published by the Free Software Foundation.
 *
 * This program is distributed in the hope that it will be useful,
 * but WITHOUT ANY WARRANTY; without even the implied warranty of
 * MERCHANTABILITY or FITNESS FOR A PARTICULAR PURPOSE.  See the
 * GNU General Public License for more details.
 */

/*-------------------------------------------------------------------------
 * This file is autogenerated file using gcdb parser. Please do not edit it.
 * Update input XML file to add a new entry or update variable in this file
 * VERSION = 1.1
 *-----------------------------------------------------------------------*/
/ {
	dsi_dlh_al00_va_txd_ili9881c_5p0_720p_video: lcdkit_dlh_al00_va_txd_ili9881c_5p0_720p_video {
		compatible = "dlh_al00_va_txd_ili9881c_5p0_720p_video";
		hw,lcdkit-panel-name = "TXS_ILI9881C 5.0' VIDEO IPS 720 x 1280";
		hw,lcdkit-panel-type = <0x01>;
		hw,lcdkit-panel-xres = <720>;
		hw,lcdkit-panel-yres = <1280>;
		hw,lcdkit-panel-width = <68>;
		hw,lcdkit-panel-height = <121>;
		hw,lcdkit-panel-on-command = [39 01 00 00 00 00 04 FF 98 81 03
			39 01 00 00 00 00 02 01 00
			39 01 00 00 00 00 02 02 00
			39 01 00 00 00 00 02 03 53
			39 01 00 00 00 00 02 04 13
			39 01 00 00 00 00 02 05 13
			39 01 00 00 00 00 02 06 06
			39 01 00 00 00 00 02 07 00
			39 01 00 00 00 00 02 08 04
			39 01 00 00 00 00 02 09 00
			39 01 00 00 00 00 02 0a 00
			39 01 00 00 00 00 02 0b 00
			39 01 00 00 00 00 02 0c 00
			39 01 00 00 00 00 02 0d 00
			39 01 00 00 00 00 02 0e 00
			39 01 00 00 00 00 02 0f 00
			39 01 00 00 00 00 02 10 00
			39 01 00 00 00 00 02 11 00
			39 01 00 00 00 00 02 12 00
			39 01 00 00 00 00 02 13 00
			39 01 00 00 00 00 02 14 00
			39 01 00 00 00 00 02 15 00
			39 01 00 00 00 00 02 16 00
			39 01 00 00 00 00 02 17 00
			39 01 00 00 00 00 02 18 00
			39 01 00 00 00 00 02 19 00
			39 01 00 00 00 00 02 1a 00
			39 01 00 00 00 00 02 1b 00
			39 01 00 00 00 00 02 1c 00
			39 01 00 00 00 00 02 1d 00
			39 01 00 00 00 00 02 1e C0
			39 01 00 00 00 00 02 1f 80
			39 01 00 00 00 00 02 20 04
			39 01 00 00 00 00 02 21 0B
			39 01 00 00 00 00 02 22 00
			39 01 00 00 00 00 02 23 00
			39 01 00 00 00 00 02 24 00
			39 01 00 00 00 00 02 25 00
			39 01 00 00 00 00 02 26 00
			39 01 00 00 00 00 02 27 00
			39 01 00 00 00 00 02 28 55
			39 01 00 00 00 00 02 29 03
			39 01 00 00 00 00 02 2a 00
			39 01 00 00 00 00 02 2b 00
			39 01 00 00 00 00 02 2c 00
			39 01 00 00 00 00 02 2d 00
			39 01 00 00 00 00 02 2e 00
			39 01 00 00 00 00 02 2f 00
			39 01 00 00 00 00 02 30 00
			39 01 00 00 00 00 02 31 00
			39 01 00 00 00 00 02 32 00
			39 01 00 00 00 00 02 33 30
			39 01 00 00 00 00 02 34 04
			39 01 00 00 00 00 02 35 05
			39 01 00 00 00 00 02 36 05
			39 01 00 00 00 00 02 37 00
			39 01 00 00 00 00 02 38 3c
			39 01 00 00 00 00 02 39 00
			39 01 00 00 00 00 02 3a 40
			39 01 00 00 00 00 02 3b 40
			39 01 00 00 00 00 02 3c 00
			39 01 00 00 00 00 02 3d 00
			39 01 00 00 00 00 02 3e 00
			39 01 00 00 00 00 02 3f 00
			39 01 00 00 00 00 02 40 00
			39 01 00 00 00 00 02 41 00
			39 01 00 00 00 00 02 42 00
			39 01 00 00 00 00 02 43 00
			39 01 00 00 00 00 02 44 00
			39 01 00 00 00 00 02 50 01
			39 01 00 00 00 00 02 51 23
			39 01 00 00 00 00 02 52 45
			39 01 00 00 00 00 02 53 67
			39 01 00 00 00 00 02 54 89
			39 01 00 00 00 00 02 55 ab
			39 01 00 00 00 00 02 56 01
			39 01 00 00 00 00 02 57 23
			39 01 00 00 00 00 02 58 45
			39 01 00 00 00 00 02 59 67
			39 01 00 00 00 00 02 5a 89
			39 01 00 00 00 00 02 5b ab
			39 01 00 00 00 00 02 5c cd
			39 01 00 00 00 00 02 5d ef
			39 01 00 00 00 00 02 5e 01
			39 01 00 00 00 00 02 5f 14
			39 01 00 00 00 00 02 60 15
			39 01 00 00 00 00 02 61 0C
			39 01 00 00 00 00 02 62 0D
			39 01 00 00 00 00 02 63 0E
			39 01 00 00 00 00 02 64 0F
			39 01 00 00 00 00 02 65 10
			39 01 00 00 00 00 02 66 11
			39 01 00 00 00 00 02 67 08
			39 01 00 00 00 00 02 68 02
			39 01 00 00 00 00 02 69 0A
			39 01 00 00 00 00 02 6a 02
			39 01 00 00 00 00 02 6b 02
			39 01 00 00 00 00 02 6c 02
			39 01 00 00 00 00 02 6d 02
			39 01 00 00 00 00 02 6e 02
			39 01 00 00 00 00 02 6f 02
			39 01 00 00 00 00 02 70 02
			39 01 00 00 00 00 02 71 02
			39 01 00 00 00 00 02 72 06
			39 01 00 00 00 00 02 73 02
			39 01 00 00 00 00 02 74 02
			39 01 00 00 00 00 02 75 14
			39 01 00 00 00 00 02 76 15
			39 01 00 00 00 00 02 77 11
			39 01 00 00 00 00 02 78 10
			39 01 00 00 00 00 02 79 0F
			39 01 00 00 00 00 02 7a 0E
			39 01 00 00 00 00 02 7b 0D
			39 01 00 00 00 00 02 7c 0C
			39 01 00 00 00 00 02 7d 06
			39 01 00 00 00 00 02 7e 02
			39 01 00 00 00 00 02 7f 0A
			39 01 00 00 00 00 02 80 02
			39 01 00 00 00 00 02 81 02
			39 01 00 00 00 00 02 82 02
			39 01 00 00 00 00 02 83 02
			39 01 00 00 00 00 02 84 02
			39 01 00 00 00 00 02 85 02
			39 01 00 00 00 00 02 86 02
			39 01 00 00 00 00 02 87 02
			39 01 00 00 00 00 02 88 08
			39 01 00 00 00 00 02 89 02
			39 01 00 00 00 00 02 8A 02
			39 01 00 00 00 00 04 FF 98 81 04
			39 01 00 00 00 00 02 6C 15
			39 01 00 00 00 00 02 6E 3B
			39 01 00 00 00 00 02 6F 53
			39 01 00 00 00 00 02 3A A4
			39 01 00 00 00 00 02 8D 15
			39 01 00 00 00 00 02 87 BA
			39 01 00 00 00 00 02 26 76
			39 01 00 00 00 00 02 B2 D1
			39 01 00 00 00 00 02 8B F3
			39 01 00 00 00 00 02 7A 10
			39 01 00 00 00 00 02 21 30
			39 01 00 00 00 00 04 FF 98 81 01
			39 01 00 00 00 00 02 22 0A
			39 01 00 00 00 00 02 31 00
			39 01 00 00 00 00 02 53 61
			39 01 00 00 00 00 02 55 99
			39 01 00 00 00 00 02 50 a6
			39 01 00 00 00 00 02 51 a6
			39 01 00 00 00 00 02 60 14
			39 01 00 00 00 00 02 A0 08
			39 01 00 00 00 00 02 A1 33
			39 01 00 00 00 00 02 A2 43
			39 01 00 00 00 00 02 A3 19
			39 01 00 00 00 00 02 A4 1C
			39 01 00 00 00 00 02 A5 2F
			39 01 00 00 00 00 02 A6 22
			39 01 00 00 00 00 02 A7 20
			39 01 00 00 00 00 02 A8 B6
			39 01 00 00 00 00 02 A9 1D
			39 01 00 00 00 00 02 AA 28
			39 01 00 00 00 00 02 AB 97
			39 01 00 00 00 00 02 AC 1C
			39 01 00 00 00 00 02 AD 20
			39 01 00 00 00 00 02 AE 51
			39 01 00 00 00 00 02 AF 25
			39 01 00 00 00 00 02 B0 2B
			39 01 00 00 00 00 02 B1 4D
			39 01 00 00 00 00 02 B2 58
			39 01 00 00 00 00 02 B3 2C
			39 01 00 00 00 00 02 C0 08
			39 01 00 00 00 00 02 C1 33
			39 01 00 00 00 00 02 C2 43
			39 01 00 00 00 00 02 C3 19
			39 01 00 00 00 00 02 C4 1C
			39 01 00 00 00 00 02 C5 2F
			39 01 00 00 00 00 02 C6 22
			39 01 00 00 00 00 02 C7 20
			39 01 00 00 00 00 02 C8 B6
			39 01 00 00 00 00 02 C9 1D
			39 01 00 00 00 00 02 CA 29
			39 01 00 00 00 00 02 CB 97
			39 01 00 00 00 00 02 CC 1C
			39 01 00 00 00 00 02 CD 20
			39 01 00 00 00 00 02 CE 51
			39 01 00 00 00 00 02 CF 26
			39 01 00 00 00 00 02 D0 2B
			39 01 00 00 00 00 02 D1 4D
			39 01 00 00 00 00 02 D2 58
			39 01 00 00 00 00 02 D3 2C
			39 01 00 00 00 00 04 FF 98 81 00
			39 01 00 00 00 00 02 35 00
			39 01 00 00 78 00 02 11 00
			39 01 00 00 0A 00 02 29 00];
		hw,lcdkit-panel-on-command-state = "dsi_lp_mode";
		hw,lcdkit-panel-display-on-command = [05 01 00 00 64 00 02 29 00];
		hw,lcdkit-panel-off-command = [05 01 00 00 14 00 02 28 00
					05 01 00 00 78 00 02 10 00];
		hw,lcdkit-panel-off-command-state = "dsi_hs_mode";
		hw,lcdkit-panel-backlight-command = [39 01 00 00 00 00 02 51 00];
		hw,lcdkit-panel-backlight-command-state = "dsi_lp_mode";
		hw,lcdkit-panel-cabc-off-command = [15 01 00 00 0a 00 02 55 00];
		hw,lcdkit-panel-cabc-off-command-state = "dsi_lp_mode";
		hw,lcdkit-panel-cabc-ui-command = [15 01 00 00 0a 00 02 55 01
					15 01 00 00 0a 00 02 53 24];
		hw,lcdkit-panel-cabc-ui-command-state = "dsi_lp_mode";
		hw,lcdkit-panel-cabc-still-command = [15 01 00 00 0a 00 02 55 02
					15 01 00 00 0a 00 02 53 2C];
		hw,lcdkit-panel-cabc-still-command-state = "dsi_lp_mode";
		hw,lcdkit-panel-cabc-moving-command = [15 01 00 00 0a 00 02 55 03
					15 01 00 00 0a 00 02 53 2C];
		hw,lcdkit-panel-cabc-moving-command-state = "dsi_lp_mode";
		hw,lcdkit-panel-cabc-support = <0>;
		hw,lcdkit-panel-dot-inversion-command = [29 01 00 00 00 00 03 c2 00 00];
		hw,lcdkit-panel-dot-inversion-command-state = "dsi_lp_mode";
		hw,lcdkit-panel-column-inversion-command = [29 01 00 00 00 00 03 c2 00 f0];
		hw,lcdkit-panel-column-inversion-command-state = "dsi_lp_mode";
		hw,lcdkit-panel-inversion-support = <0>;
		hw,lcdkit-panel-forword-scan-command = [15 01 00 00 00 00 02 36 00];
		hw,lcdkit-panel-forword-scan-command-state = "dsi_lp_mode";
		hw,lcdkit-panel-revert-scan-command = [15 01 00 00 00 00 02 36 c0];
		hw,lcdkit-panel-revert-scan-command-state = "dsi_lp_mode";
		hw,lcdkit-panel-scan-support = <0>;
		hw,lcdkit-panel-display-region-command = [];
		hw,lcdkit-panel-display-region-command-state = "dsi_lp_mode";
		hw,lcdkit-panel-display-region-support = <0>;
		hw,lcdkit-panel-checksum-enter-command = [];
		hw,lcdkit-panel-checksum-enter-command-state = "dsi_lp_mode";
		hw,lcdkit-panel-checksum-command = [];
		hw,lcdkit-panel-checksum-command-state = "dsi_lp_mode";
		hw,lcdkit-panel-checksum-exit-command = [];
		hw,lcdkit-panel-checksum-exit-command-state = "dsi_lp_mode";
		hw,lcdkit-panel-checksum-value = [];
		hw,lcdkit-panel-checksum-support = <0>;
		hw,lcdkit-panel-esd-reg-command = [06 01 00 00 0a 00 01 0a];
		hw,lcdkit-panel-esd-reg-command-state = "dsi_lp_mode";
		hw,lcdkit-panel-esd-value = [1c];
		hw,lcdkit-panel-esd-support = <0>;
		hw,lcdkit-panel-check-reg-command = [06 01 00 00 0a 00 01 0a];
		hw,lcdkit-panel-check-reg-value = [1c];
		hw,lcdkit-panel-check-reg-command-state = "dsi_lp_mode";
		hw,lcdkit-panel-check-reg-support = <0>;
		hw,lcdkit-panel-mipi-detect-command = [];
		hw,lcdkit-panel-mipi-detect-value = [];
		hw,lcdkit-panel-mipi-detect-mask = [];
		hw,lcdkit-panel-mipi-detect-command-state = "dsi_lp_mode";
		hw,lcdkit-panel-mipi-detect-support = <0>;
		hw,lcdkit-panel-shutdown-sleep-support = <0>;
		hw,lcdkit-dsi-bpp = <24>;
		hw,lcdkit-panel-cmd-type = <0>;
		hw,lcdkit-pixel-packing = <0>;
		hw,lcdkit-underflow-color = <0xff>;
		hw,lcdkit-border-color = <0>;
		hw,lcdkit-panel-orientation = <0>;
		hw,lcdkit-brightness-max-level = <4095>;
		hw,lcdkit-bl-min-level = <41>;
		hw,lcdkit-bl-max-level = <4095>;
		hw,lcdkit-interleave-mode = <0>;
		hw,lcdkit-h-sync-pulse = <1>;
		hw,lcdkit-bllp-power-mode;
		hw,lcdkit-bllp-eof-power-mode;
		hw,lcdkit-traffic-mode = "burst_mode";
		hw,lcdkit-te-dcs-command = <0>;
		hw,lcdkit-te-pin-select = <0>;
		hw,lcdkit-virtual-channel-id = <0>;
		hw,lcdkit-color-order = "rgb_swap_rgb";
		hw,lcdkit-lane-0-state;
		hw,lcdkit-lane-1-state;
		hw,lcdkit-lane-2-state;
		hw,lcdkit-lane-3-state;
		hw,lcdkit-h-left-border = <0>;
		hw,lcdkit-h-right-border = <0>;
		hw,lcdkit-v-top-border = <0>;
		hw,lcdkit-v-bottom-border = <0>;
		hw,lcdkit-panel-framerate = <60>;
		hw,lcdkit-panel-clockrate = <490020000>;
		hw,lcdkit-panel-timings = [9B 22 18 00 4A 4E 1C 26 1D 03 04 00];
		hw,lcdkit-t-clk-pre = <0x1C>;
		hw,lcdkit-t-clk-post = <0x04>;
		hw,lcdkit-tx-eot-append;
		hw,lcdkit-stream = <0>;
		hw,lcdkit-lp11-init;
		hw,lcdkit-mdp-trigger = "none";
		hw,lcdkit-dma-trigger = "trigger_sw";
		hw,lcdkit-bl-pmic-control-type = "bl_ctrl_wled";
		qcom,panel-supply-entries = <&dsi_panel_pwr_supply>;
		hw,lcdkit-lane-map = "lane_map_0123";
		hw,lcdkit-delay-before-bl = <0>;
		hw,lcdkit-mipi-regulator-mode = <1>;
		hw,lcdkit-delay-af-rst-off = <20>;
		hw,lcdkit-delay-af-blic-init = <0>;
		hw,lcdkit-bl-level-limit-percent = <100>;
		hw,lcdkit-use-second-ic-for-esd = <0>;
		hw,lcdkit-esd-check-num = <3>;
		hw,lcdkit-h-back-porch = <252>;
		hw,lcdkit-h-front-porch = <176>;
		hw,lcdkit-h-pulse-width = <28>;
		hw,lcdkit-v-back-porch = <20>;
		hw,lcdkit-v-pulse-width = <4>;
		hw,lcdkit-v-front-porch = <28>;
		hw,lcdkit-h-sync-skew = <0>;
		hw,lcdkit-lcd-type = <0>;
		hw,lcdkit-panel-pt-test-support = <0>;
		hw,lcdkit-bias-power-ctrl-mode = <0x02>;
		hw,lcdkit-iovcc-power-ctrl-mode = <0x01>;
		hw,lcdkit-vci-power-ctrl-mode = <0x01>;
		hw,lcdkit-id0-gpio = <36>;
		hw,lcdkit-id1-gpio = <61>;
		hw,lcdkit-reset-gpio = <60>;
		hw,lcdkit-te-gpio = <0>;
		hw,lcdkit-vsp-gpio = <93>;
		hw,lcdkit-vsn-gpio = <94>;
		hw,lcdkit-iovcc-gpio = <0>;
		hw,lcdkit-vci-gpio = <0>;
		hw,lcdkit-bl-gpio = <98>;
		hw,lcdkit-iovcc-on-is-need-reset = <1>;
		hw,lcdkit-vsn-on-is-need-reset = <1>;
		hw,lcdkit-lcd-vsp = <5500000>;
		hw,lcdkit-lcd-vsn = <5500000>;
		hw,lcdkit-lcd-rst-first-high = <50>;
		hw,lcdkit-lcd-rst-low = <20>;
		hw,lcdkit-lcd-rst-second-high = <70>;
		hw,lcdkit-delay-af-vci-on = <0>;
		hw,lcdkit-delay-af-iovcc-on = <0>;
		hw,lcdkit-delay-af-bias-on = <0>;
		hw,lcdkit-delay-af-vsp-on = <0>;
		hw,lcdkit-delay-af-vsn-on = <3>;
		hw,lcdkit-delay-af-lp11 = <0>;
		hw,lcdkit-delay-af-tp-reset = <25>;
		hw,lcdkit-delay-af-vsn-off = <3>;
		hw,lcdkit-delay-af-vsp-off = <0>;
		hw,lcdkit-delay-af-bias-off = <0>;
		hw,lcdkit-delay-af-iovcc-off = <0>;
		hw,lcdkit-delay-af-vci-off = <0>;
		hw,lcdkit-panel-off-reset-high = <0>;
    };
};