/*---------------------------------------------------------------------------
 * This file is autogenerated file using huawei LCD parser. Please do not edit it.
 * Update input XML file to add a new entry or update variable in this file
 * Parser location: vendor/huawei/chipset_common/devkit/lcdkit/tools 
 *---------------------------------------------------------------------------*/


#include "dlh_al00_va_txd_ili9881c_5p0_720p_video.dtsi"
#include "dlh_al00_va_tcl_hx8394f_5p0_720p_video.dtsi"