qcom,mtp-4v35-4650mAh-gy-data {
	/* #24021525_Huawei_Milan_4650mAh_averaged_MasterSlave_Apr15th2016*/
	qcom,max-voltage-uv = <4350000>;
	qcom,nom-batt-capacity-mah = <4650>;
	qcom,batt-id-kohm = <22>;
	qcom,battery-beta = <3380>;
	qcom,battery-type = "HB3080G1EBC_GY_SWD";
	qcom,chg-rslow-comp-c1 = <3255025>;
	qcom,chg-rslow-comp-c2 = <4543096>;
	qcom,chg-rs-to-rslow = <717660>;
	qcom,chg-rslow-comp-thr = <0xA3>;
	qcom,checksum = <0x3C10>;
	qcom,gui-version = "PMI8950GUI - 2.0.0.16";
	qcom,fg-profile-data = [
		 9B 82 0D 7A
		 1F 7D 56 72
		 30 83 5E 73
		 36 7E 9F 79
		 F0 81 97 9A
		 8B BD A0 CA
		 83 0E C8 83
		 4A 76 E7 7A
		 F3 6F 4F 83
		 46 58 F6 83
		 64 94 22 82
		 DD 99 12 BD
		 5D CA 50 0E
		 8E 12 16 59
		 CE 6E 71 FC
		 78 3C B0 3C
		 CF 38 00 00
		 46 3E C5 38
		 22 45 00 00
		 00 00 00 00
		 00 00 00 00
		 E7 69 BC 68
		 E1 76 75 7A
		 A1 77 26 6A
		 92 75 AC 79
		 75 77 F2 69
		 A8 88 CA C7
		 08 17 5B 7B
		 4C A0 71 0C
		 28 00 FF 36
		 F0 11 30 03
		 00 00 00 0C
	];
};
