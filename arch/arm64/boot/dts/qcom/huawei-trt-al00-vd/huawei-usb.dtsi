&usb_otg {
	qcom,hsusb-otg-mode = <3>;
	qcom,hsusb-otg-phy-init-seq =
	<0x44 0x80 0x6f 0x81 0x3c 0x82 0x13 0x83 0xffffffff>;
	qcom,hsusb-otg-phy-init-seq-host =
	<0x74 0x80 0x2b 0x81 0x3f 0x82 0x13 0x83 0xffffffff>;
};
