/* Copyright (c) 2013, The Linux Foundation. All rights reserved.
 *
 * This program is free software; you can redistribute it and/or modify
 * it under the terms of the GNU General Public License version 2 and
 * only version 2 as published by the Free Software Foundation.
 *
 * This program is distributed in the hope that it will be useful,
 * but WITHOUT ANY WARRANTY; without even the implied warranty of
 * MERCHANTABILITY or FITNESS FOR A PARTICULAR PURPOSE.  See the
 * GNU General Public License for more details.
 */

/*---------------------------------------------------------------------------
 * This file is autogenerated file using gcdb parser. Please do not edit it.
 * Update input XML file to add a new entry or update variable in this file
 * VERSION = "1.0"
 *---------------------------------------------------------------------------*/
&mdss_mdp {
	dsi_boe_nt35596s_5p0_1080p_video: qcom,mdss_dsi_boe_nt35596s_5p0_1080p_video {
		qcom,mdss-dsi-panel-name = "BOE_NT35596S_5P0_1080P_VIDEO";
		qcom,cont-splash-enabled;
		qcom,mdss-dsi-panel-controller = <&mdss_dsi0>;
		qcom,panel-supply-entries = <&dsi_panel_pwr_supply>;
		qcom,mdss-dsi-panel-type = "dsi_video_mode";
		qcom,mdss-dsi-panel-destination = "display_1";
		qcom,mdss-dsi-panel-clockrate = <906000000>;
		qcom,mdss-dsi-panel-framerate = <60>;
		qcom,mdss-dsi-virtual-channel-id = <0>;
		qcom,mdss-dsi-stream = <0>;
		qcom,mdss-dsi-panel-width = <1080>;
		qcom,mdss-dsi-panel-height = <1920>;
		qcom,mdss-dsi-h-front-porch = <114>;
		qcom,mdss-dsi-h-back-porch = <50>;
		qcom,mdss-dsi-h-pulse-width = <8>;
		qcom,mdss-dsi-h-sync-skew = <0>;
		qcom,mdss-dsi-v-back-porch = <6>;
		qcom,mdss-dsi-v-front-porch = <10>;
		qcom,mdss-dsi-v-pulse-width = <4>;
		qcom,mdss-dsi-h-left-border = <0>;
		qcom,mdss-dsi-h-right-border = <0>;
		qcom,mdss-dsi-v-top-border = <0>;
		qcom,mdss-dsi-v-bottom-border = <0>;
		qcom,mdss-dsi-bpp = <24>;
		qcom,mdss-dsi-underflow-color = <0x00>;
		qcom,mdss-dsi-border-color = <0>;
		qcom,mdss-dsi-color-order = "rgb_swap_rgb";
		qcom,mdss-dsi-on-command = [39 01 00 00 00 00 02 FF E0
                                        39 01 00 00 01 00 02 4F 01
                                        39 01 00 00 01 00 02 4F 00
                                        29 01 00 00 00 00 02 FF 10
                                        29 01 00 00 00 00 02 FB 01
                                        29 01 00 00 00 00 02 55 80
                                        29 01 00 00 00 00 02 FF 22
                                        29 01 00 00 00 00 02 FB 01
                                        29 01 00 00 00 00 02 00 00
                                        29 01 00 00 00 00 02 01 00
                                        29 01 00 00 00 00 02 02 00
                                        29 01 00 00 00 00 02 03 00
                                        29 01 00 00 00 00 02 04 00
                                        29 01 00 00 00 00 02 05 04
                                        29 01 00 00 00 00 02 06 08
                                        29 01 00 00 00 00 02 07 0C
                                        29 01 00 00 00 00 02 08 14
                                        29 01 00 00 00 00 02 09 24
                                        29 01 00 00 00 00 02 0A 32
                                        29 01 00 00 00 00 02 0B 41
                                        29 01 00 00 00 00 02 0C 44
                                        29 01 00 00 00 00 02 0D 46
                                        29 01 00 00 00 00 02 0E 34
                                        29 01 00 00 00 00 02 0F 23
                                        29 01 00 00 00 00 02 10 0C
                                        29 01 00 00 00 00 02 11 00
                                        29 01 00 00 00 00 02 12 00
                                        29 01 00 00 00 00 02 13 00
                                        29 01 00 00 00 00 02 1A 00
                                        29 01 00 00 00 00 02 1B 00
                                        29 01 00 00 00 00 02 1C 08
                                        29 01 00 00 00 00 02 1D 14
                                        29 01 00 00 00 00 02 1E 1E
                                        29 01 00 00 00 00 02 1F 2A
                                        29 01 00 00 00 00 02 20 34
                                        29 01 00 00 00 00 02 21 1A
                                        29 01 00 00 00 00 02 22 08
                                        29 01 00 00 00 00 02 23 00
                                        29 01 00 00 00 00 02 24 00
                                        29 01 00 00 00 00 02 25 00
                                        29 01 00 00 00 00 02 26 1A
                                        29 01 00 00 00 00 02 27 28
                                        29 01 00 00 00 00 02 28 2A
                                        29 01 00 00 00 00 02 29 1A
                                        29 01 00 00 00 00 02 2A 00
                                        29 01 00 00 00 00 02 2B 00
                                        29 01 00 00 00 00 02 2F 00
                                        29 01 00 00 00 00 02 30 00
                                        29 01 00 00 00 00 02 31 00
                                        29 01 00 00 00 00 02 32 82
                                        29 01 00 00 00 00 02 33 84
                                        29 01 00 00 00 00 02 34 06
                                        29 01 00 00 00 00 02 35 09
                                        29 01 00 00 00 00 02 36 0C
                                        29 01 00 00 00 00 02 37 0E
                                        29 01 00 00 00 00 02 38 0E
                                        29 01 00 00 00 00 02 39 0C
                                        29 01 00 00 00 00 02 3A 08
                                        29 01 00 00 00 00 02 3B 04
                                        29 01 00 00 00 00 02 3F 00
                                        29 01 00 00 00 00 02 40 00
                                        29 01 00 00 00 00 02 41 00
                                        29 01 00 00 00 00 02 42 00
                                        29 01 00 00 00 00 02 43 00
                                        29 01 00 00 00 00 02 44 00
                                        29 01 00 00 00 00 02 45 00
                                        29 01 00 00 00 00 02 46 00
                                        29 01 00 00 00 00 02 47 00
                                        29 01 00 00 00 00 02 48 00
                                        29 01 00 00 00 00 02 49 00
                                        29 01 00 00 00 00 02 4A 00
                                        29 01 00 00 00 00 02 4B 00
                                        29 01 00 00 00 00 02 4C 84
                                        29 01 00 00 00 00 02 4D 00
                                        29 01 00 00 00 00 02 4E 00
                                        29 01 00 00 00 00 02 4F 00
                                        29 01 00 00 00 00 02 50 00
                                        29 01 00 00 00 00 02 51 00
                                        29 01 00 00 00 00 02 52 00
                                        29 01 00 00 00 00 02 53 01
                                        29 01 00 00 00 00 02 54 01
                                        29 01 00 00 00 00 02 55 99
                                        29 01 00 00 00 00 02 56 04
                                        29 01 00 00 00 00 02 58 00
                                        29 01 00 00 00 00 02 68 00
                                        29 01 00 00 00 00 02 84 00
                                        29 01 00 00 00 00 02 85 00
                                        29 01 00 00 00 00 02 86 00
                                        29 01 00 00 00 00 02 87 80
                                        29 01 00 00 00 00 02 88 07
                                        29 01 00 00 00 00 02 A2 20
                                        29 01 00 00 00 00 02 A9 01
                                        29 01 00 00 00 00 02 AA 00
                                        29 01 00 00 00 00 02 AB 0D
                                        29 01 00 00 00 00 02 AC 07
                                        29 01 00 00 00 00 02 AD 64
                                        29 01 00 00 00 00 02 AF 22
                                        29 01 00 00 00 00 02 B0 02
                                        29 01 00 00 00 00 02 B1 12
                                        29 01 00 00 00 00 02 B2 2F
                                        29 01 00 00 00 00 02 B3 29
                                        29 01 00 00 00 00 02 B4 F0
                                        29 01 00 00 00 00 02 B6 33
                                        29 01 00 00 00 00 02 B7 03
                                        29 01 00 00 00 00 02 B8 00
                                        29 01 00 00 00 00 02 B9 55
                                        29 01 00 00 00 00 02 BA 4A
                                        29 01 00 00 00 00 02 BB A5
                                        29 01 00 00 00 00 02 BD 22
                                        29 01 00 00 00 00 02 BE 02
                                        29 01 00 00 00 00 02 BF 00
                                        29 01 00 00 00 00 02 C0 75
                                        29 01 00 00 00 00 02 C1 6A
                                        29 01 00 00 00 00 02 C2 A5
                                        29 01 00 00 00 00 02 C4 22
                                        29 01 00 00 00 00 02 C5 02
                                        29 01 00 00 00 00 02 C6 00
                                        29 01 00 00 00 00 02 C7 95
                                        29 01 00 00 00 00 02 C8 8A
                                        29 01 00 00 00 00 02 C9 A5
                                        29 01 00 00 00 00 02 CB 22
                                        29 01 00 00 00 00 02 CC 02
                                        29 01 00 00 00 00 02 CD 00
                                        29 01 00 00 00 00 02 CE B5
                                        29 01 00 00 00 00 02 CF AA
                                        29 01 00 00 00 00 02 D0 A5
                                        29 01 00 00 00 00 02 D2 22
                                        29 01 00 00 00 00 02 D3 02
                                        29 01 00 00 00 00 02 FB 01
                                        29 01 00 00 00 00 02 FF 10
                                        29 01 00 00 00 00 02 FB 01
                                        29 01 00 00 00 00 02 9F F7
                                        29 01 00 00 00 00 02 A0 33
                                        29 01 00 00 00 00 02 89 00
                                        29 01 00 00 00 00 02 9D FC
                                        29 01 00 00 00 00 02 A0 32
                                        29 01 00 00 00 00 02 89 00
                                        39 01 00 00 00 00 02 FF 10
                                        39 01 00 00 00 00 02 FB 01
                                        39 01 00 00 00 00 02 B0 01
                                        39 01 00 00 78 00 02 11 00
                                        39 01 00 00 00 00 02 FF 20
                                        39 01 00 00 00 00 02 FB 01
                                        39 01 00 00 00 00 02 06 14
                                        39 01 00 00 00 00 02 07 9E
                                        39 01 00 00 00 00 02 0E AB
                                        39 01 00 00 00 00 02 0F AE
                                        39 01 00 00 00 00 02 FF 10
                                        39 01 00 00 00 00 02 FB 01
                                        39 01 00 00 14 00 02 29 00];
		qcom,mdss-dsi-off-command = [39 01 00 00 78 00 02 10 00
					39 01 00 00 20 00 02 28 00];
		qcom,mdss-dsi-on-command-state = "dsi_lp_mode";
		qcom,mdss-dsi-off-command-state = "dsi_hs_mode";
		qcom,mdss-dsi-h-sync-pulse = <1>;
		qcom,mdss-dsi-traffic-mode = "burst_mode";
		qcom,mdss-dsi-lane-map = "lane_map_0123";
		qcom,mdss-dsi-bllp-eof-power-mode;
		qcom,mdss-dsi-bllp-power-mode;
		qcom,mdss-dsi-lane-0-state;
		qcom,mdss-dsi-lane-1-state;
		qcom,mdss-dsi-lane-2-state;
		qcom,mdss-dsi-lane-3-state;
		qcom,mdss-dsi-te-pin-select = <1>;
		qcom,mdss-dsi-te-v-sync-rd-ptr-irq-line = <0x2c>;
		qcom,mdss-dsi-te-dcs-command = <1>;
		qcom,mdss-dsi-te-check-enable;
		qcom,mdss-dsi-te-using-te-pin;
		qcom,mdss-dsi-panel-timings = [24 1f 08 09 05 03 04 a0
		24 1f 08 09 05 03 04 a0
		24 1f 08 09 05 03 04 a0
		24 1f 08 09 05 03 04 a0
		24 1b 08 09 05 03 04 a0];
		qcom,mdss-dsi-t-clk-post = <0xF0>;
		qcom,mdss-dsi-t-clk-pre = <0xF6>;
		qcom,mdss-dsi-bl-min-level = <46>;
		qcom,mdss-dsi-bl-max-level = <3640>;
		qcom,mdss-brightness-max-level = <3640>;
		qcom,mdss-dsi-dma-trigger = "trigger_sw";
		qcom,mdss-dsi-mdp-trigger = "none";
		qcom,mdss-dsi-bl-pmic-control-type = "bl_ctrl_wled";
		qcom,panel-dot-inversion-mode-cmds = [29 01 00 00 00 00 02 FF 24
					29 01 00 00 00 00 02 FB 01
					29 01 00 00 00 00 02 9B 00
					29 01 00 00 00 00 02 FF 10
					29 01 00 00 00 00 02 FB 01];
		qcom,panel-column-inversion-mode-cmds = [29 01 00 00 00 00 02 FF 24
					29 01 00 00 00 00 02 FB 01
					29 01 00 00 00 00 02 9B 0F
					29 01 00 00 00 00 02 FF 10
					29 01 00 00 00 00 02 FB 01];
		qcom,dot-inversion-cmds-dsi-state = "dsi_lp_mode";
		qcom,column-inversion-cmds-dsi-state = "dsi_lp_mode";
		qcom,panel-esd-check-enabled;
		qcom,panel-esd-read-commands = [06 01 00 01 05 00 02 0A 9C];
		qcom,panel-dsm-check-enabled;
		qcom,panel-dsm-read-commands = [06 01 00 01 05 00 02 05 00
                               06 01 00 01 05 00 02 0A 9C
                               06 01 00 01 05 00 02 0B 00
                               06 01 00 01 05 00 02 0C 07
                               06 01 00 01 05 00 02 0D 00
                               06 01 00 01 05 00 02 0E 00
                               06 01 00 01 05 00 02 0F C0];
		qcom,esd-read-cmds-state = "dsi_hs_mode";
		qcom,dsm-read-cmds-state = "dsi_hs_mode";
		qcom,mdss-dsi-lp11-init;
		qcom,mdss-pan-physical-width-dimension = <62>;
		qcom,mdss-pan-physical-height-dimension = <110>;
		huawei,delaytime-before-bl = <80>;
		huawei,long-read-flag = <1>;
		huawei,reg-read-expect-value = <0x9C>;
		huawei,reg-long-read-count = <3>;
		qcom,mdss-dsi-reset-sequence = <1 10>, <0 5>, <1 10>;

	};
};
