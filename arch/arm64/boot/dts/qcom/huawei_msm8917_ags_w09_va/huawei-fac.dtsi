/{
		huawei_fac_info {
		compatible = "huawei,hw_fac_info";
		fac,product_name = "AGS-W09";
		fac,hardware_ver = "SH1AGSW09M";
		fac,software_ver = "AGS_W09_VA";
		fac,simcard_adapt = "support";
		status = "ok";
	};
};
