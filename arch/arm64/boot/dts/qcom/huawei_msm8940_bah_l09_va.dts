/*
 * Copyright (c) 2016, The Linux Foundation. All rights reserved.
 *
 * This program is free software; you can redistribute it and/or modify
 * it under the terms of the GNU General Public License version 2 and
 * only version 2 as published by the Free Software Foundation.
 *
 * This program is distributed in the hope that it will be useful,
 * but WITHOUT ANY WARRANTY; without even the implied warranty of
 * MERCHANTABILITY or FITNESS FOR A PARTICULAR PURPOSE.  See the
 * GNU General Public License for more details.
 */

/dts-v1/;
#include "huawei_msm8940_base.dtsi"
#include "huawei_msm8940_bah_l09_va/huawei.dtsi"
/ {
	model = "Huawei Technologies, Inc. BAH-L09";
	compatible = "qcom,msm8940-mtp", "qcom,msm8940", "qcom,mtp";
	qcom,board-id= <8040 0>;
	qcom,pmic-id = <0x10019 0x020011 0x0 0x0>;
	huawei,modem_id = <0xFAB00081 0x0>;
};
&rpm_bus {
	rpm-regulator-ldoa10 {
		pm8937_l10: regulator-l10 {
			regulator-boot-on;
			regulator-always-on;
		};
	};
};
