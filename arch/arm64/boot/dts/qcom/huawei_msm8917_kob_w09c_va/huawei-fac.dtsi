/{
		huawei_fac_info {
		compatible = "huawei,hw_fac_info";
		fac,product_name = "Kobe-W09C";
		fac,hardware_ver = "SH1KOBW09CM";
		fac,software_ver = "Kobe_W09C_VA";
		fac,simcard_adapt = "support";
		status = "ok";
	};
};
