
qcom,qrd-4v4-3900mAh-GY-XWD-data {
	/* #2765116_Huawei_TorontoXWDgy_3900mAh_averaged_MasterSlave_Jan4th2017*/
	qcom,max-voltage-uv = <4400000>;
	qcom,nom-batt-capacity-mah = <3900>;
	qcom,batt-id-kohm = <21>;
	qcom,battery-beta = <3435>;
	qcom,battery-type = "HB406689ECW_GY_XWD";
	qcom,fg-cc-cv-threshold-mv = <4380>;
	qcom,chg-rslow-comp-c1 = <3893854>;
	qcom,chg-rslow-comp-c2 = <7275859>;
	qcom,chg-rs-to-rslow = <820633>;
	qcom,chg-rslow-comp-thr = <0xBB>;
	qcom,checksum = <0x033D>;
	qcom,gui-version = "PMI8950GUI - 2.0.0.16";
	qcom,fg-profile-data = [
		 FA 83 E6 7D 
		 04 82 8D 7C 
		 60 83 DA 6D 
		 31 88 9A 8E 
		 29 82 FF 99 
		 0E BD C8 C9 
		 5A 0E 06 88 
		 0B 7E 01 82 
		 7C 7C 57 83 
		 00 68 76 7B 
		 10 8C 4D 82 
		 C3 99 17 BD 
		 10 CA 59 0E 
		 CC 0F 92 59 
		 14 70 71 FD 
		 C3 3F 85 46 
		 FE 42 00 00 
		 66 47 36 39 
		 8E 32 00 00 
		 00 00 00 00 
		 00 00 00 00 
		 99 6B 4D 6A 
		 31 78 E5 8A 
		 CB 76 04 70 
		 7D 44 10 81 
		 11 75 A3 69 
		 F6 76 66 A8 
		 1D A3 60 7C 
		 5E A0 71 0C 
		 28 00 FF 36 
		 F0 11 30 03 
		 00 00 00 0C 
	];
};
