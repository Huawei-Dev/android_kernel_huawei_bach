/* Copyright (c) 2013, The Linux Foundation. All rights reserved.
 *
 * This program is free software; you can redistribute it and/or modify
 * it under the terms of the GNU General Public License version 2 and
 * only version 2 as published by the Free Software Foundation.
 *
 * This program is distributed in the hope that it will be useful,
 * but WITHOUT ANY WARRANTY; without even the implied warranty of
 * MERCHANTABILITY or FITNESS FOR A PARTICULAR PURPOSE.  See the
 * GNU General Public License for more details.
 */

/*---------------------------------------------------------------------------
 * This file is autogenerated file using gcdb parser. Please do not edit it.
 * Update input XML file to add a new entry or update variable in this file
 * VERSION = "1.0"
 *---------------------------------------------------------------------------*/
&mdss_mdp {
	dsi_tianma_focal8716_5p5_1080p_video: qcom,mdss_dsi_tianma_focal8716_5p5_1080p_video {
		qcom,mdss-dsi-panel-name = "TIANMA_FOCAL8716_1080P_VIDEO";
		qcom,cont-splash-enabled;
		qcom,mdss-dsi-panel-controller = <&mdss_dsi0>;
		qcom,panel-supply-entries = <&dsi_panel_pwr_supply>;
		qcom,mdss-dsi-panel-type = "dsi_video_mode";
		qcom,mdss-dsi-panel-destination = "display_1";
		qcom,mdss-dsi-panel-framerate = <60>;
		qcom,mdss-dsi-virtual-channel-id = <0>;
		qcom,mdss-dsi-stream = <0>;
		qcom,mdss-dsi-panel-width = <1080>;
		qcom,mdss-dsi-panel-height = <1920>;
		qcom,mdss-dsi-h-front-porch = <98>;
		qcom,mdss-dsi-h-back-porch = <98>;
		qcom,mdss-dsi-h-pulse-width = <10>;
		qcom,mdss-dsi-h-sync-skew = <0>;
		qcom,mdss-dsi-v-back-porch = <20>;
		qcom,mdss-dsi-v-front-porch = <20>;
		qcom,mdss-dsi-v-pulse-width = <2>;
		qcom,mdss-dsi-h-left-border = <0>;
		qcom,mdss-dsi-h-right-border = <0>;
		qcom,mdss-dsi-v-top-border = <0>;
		qcom,mdss-dsi-v-bottom-border = <0>;
		qcom,mdss-dsi-bpp = <24>;
		qcom,mdss-dsi-underflow-color = <0xff>;
		qcom,mdss-dsi-border-color = <0>;
		qcom,mdss-dsi-color-order = "rgb_swap_rgb";
		qcom,mdss-dsi-on-command = [29 01 00 00 00 00 02 00 00
					29 01 00 00 00 00 04 ff 87 16 01
					29 01 00 00 00 00 02 00 80
					29 01 00 00 00 00 03 ff 87 16
					29 01 00 00 00 00 02 00 A0
					29 01 00 00 00 00 0d D6 0d 0c 0d 15 15 14 0f 0f 0f 0f 0f 0f
					29 01 00 00 00 00 02 00 B0
					29 01 00 00 00 00 0d D6 84 7b 73 62 71 7b 80 80 80 80 80 80
					29 01 00 00 00 00 02 00 C0
					29 01 00 00 00 00 0d D6 82 80 78 88 91 93 80 80 80 80 80 80
					29 01 00 00 00 00 02 00 D0
					29 01 00 00 00 00 0d D6 87 87 82 88 8e 92 80 80 80 80 80 80
					29 01 00 00 00 00 02 00 82
					29 01 00 00 00 00 02 B3 0C
					29 01 00 00 00 00 02 00 80
					29 01 00 00 00 00 03 FF 00 00
					29 01 00 00 00 00 02 00 00
					29 01 00 00 00 00 04 FF 00 00 00
					15 01 00 00 00 00 02 91 80
					15 01 00 00 00 00 02 35 00
					05 01 00 00 78 00 02 11 00
					05 01 00 00 14 00 02 29 00
					29 01 00 00 05 00 03 99 00 00];
		qcom,mdss-dsi-off-command = [29 01 00 00 05 00 03 99 95 27
					05 01 00 00 20 00 02 28 00
					05 01 00 00 78 00 02 10 00
					23 01 00 00 00 00 02 00 00
					29 01 00 00 05 00 05 f7 5a a5 87 16];
		qcom,mdss-dsi-on-command-state = "dsi_lp_mode";
		qcom,mdss-dsi-off-command-state = "dsi_lp_mode";
		qcom,mdss-dsi-h-sync-pulse = <1>;
		qcom,mdss-dsi-traffic-mode = "burst_mode";
		qcom,mdss-dsi-lane-map = "lane_map_0123";
		qcom,mdss-dsi-bllp-eof-power-mode;
		qcom,mdss-dsi-bllp-power-mode;
		qcom,mdss-dsi-lane-0-state;
		qcom,mdss-dsi-lane-1-state;
		qcom,mdss-dsi-lane-2-state;
		qcom,mdss-dsi-lane-3-state;
		qcom,mdss-dsi-panel-timings = [24 1f 08 09 05 03 04 a0
		24 1f 08 09 05 03 04 a0
		24 1f 08 09 05 03 04 a0
		24 1f 08 09 05 03 04 a0
		24 1b 08 09 05 03 04 a0];
		qcom,mdss-dsi-t-clk-post = <0x02>;
		qcom,mdss-dsi-t-clk-pre = <0x2D>;
		qcom,mdss-dsi-bl-min-level = <30>;
		qcom,mdss-dsi-bl-max-level = <3800>;
		qcom,mdss-brightness-max-level = <3800>;
		qcom,mdss-dsi-dma-trigger = "trigger_sw";
		qcom,mdss-dsi-mdp-trigger = "none";
		qcom,mdss-dsi-bl-pmic-control-type = "bl_ctrl_wled";
		qcom,panel-dot-inversion-mode-cmds = [29 01 00 00 00 00 02 FF 24
					29 01 00 00 00 00 02 FB 01
					29 01 00 00 00 00 02 9B 00
					29 01 00 00 00 00 02 FF 10
					29 01 00 00 00 00 02 FB 01];
		qcom,panel-column-inversion-mode-cmds = [29 01 00 00 00 00 02 FF 24
					29 01 00 00 00 00 02 FB 01
					29 01 00 00 00 00 02 9B 0F
					29 01 00 00 00 00 02 FF 10
					29 01 00 00 00 00 02 FB 01];
		qcom,dot-inversion-cmds-dsi-state = "dsi_lp_mode";
		qcom,column-inversion-cmds-dsi-state = "dsi_lp_mode";
		qcom,panel-esd-check-enabled;
		qcom,panel-esd-read-commands = [06 01 00 01 05 00 02 0A 9c
					06 01 00 01 05 00 02 0F C0
					06 01 00 01 05 00 02 05 00
					06 01 00 01 05 00 02 AC 00
					06 01 00 01 05 00 02 0D 00
					06 01 00 01 05 00 02 0B 00
					06 01 00 01 05 00 02 1D 02
					06 01 00 01 05 00 02 0C 07];
		qcom,esd-read-cmds-state = "dsi_hs_mode";
		qcom,mdss-dsi-lp11-init;
		qcom,mdss-dsi-tx-eot-append;
		qcom,mdss-dsi-rx-eot-ignore;
		qcom,mdss-bta-timeout-check;
		qcom,mdss-pan-physical-width-dimension = <68>;
		qcom,mdss-pan-physical-height-dimension = <121>;
		huawei,delaytime-before-bl = <80>;
		huawei,long-read-flag = <1>;
		huawei,reg-read-expect-value = <0x9C>;
		huawei,reg-long-read-count = <3>;
		qcom,mdss-dsi-reset-sequence = <1 15>, <0 5>, <1 15>;

	};
};
