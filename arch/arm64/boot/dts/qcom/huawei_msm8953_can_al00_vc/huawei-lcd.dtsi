/*---------------------------------------------------------------------------
 * This file is autogenerated file using huawei LCD parser. Please do not edit it.
 * Update input XML file to add a new entry or update variable in this file
 * Parser location: device/qcom/common/display/tools/huawei_lcd_panel 
 *---------------------------------------------------------------------------*/


#include "hw-panel-boe_nt35596s_5p0_1080p_video.dtsi"
#include "hw-panel-boe_td4300_5p0_1080p_video.dtsi"
#include "hw-panel-ctc_td4310_5p0_1080p_video.dtsi"
#include "hw-panel-jdi_sd6fa1_5p0_1080p_video.dtsi"
#include "hw-panel-lg_td4300_5p0_1080p_video.dtsi"
#include "hw-panel-tianma_td4300_5p0_1080p_video.dtsi"
