/* Copyright (c) 2013, The Linux Foundation. All rights reserved.
 *
 * This program is free software; you can redistribute it and/or modify
 * it under the terms of the GNU General Public License version 2 and
 * only version 2 as published by the Free Software Foundation.
 *
 * This program is distributed in the hope that it will be useful,
 * but WITHOUT ANY WARRANTY; without even the implied warranty of
 * MERCHANTABILITY or FITNESS FOR A PARTICULAR PURPOSE.  See the
 * GNU General Public License for more details.
 */

/*---------------------------------------------------------------------------
 * This file is autogenerated file using gcdb parser. Please do not edit it.
 * Update input XML file to add a new entry or update variable in this file
 * VERSION = "1.0"
 *---------------------------------------------------------------------------*/
&mdss_mdp {
	dsi_boe_nt35523b_8p0_800p_video: qcom,mdss_dsi_boe_nt35523b_8p0_800p_video {
		qcom,mdss-dsi-panel-name = "BOE_NT35523B_8P0_800P_VIDEO";
		qcom,cont-splash-enabled;
		qcom,mdss-dsi-panel-controller = <&mdss_dsi0>;
		qcom,panel-supply-entries = <&dsi_panel_pwr_supply>;
		qcom,mdss-dsi-panel-type = "dsi_video_mode";
		qcom,mdss-dsi-panel-destination = "display_1";
		qcom,mdss-dsi-panel-framerate = <60>;
		qcom,mdss-dsi-virtual-channel-id = <0>;
		qcom,mdss-dsi-stream = <0>;
		qcom,mdss-dsi-panel-width = <800>;
		qcom,mdss-dsi-panel-height = <1280>;
		qcom,mdss-dsi-h-front-porch = <180>;
		qcom,mdss-dsi-h-back-porch = <90>;
		qcom,mdss-dsi-h-pulse-width = <4>;
		qcom,mdss-dsi-h-sync-skew = <0>;
		qcom,mdss-dsi-v-back-porch = <14>;
		qcom,mdss-dsi-v-front-porch = <16>;
		qcom,mdss-dsi-v-pulse-width = <2>;
		qcom,mdss-dsi-h-left-border = <0>;
		qcom,mdss-dsi-h-right-border = <0>;
		qcom,mdss-dsi-v-top-border = <0>;
		qcom,mdss-dsi-v-bottom-border = <0>;
		qcom,mdss-dsi-bpp = <24>;
		qcom,mdss-dsi-underflow-color = <0xff>;
		qcom,mdss-dsi-border-color = <0>;
		qcom,mdss-dsi-color-order = "rgb_swap_rgb";
		qcom,mdss-dsi-on-command = [39 01 00 00 00 00 06 F0 55 AA 52 08 00
					39 01 00 00 01 00 03 B1 EE 01
					39 01 00 00 01 00 05 B8 02 06 21 00
					39 01 00 00 00 00 03 BA 22 26
					39 01 00 00 00 00 05 E6 FF FF FB DA
					39 01 00 00 00 00 07 CC 11 11 11 00 00 00
					39 01 00 00 00 00 0d CE 10 10 10 10 10 10 10 10 10 10 10 10
					39 01 00 00 00 00 0d D7 09 09 09 00 01 00 00 00 01 00 00 00
					39 01 00 00 00 00 0d D8 00 00 00 09 09 09 00 00 00 00 09 09
					39 01 00 00 00 00 06 F0 55 AA 52 08 01
					39 01 00 00 00 00 02 B2 01
					39 01 00 00 00 00 02 CA 00
					39 01 00 00 00 00 02 CE 34
					39 01 00 00 00 00 03 BC 68 01
					39 01 00 00 00 00 03 BD 68 01
					39 01 00 00 00 00 06 F0 55 AA 52 08 02
					39 01 00 00 00 00 02 B0 40
					39 01 00 00 00 00 11 D1 00 00 00 12 00 3C 00 55 00 78 00 9D 00 BE 00 F0
					39 01 00 00 00 00 11 D2 01 18 01 59 01 8E 01 DD 02 1F 02 21 02 5D 02 9E
					39 01 00 00 00 00 11 D3 02 C6 03 00 03 26 03 59 03 7A 03 A2 03 BB 03 D8
					39 01 00 00 00 00 05 D4 03 F6 03 FF
					39 01 00 00 00 00 06 F0 55 AA 52 08 03
					39 01 00 00 00 00 05 B0 00 23 00 00
					39 01 00 00 00 00 08 B2 01 00 06 04 00 D8 42
					39 01 00 00 00 00 08 B3 01 00 05 04 00 D8 42
					39 01 00 00 00 00 08 BA 85 03 00 04 01 D8 42
					39 01 00 00 00 00 08 BB 85 03 00 03 01 D8 42
					39 01 00 00 00 00 06 F0 55 AA 52 08 06
					39 01 00 00 00 00 02 B3 03
					39 01 00 00 00 00 06 B1 19 18 18 02 3A
					39 01 00 00 00 00 03 B2 3A 3A
					39 01 00 00 00 00 06 B6 13 12 12 00 3A
					39 01 00 00 00 00 05 FF AA 55 A5 80
					39 01 00 00 00 00 02 6F 09
					39 01 00 00 00 00 02 F7 82
					39 01 00 00 00 00 02 6F 0B
					39 01 00 00 00 00 02 F7 E0
					39 01 00 00 00 00 02 55 81
					39 01 00 00 00 00 02 53 2C
					39 01 00 00 00 00 02 51 FF
					39 01 00 00 78 00 02 11 00
					39 01 00 00 20 00 02 29 00];
		qcom,mdss-dsi-off-command = [39 01 00 00 78 00 02 10 00
					39 01 00 00 20 00 02 28 00];
		qcom,mdss-dsi-on-command-state = "dsi_lp_mode";
		qcom,mdss-dsi-off-command-state = "dsi_hs_mode";
		qcom,mdss-dsi-h-sync-pulse = <1>;
		qcom,mdss-dsi-traffic-mode = "burst_mode";
		qcom,mdss-dsi-lane-map = "lane_map_0123";
		qcom,mdss-dsi-bllp-eof-power-mode;
		qcom,mdss-dsi-bllp-power-mode;
		qcom,mdss-dsi-lane-0-state;
		qcom,mdss-dsi-lane-1-state;
		qcom,mdss-dsi-lane-2-state;
		qcom,mdss-dsi-lane-3-state;
		qcom,mdss-dsi-panel-timings = [94 20 14 00 46 48 1A 24 18 03 04 00];
		qcom,mdss-dsi-t-clk-post = <0x04>;
		qcom,mdss-dsi-t-clk-pre = <0x1D>;
		qcom,mdss-dsi-bl-min-level = <6>;
		qcom,mdss-dsi-bl-max-level = <255>;
		qcom,mdss-brightness-max-level = <255>;
		qcom,mdss-dsi-dma-trigger = "trigger_sw";
		qcom,mdss-dsi-mdp-trigger = "none";
		qcom,mdss-dsi-bl-pmic-control-type = "bl_ctrl_dcs";
		qcom,mdss-pan-physical-width-dimension = <124>;
		qcom,mdss-pan-physical-height-dimension = <211>;
		huawei,product-pad-flag = <1>;
		qcom,mdss-dsi-reset-sequence = <1 15>, <0 5>, <1 20>;

	};
};
