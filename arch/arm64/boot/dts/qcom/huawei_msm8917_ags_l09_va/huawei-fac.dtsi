/{
		huawei_fac_info {
		compatible = "huawei,hw_fac_info";
		fac,product_name = "AGS-L09";
		fac,hardware_ver = "SH1AGSL09M";
		fac,software_ver = "AGS_L09_VA";
		fac,simcard_adapt = "support";
		status = "ok";
	};
};
