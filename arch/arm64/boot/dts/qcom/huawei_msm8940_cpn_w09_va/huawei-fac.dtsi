/{
		huawei_fac_info {
		compatible = "huawei,hw_fac_info";
		fac,product_name = "CPN-W09";
		fac,hardware_ver = "SH1CHOPINW09M";
		fac,software_ver = "CPN_W09_VA";
		fac,simcard_adapt = "support";
		status = "ok";
	};
};
