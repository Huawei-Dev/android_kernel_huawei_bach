/*
 * Copyright (c) 2016, The Linux Foundation. All rights reserved.
 *
 * This program is free software; you can redistribute it and/or modify
 * it under the terms of the GNU General Public License version 2 and
 * only version 2 as published by the Free Software Foundation.
 *
 * This program is distributed in the hope that it will be useful,
 * but WITHOUT ANY WARRANTY; without even the implied warranty of
 * MERCHANTABILITY or FITNESS FOR A PARTICULAR PURPOSE.  See the
 * GNU General Public License for more details.
 */

/ {
	huawei_wifi_info {
		compatible = "huawei,hw_wifi_info";
		status = "ok";
		wifi,chiptype = "WIFI_QUALCOMM_WCN3680";
		wifi,pubfile_id = "cpn_al00";
		wifi,fw_ver = "QCOM_WCN3680_2.0.2";
	};
};
