/{
		huawei_fac_info {
		compatible = "huawei,hw_fac_info";
		fac,product_name = "BAH-AL00";
		fac,hardware_ver = "SH1BAHAL00M";
		fac,software_ver = "BAH_AL00_VA";
		fac,simcard_adapt = "support";
		status = "ok";
	};
};
