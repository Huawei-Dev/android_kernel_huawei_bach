/{
		huawei_fac_info {
		compatible = "huawei,hw_fac_info";
		fac,product_name = "BAH-L01";
		fac,hardware_ver = "SH1BAHL01M";
		fac,software_ver = "BAH_L01_VA";
		fac,simcard_adapt = "support";
		status = "ok";
	};
};
