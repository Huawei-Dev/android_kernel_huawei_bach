
qcom,qrd-4v4-4000mAh-ATL-Desay-data {
	/* #2741543_Huawei_TorontoATL_3900mAh_averaged_MasterSlave_Dec14th2016*/
	qcom,max-voltage-uv = <4400000>;
	qcom,nom-batt-capacity-mah = <3900>;
	qcom,batt-id-kohm = <64>;
	qcom,battery-beta = <3435>;
	qcom,battery-type = "HB406689ECW_ATL_Desay";
	qcom,fg-cc-cv-threshold-mv = <4380>;
	qcom,chg-rslow-comp-c1 = <2494919>;
	qcom,chg-rslow-comp-c2 = <2719174>;
	qcom,chg-rs-to-rslow = <1054622>;
	qcom,chg-rslow-comp-thr = <0x99>;
	qcom,checksum = <0x3F88>;
	qcom,gui-version = "PMI8950GUI - 2.0.0.16";
	qcom,fg-profile-data = [
		 E4 83 F3 7C 
		 44 81 B2 77 
		 69 83 77 75 
		 16 8A E9 94 
		 1B 82 8F 99 
		 1C BC 1B C8 
		 56 12 01 88 
		 9E 7D B3 81 
		 3C 7C 54 83 
		 B3 69 9D 79 
		 C7 86 32 82 
		 39 9A 8F BD 
		 D9 CA 59 0E 
		 91 0F 0A 59 
		 14 70 71 FD 
		 56 21 9C 45 
		 5E 2C 00 00 
		 23 47 38 33 
		 AF 31 00 00 
		 00 00 00 00 
		 00 00 00 00 
		 BF 70 35 70 
		 F2 68 6B 88 
		 CD 6F 71 61 
		 47 67 43 78 
		 7E 6E 6E 5B 
		 BC 5F 36 A0 
		 1E 24 69 2B 
		 6C A0 71 0C 
		 28 00 FF 36 
		 F0 11 30 03 
		 00 00 00 0C 
	];
};
