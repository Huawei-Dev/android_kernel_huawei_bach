/*
 * Copyright (c) 2015, The Linux Foundation. All rights reserved.
 *
 * This program is free software; you can redistribute it and/or modify
 * it under the terms of the GNU General Public License version 2 and
 * only version 2 as published by the Free Software Foundation.
 *
 * This program is distributed in the hope that it will be useful,
 * but WITHOUT ANY WARRANTY; without even the implied warranty of
 * MERCHANTABILITY or FITNESS FOR A PARTICULAR PURPOSE.  See the
 * GNU General Public License for more details.
 */
 /dts-v1/;
#include "huawei_base.dtsi"
#include "huawei_msm8953_mla_tl00_va/huawei.dtsi"

/ {
	model = "Huawei Technologies, Inc. MLA-TL00";
	qcom,board-id= <8032 0>;
	huawei,modem_id = <0xFBF40182 0x0>;
};
