/* Copyright (c) 2013, The Linux Foundation. All rights reserved.
 *
 * This program is free software; you can redistribute it and/or modify
 * it under the terms of the GNU General Public License version 2 and
 * only version 2 as published by the Free Software Foundation.
 *
 * This program is distributed in the hope that it will be useful,
 * but WITHOUT ANY WARRANTY; without even the implied warranty of
 * MERCHANTABILITY or FITNESS FOR A PARTICULAR PURPOSE.  See the
 * GNU General Public License for more details.
 */

/*---------------------------------------------------------------------------
 * This file is autogenerated file using gcdb parser. Please do not edit it.
 * Update input XML file to add a new entry or update variable in this file
 * VERSION = "1.0"
 *---------------------------------------------------------------------------*/
&mdss_mdp {
	dsi_boe_test1906c_5p5_1080p_cmd: qcom,mdss_dsi_boe_test1906c_5p5_1080p_cmd {
		qcom,mdss-dsi-panel-name = "BOE_TEST1906C_5P5_1080P_CMD";
		qcom,cont-splash-enabled;
		qcom,mdss-dsi-panel-controller = <&mdss_dsi0>;
		qcom,panel-supply-entries = <&dsi_panel_pwr_supply>;
		qcom,mdss-dsi-panel-type = "dsi_cmd_mode";
		qcom,mdss-dsi-panel-destination = "display_1";
		qcom,mdss-dsi-panel-clockrate = <898000000>;
		qcom,mdss-dsi-panel-framerate = <60>;
		qcom,mdss-dsi-virtual-channel-id = <0>;
		qcom,mdss-dsi-stream = <0>;
		qcom,mdss-dsi-panel-width = <1080>;
		qcom,mdss-dsi-panel-height = <1920>;
		qcom,mdss-dsi-h-front-porch = <45>;
		qcom,mdss-dsi-h-back-porch = <45>;
		qcom,mdss-dsi-h-pulse-width = <8>;
		qcom,mdss-dsi-h-sync-skew = <0>;
		qcom,mdss-dsi-v-back-porch = <16>;
		qcom,mdss-dsi-v-front-porch = <16>;
		qcom,mdss-dsi-v-pulse-width = <4>;
		qcom,mdss-dsi-h-left-border = <0>;
		qcom,mdss-dsi-h-right-border = <0>;
		qcom,mdss-dsi-v-top-border = <0>;
		qcom,mdss-dsi-v-bottom-border = <0>;
		qcom,mdss-dsi-bpp = <24>;
		qcom,mdss-dsi-underflow-color = <0x00>;
		qcom,mdss-dsi-border-color = <0>;
		qcom,mdss-dsi-color-order = "rgb_swap_rgb";
		qcom,mdss-dsi-on-command = [29 01 00 00 00 00 02 00 00
					29 01 00 00 00 00 04 FF 19 06 01
					29 01 00 00 00 00 02 00 80
					29 01 00 00 00 00 03 FF 19 06
					29 01 00 00 00 00 02 00 00
					29 01 00 00 00 00 02 00 00
					29 01 00 00 00 00 02 D1 CC
					29 01 00 00 00 00 02 00 01
					29 01 00 00 00 00 02 D1 DD
					29 01 00 00 00 00 02 DA 00
					29 01 00 00 00 00 02 DB 00
					29 01 00 00 00 00 02 DC 00
					29 01 00 00 00 00 02 00 A0
					29 01 00 00 00 00 04 C1 00 C0 10
					29 01 00 00 00 00 02 00 91
					29 01 00 00 00 00 03 C5 14 1E
					29 01 00 00 00 00 02 00 85
					29 01 00 00 00 00 02 C5 14
					29 01 00 00 00 00 02 00 86
					29 01 00 00 00 00 02 C5 14
					29 01 00 00 00 00 02 00 95
					29 01 00 00 00 00 02 C5 11
					29 01 00 00 00 00 02 00 00
					29 01 00 00 00 00 02 D9 00
					29 01 00 00 00 00 02 00 01
					29 01 00 00 00 00 02 D9 CD
					29 01 00 00 00 00 02 00 02
					29 01 00 00 00 00 02 D9 00
					29 01 00 00 00 00 02 00 03
					29 01 00 00 00 00 02 D9 CD
					29 01 00 00 00 00 02 00 04
					29 01 00 00 00 00 02 D9 00
					29 01 00 00 00 00 02 00 05
					29 01 00 00 00 00 02 D9 CD
					29 01 00 00 00 00 02 00 06
					29 01 00 00 00 00 02 D9 00
					29 01 00 00 00 00 02 00 07
					29 01 00 00 00 00 02 D9 CD
					29 01 00 00 00 00 02 00 81
					29 01 00 00 00 00 02 A5 01
					29 01 00 00 00 00 02 00 A5
					29 01 00 00 00 00 02 C5 11
					29 01 00 00 00 00 02 00 90
					29 01 00 00 00 00 05 F5 09 16 09 16
					29 01 00 00 00 00 02 00 A7
					29 01 00 00 00 00 02 F5 1A
					29 01 00 00 00 00 02 00 9D
					29 01 00 00 00 00 02 F5 1A
					29 01 00 00 00 00 02 00 A5
					29 01 00 00 00 00 02 F5 16
					29 01 00 00 00 00 02 00 8D
					29 01 00 00 00 00 02 F5 17
					29 01 00 00 00 00 02 00 E3
					29 01 00 00 00 00 02 F5 11
					29 01 00 00 00 00 02 00 ED
					29 01 00 00 00 00 02 F5 16
					29 01 00 00 00 00 02 00 E5
					29 01 00 00 00 00 02 F5 16
					29 01 00 00 00 00 02 00 81
					29 01 00 00 00 00 02 F5 16
					29 01 00 00 00 00 02 00 83
					29 01 00 00 00 00 02 F5 16
					29 01 00 00 00 00 02 00 E1
					29 01 00 00 00 00 02 F5 16
					29 01 00 00 00 00 02 00 C0
					29 01 00 00 00 00 10 CC 0C 0C 00 00 0C 0C 0C 0C 00 00 00 00 00 00 00
					29 01 00 00 00 00 02 00 D0
					29 01 00 00 00 00 10 CC 00 00 00 00 00 00 00 00 00 00 00 33 33 33 33
					29 01 00 00 00 00 02 00 E0
					29 01 00 00 00 00 10 CC 33 33 00 00 00 00 00 00 00 00 00 00 00 00 00
					29 01 00 00 00 00 02 00 80
					29 01 00 00 00 00 03 C1 55 55
					29 01 00 00 00 00 02 00 94
					29 01 00 00 00 00 02 C5 22
					29 01 00 00 00 00 02 00 A4
					29 01 00 00 00 00 02 C5 22
					29 01 00 00 00 00 02 00 C1
					29 01 00 00 00 00 02 C5 F5
					29 01 00 00 00 00 02 00 B3
					29 01 00 00 00 00 02 C0 88
					29 01 00 00 00 00 02 00 B4
					29 01 00 00 00 00 02 C0 00
					29 01 00 00 00 00 02 00 E0
					29 01 00 00 00 00 02 C5 01
					29 01 00 00 00 00 02 00 00
					29 01 00 00 00 00 03 D8 23 23
					29 01 00 00 00 00 02 00 80
					29 01 00 00 00 00 02 C4 31
					29 01 00 00 00 00 02 00 A0
					29 01 00 00 00 00 02 B3 33
					29 01 00 00 00 00 02 00 A6
					29 01 00 00 00 00 02 B3 30
					29 01 00 00 00 00 02 00 E0
					29 01 00 00 00 00 0B B4 1C 19 3F 01 64 5C 01 A0 5F A0
					29 01 00 00 00 00 02 00 F0
					29 01 00 00 00 00 02 B4 64
					29 01 00 00 00 00 02 00 80
					29 01 00 00 00 00 0F C0 00 74 00 0A 0A 00 74 0A 0A 00 74 00 0A 0A
					29 01 00 00 00 00 02 00 90
					29 01 00 00 00 00 07 C0 00 00 00 02 00 04
					29 01 00 00 00 00 02 00 A0
					29 01 00 00 00 00 10 C0 00 00 02 00 00 1F 00 00 00 00 00 00 00 00 00
					29 01 00 00 00 00 02 00 D0
					29 01 00 00 00 00 10 C0 00 00 02 00 00 1F 00 00 00 00 00 00 00 00 00
					29 01 00 00 00 00 02 00 80
					29 01 00 00 00 00 0D C2 83 01 00 00 82 01 00 00 00 00 00 00
					29 01 00 00 00 00 02 00 90
					29 01 00 00 00 00 0D C2 00 00 00 00 00 00 00 00 00 00 00 00
					29 01 00 00 00 00 02 00 A0
					29 01 00 00 00 00 0E C2 00 00 00 00 00 00 00 00 00 00 00 00 00
					29 01 00 00 00 00 02 00 B0
					29 01 00 00 00 00 10 C2 82 02 00 00 88 81 02 00 00 88 00 02 00 00 88
					29 01 00 00 00 00 02 00 C0
					29 01 00 00 00 00 10 C2 01 02 00 00 88 00 00 00 00 00 00 00 00 00 00
					29 01 00 00 00 00 02 00 D0
					29 01 00 00 00 00 10 C2 00 00 00 00 00 00 00 00 00 00 33 33 33 33 00
					29 01 00 00 00 00 02 00 80
					29 01 00 00 00 00 10 C3 00 00 00 00 00 00 00 00 00 00 00 00 00 00 00
					29 01 00 00 00 00 02 00 A0
					29 01 00 00 00 00 0D C3 83 01 00 00 82 01 00 00 00 00 00 00
					29 01 00 00 00 00 02 00 B0
					29 01 00 00 00 00 0F C3 00 00 00 00 82 02 00 00 88 81 02 00 00 88
					29 01 00 00 00 00 02 00 C0
					29 01 00 00 00 00 10 C3 00 02 00 00 88 01 02 00 00 88 00 00 00 00 00
					29 01 00 00 00 00 02 00 D0
					29 01 00 00 00 00 10 C3 00 00 00 00 00 00 00 00 00 00 00 00 00 00 00
					29 01 00 00 00 00 02 00 E0
					29 01 00 00 00 00 06 C3 33 33 33 33 00
					29 01 00 00 00 00 02 00 80
					29 01 00 00 00 00 0C CB 00 00 00 00 30 00 03 00 00 00 70
					29 01 00 00 00 00 02 00 90
					29 01 00 00 00 00 10 CB 00 00 00 00 00 00 00 00 00 00 00 00 00 00 00
					29 01 00 00 00 00 02 00 A0
					29 01 00 00 00 00 10 CB 00 00 00 BF 00 00 00 00 00 FF 00 00 00 00 00
					29 01 00 00 00 00 02 00 B0
					29 01 00 00 00 00 0D CB 00 00 00 00 00 00 00 00 00 00 77 77
					29 01 00 00 00 00 02 00 C0
					29 01 00 00 00 00 10 CB 01 01 01 01 01 01 01 01 01 01 01 01 01 01 01
					29 01 00 00 00 00 02 00 D0
					29 01 00 00 00 00 10 CB 01 01 01 F3 01 01 01 01 00 F3 00 00 01 00 01
					29 01 00 00 00 00 02 00 E0
					29 01 00 00 00 00 0D CB 00 01 00 01 00 01 00 01 00 00 77 07
					29 01 00 00 00 00 02 00 F0
					29 01 00 00 00 00 0C CB FF FF FF FF FF FF 03 33 03 00 70 
					29 01 00 00 00 00 02 00 80
					29 01 00 00 00 00 0D CC 08 09 18 19 0C 0D 0E 0F 07 07 07 07
					29 01 00 00 00 00 02 00 90
					29 01 00 00 00 00 0D CC 09 08 19 18 0F 0E 0D 0C 07 07 07 07
					29 01 00 00 00 00 02 00 A0
					29 01 00 00 00 00 10 CC 14 15 16 17 1C 1D 1E 1F 01 04 20 07 07 07 00
					29 01 00 00 00 00 02 00 B0
					29 01 00 00 00 00 0A CC 01 02 03 04 05 06 07 07 00
					29 01 00 00 00 00 02 00 80
					29 01 00 00 00 00 10 CD 1A 01 11 12 1A 05 18 07 1A 1A 23 23 23 1F 1E
					29 01 00 00 00 00 02 00 90
					29 01 00 00 00 00 04 CD 1D 23 23
					29 01 00 00 00 00 02 00 A0
					29 01 00 00 00 00 10 CD 1A 02 11 12 1A 06 18 08 1A 1A 23 23 23 1F 1E
					29 01 00 00 00 00 02 00 B0
					29 01 00 00 00 00 04 CD 1D 23 23
					29 01 00 00 00 00 02 00 80
					29 01 00 00 00 00 0B A4 AF 00 20 04 00 17 15 03 60 00
					29 01 00 00 00 00 02 00 90
					29 01 00 00 00 00 04 A4 00 00 00
					29 01 00 00 00 00 02 00 80
					29 01 00 00 00 00 0D A7 FF 0F 1E 00 20 00 01 98 00 00 00 00
					29 01 00 00 00 00 02 00 90
					29 01 00 00 00 00 0B A7 1d 20 3d 00 00 BE 90 CE 05 F0
					29 01 00 00 00 00 02 00 A0
					29 01 00 00 00 00 02 A7 30
					29 01 00 00 00 00 02 00 B0
					29 01 00 00 00 00 06 A7 00 1E 1E 00 00
					29 01 00 00 00 00 02 00 C0
					29 01 00 00 00 00 0D A7 FF 0F 1E 00 1F 00 01 18 00 00 00 00
					29 01 00 00 00 00 02 00 D0
					29 01 00 00 00 00 0B A7 FF FF 1C 00 01 7C 81 7C 0B E0
					29 01 00 00 00 00 02 00 E0
					29 01 00 00 00 00 02 A7 30
					29 01 00 00 00 00 02 00 F0
					29 01 00 00 00 00 06 A7 00 3C 3C 00 00
					29 01 00 00 00 00 02 00 D0
					29 01 00 00 00 00 0B A7 FF FF 1D 00 01 7C 81 7C 0B E0
					29 01 00 00 00 00 02 00 80
					29 01 00 00 00 00 0D A9 00 00 00 00 00 00 00 00 00 00 00 00
					29 01 00 00 00 00 02 00 90
					29 01 00 00 00 00 0B A9 00 00 00 00 00 00 00 00 00 00
					29 01 00 00 00 00 02 00 A0
					29 01 00 00 00 00 02 A9 00
					29 01 00 00 00 00 02 00 B0
					29 01 00 00 00 00 06 A9 00 00 00 00 00
					29 01 00 00 00 00 02 00 C0
					29 01 00 00 00 00 0F A9 FF 3A 49 00 1E 00 01 00 00 00 00 00 00 77
					29 01 00 00 00 00 02 00 D0
					29 01 00 00 00 00 0B A9 FF FF 1D 00 01 7C 81 7C 0B E0
					29 01 00 00 00 00 02 00 E0
					29 01 00 00 00 00 02 A9 30
					29 01 00 00 00 00 02 00 F0
					29 01 00 00 00 00 06 A9 00 3C 3C 00 00
					29 01 00 00 00 00 02 00 B0
					29 01 00 00 00 00 09 A4 05 F0 0B E0 00 00 0B E0
					29 01 00 00 00 00 02 00 80
					29 01 00 00 00 00 10 AB 05 14 00 00 FF 6A 00 00 00 00 00 00 00 00 00
					29 01 00 00 00 00 02 00 A0
					29 01 00 00 00 00 10 AB 00 00 00 00 00 00 00 07 00 00 00 00 01 00 00
					29 01 00 00 00 00 02 00 B0
					29 01 00 00 00 00 0D AB 00 00 21 0A 00 00 44 04 00 00 00 00
					29 01 00 00 00 00 02 00 93
					29 01 00 00 00 00 02 B3 01
					29 01 00 00 00 00 02 00 80
					29 01 00 00 00 00 08 CE 00 00 00 00 00 00 00 
					29 01 00 00 00 00 02 00 87
					29 01 00 00 00 00 08 CE 00 00 33 00 33 00 00 
					29 01 00 00 00 00 02 00 F0
					29 01 00 00 00 00 05 CE 00 00 00 00
					29 01 00 00 00 00 02 00 90
					29 01 00 00 00 00 10 CE 00 00 00 F0 00 00 00 00 FC 00 FC 00 00 00 00
					29 01 00 00 00 00 02 00 A0
					29 01 00 00 00 00 08 CE 00 00 40 40 40 00 00
					29 01 00 00 00 00 02 00 B0
					29 01 00 00 00 00 10 CE 01 01 01 01 01 01 01 01 F1 01 F1 01 01 01 01  
					29 01 00 00 00 00 02 00 C0
					29 01 00 00 00 00 08 CE 01 01 01 01 01 01 01  
					29 01 00 00 00 00 02 00 D0
					29 01 00 00 00 00 10 CE 04 04 04 04 04 04 04 04 F7 04 F7 04 04 00 00  
					29 01 00 00 00 00 02 00 E0
					29 01 00 00 00 00 08 CE 00 00 15 15 15 04 04
					29 01 00 00 00 00 02 00 F4
					29 01 00 00 00 00 02 CE 25
					29 01 00 00 00 00 02 00 00
					29 01 00 00 00 00 04 FF FF FF FF
					29 01 00 00 00 00 05 2A 00 00 04 37
					29 01 00 00 00 00 05 2B 00 00 07 7F
					15 01 00 00 00 00 02 35 00
					05 01 00 00 78 00 02 11 00
					05 01 00 00 00 00 02 29 00];
		qcom,mdss-dsi-off-command = [05 01 00 00 00 00 02 28 00
					05 01 00 00 78 00 02 10 00];
		qcom,mdss-dsi-on-command-state = "dsi_lp_mode";
		qcom,mdss-dsi-off-command-state = "dsi_hs_mode";
		qcom,mdss-dsi-h-sync-pulse = <1>;
		qcom,mdss-dsi-traffic-mode = "burst_mode";
		qcom,mdss-dsi-lane-map = "lane_map_0123";
		qcom,mdss-dsi-bllp-eof-power-mode;
		qcom,mdss-dsi-bllp-power-mode;
		qcom,mdss-dsi-lane-0-state;
		qcom,mdss-dsi-lane-1-state;
		qcom,mdss-dsi-lane-2-state;
		qcom,mdss-dsi-lane-3-state;
		qcom,mdss-dsi-te-pin-select = <1>;
		qcom,mdss-dsi-te-v-sync-rd-ptr-irq-line = <0x2c>;
		qcom,mdss-dsi-te-dcs-command = <1>;
		qcom,mdss-dsi-te-check-enable;
		qcom,mdss-dsi-te-using-te-pin;
		qcom,mdss-dsi-panel-timings = [23 1E 08 09 05 03 04 A0
	23 1E 08 09 05 03 04 A0
	23 1E 08 09 05 03 04 A0
	23 1E 08 09 05 03 04 A0
	23 1A 08 09 05 03 04 A0];
		qcom,mdss-dsi-t-clk-post = <0x2C>;
		qcom,mdss-dsi-t-clk-pre = <0x2B>;
		qcom,mdss-dsi-bl-min-level = <30>;
		qcom,mdss-dsi-bl-max-level = <4095>;
		qcom,mdss-brightness-max-level = <4095>;
		qcom,mdss-dsi-dma-trigger = "trigger_sw";
		qcom,mdss-dsi-mdp-trigger = "none";
		qcom,mdss-dsi-bl-pmic-control-type = "bl_ctrl_wled";
		qcom,panel-dot-inversion-mode-cmds = [29 01 00 00 00 00 02 00 00
                          29 01 00 00 00 00 04 FF 19 06 01
                          29 01 00 00 00 00 02 00 80
                          29 01 00 00 00 00 03 FF 19 06
                          29 01 00 00 00 00 02 00 B3
                          29 01 00 00 00 00 02 C0 00
                          29 01 00 00 00 00 02 00 00
                          29 01 00 00 00 00 02 FB 01
                          29 01 00 00 00 00 02 00 00
                          29 01 00 00 00 00 04 FF FF FF FF];
		qcom,panel-column-inversion-mode-cmds = [29 01 00 00 00 00 02 00 00
                             29 01 00 00 00 00 04 FF 19 06 01
                             29 01 00 00 00 00 02 00 80
                             29 01 00 00 00 00 03 FF 19 06
                             29 01 00 00 00 00 02 00 B3
                             29 01 00 00 00 00 02 C0 88
                             29 01 00 00 00 00 02 00 00
                             29 01 00 00 00 00 02 FB 01
                             29 01 00 00 00 00 02 00 00
                             29 01 00 00 00 00 04 FF FF FF FF];
		qcom,dot-inversion-cmds-dsi-state = "dsi_lp_mode";
		qcom,column-inversion-cmds-dsi-state = "dsi_lp_mode";
		qcom,mdss-dsi-lp11-init;
		qcom,mdss-pan-physical-width-dimension = <68>;
		qcom,mdss-pan-physical-height-dimension = <121>;
		huawei,delaytime-before-bl = <80>;
		huawei,long-read-flag = <1>;
		huawei,reg-read-expect-value = <0x9C>;
		huawei,reg-long-read-count = <3>;
		qcom,mdss-dsi-reset-sequence = <1 15>, <0 5>, <1 15>;

	};
};
