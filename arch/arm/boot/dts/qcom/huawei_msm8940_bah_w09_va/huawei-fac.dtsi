/{
		huawei_fac_info {
		compatible = "huawei,hw_fac_info";
		fac,product_name = "BAH-W09";
		fac,hardware_ver = "SH1BAHW09M";
		fac,software_ver = "BAH_W09_VA";
		fac,simcard_adapt = "support";
		status = "ok";
	};
};
