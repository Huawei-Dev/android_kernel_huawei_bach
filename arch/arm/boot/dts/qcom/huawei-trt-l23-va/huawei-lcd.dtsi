/*---------------------------------------------------------------------------
 * This file is autogenerated file using huawei LCD parser. Please do not edit it.
 * Update input XML file to add a new entry or update variable in this file
 * Parser location: device/qcom/common/display/tools/huawei_lcd_panel 
 *---------------------------------------------------------------------------*/


#include "hw-panel-boe_td4100_5p5_720pxa_video.dtsi"
#include "hw-panel-inx_ft8607_5p5_720pxa_video.dtsi"
