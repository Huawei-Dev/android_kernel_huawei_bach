 / {
	huawei_wifi_info {
		compatible = "huawei,hw_wifi_info";
		status = "ok";
		wifi,chiptype = "WIFI_QUALCOMM_WCN3660B";
		wifi,pubfile_id = "can_al00_no_fem";
		wifi,fw_ver = "QCOM_WCN3660B_2.0.2";
		wifi,no-autodetect-xo;
	};
};
