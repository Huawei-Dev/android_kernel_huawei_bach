/* Copyright (c) 2013, The Linux Foundation. All rights reserved.
 *
 * This program is free software; you can redistribute it and/or modify
 * it under the terms of the GNU General Public License version 2 and
 * only version 2 as published by the Free Software Foundation.
 *
 * This program is distributed in the hope that it will be useful,
 * but WITHOUT ANY WARRANTY; without even the implied warranty of
 * MERCHANTABILITY or FITNESS FOR A PARTICULAR PURPOSE.  See the
 * GNU General Public License for more details.
 */

/*---------------------------------------------------------------------------
 * This file is autogenerated file using gcdb parser. Please do not edit it.
 * Update input XML file to add a new entry or update variable in this file
 * VERSION = "1.0"
 *---------------------------------------------------------------------------*/
&mdss_mdp {
	dsi_ctc_td4310_5p0_1080p_video: qcom,mdss_dsi_ctc_td4310_5p0_1080p_video {
		qcom,mdss-dsi-panel-name = "CTC_TD4310_1080P_VIDEO";
		qcom,cont-splash-enabled;
		qcom,mdss-dsi-panel-controller = <&mdss_dsi0>;
		qcom,panel-supply-entries = <&dsi_panel_pwr_supply>;
		qcom,mdss-dsi-panel-type = "dsi_video_mode";
		qcom,mdss-dsi-panel-destination = "display_1";
		qcom,mdss-dsi-panel-clockrate = <900000000>;
		qcom,mdss-dsi-panel-framerate = <60>;
		qcom,mdss-dsi-virtual-channel-id = <0>;
		qcom,mdss-dsi-stream = <0>;
		qcom,mdss-dsi-panel-width = <1080>;
		qcom,mdss-dsi-panel-height = <1920>;
		qcom,mdss-dsi-h-front-porch = <107>;
		qcom,mdss-dsi-h-back-porch = <50>;
		qcom,mdss-dsi-h-pulse-width = <2>;
		qcom,mdss-dsi-h-sync-skew = <0>;
		qcom,mdss-dsi-v-back-porch = <33>;
		qcom,mdss-dsi-v-front-porch = <4>;
		qcom,mdss-dsi-v-pulse-width = <2>;
		qcom,mdss-dsi-h-left-border = <0>;
		qcom,mdss-dsi-h-right-border = <0>;
		qcom,mdss-dsi-v-top-border = <0>;
		qcom,mdss-dsi-v-bottom-border = <0>;
		qcom,mdss-dsi-bpp = <24>;
		qcom,mdss-dsi-underflow-color = <0x00>;
		qcom,mdss-dsi-border-color = <0>;
		qcom,mdss-dsi-color-order = "rgb_swap_rgb";
		qcom,mdss-dsi-on-command = [23 01 00 00 00 00 02 B0 00
					29 01 00 00 00 00 04 B3 31 00 06
					29 01 00 00 00 00 02 B4 00
					29 01 00 00 00 00 06 B6 33 5B 81 12 00
					29 01 00 00 00 00 08 B8 57 3D 19 1E 0A 50 50
					29 01 00 00 00 00 08 B9 6F 3D 28 3C 14 C8 C8
					29 01 00 00 00 00 08 BA B5 33 41 64 23 A0 A0
					29 01 00 00 00 00 03 BB 14 14
					29 01 00 00 00 00 03 BC 37 32
					29 01 00 00 00 00 03 BD 64 32
					29 01 00 00 00 00 02 BE 04
					29 01 00 00 00 00 02 C0 00
					29 01 00 00 00 00 31 C1 04 C8 00 FF FF FF E8 94 71 EB CB BB 67 CD B9 C6 7C E7 57 6F 31 48 01 FF FF 0F 00 00 00 00 00 00 00 00 40 02 62 01 06 05 84 00 01 00 01 00 00 00
					29 01 00 00 00 00 19 C2 01 F7 80 12 68 08 0C 10 00 08 60 00 00 00 00 00 00 00 00 08 00 00 00 00
					29 01 00 00 00 00 3F C3 78 77 87 78 70 00 00 00 00 00 3B 63 B6 00 00 3F C3 FC 00 00 01 01 0C 28 00 01 00 01 00 00 15 00 15 00 2C 01 00 00 00 00 00 00 00 00 00 00 00 00 2C 00 2C 00 5A 02 00 00 00 00 00 00 40 00
					29 01 00 00 00 00 15 C4 70 00 00 00 00 00 00 00 00 02 02 31 01 00 00 00 02 01 01 01
					29 01 00 00 00 00 09 C5 08 00 00 00 00 70 00 00
					29 01 00 00 00 00 40 C6 46 02 36 02 36 00 00 01 02 01 02 00 00 00 00 00 00 04 0D 04 47 00 8E 61 00 00 00 00 00 00 00 00 00 00 00 00 00 00 00 00 00 00 00 00 00 00 00 00 00 00 00 00 00 00 00 00 00 00 00 00 00 00 00
					29 01 00 00 00 00 27 C7 00 12 1F 31 40 4B 63 75 83 8F 42 4F 5E 74 7D 8A 99 A6 B4 00 12 1F 31 40 4B 63 75 83 8F 42 4F 5E 74 7D 8A 99 A6 B4
					29 01 00 00 00 00 38 C8 00 00 00 00 00 FC 00 00 00 00 00 FC 00 00 00 00 00 FC 00 00 00 00 00 FC 00 00 00 00 00 FC 00 00 00 00 00 FC 00 00 00 00 00 FC 00 00 00 00 00 FC 00 00 00 00 00 FC 00
					29 01 00 00 00 00 14 C9 00 00 00 00 00 FC 00 00 00 00 00 FC 00 00 00 00 00 FC 00
					29 01 00 00 00 00 2C CA 1C FC FC FC 00 00 00 00 00 00 00 00 00 00 00 00 00 00 00 00 00 00 00 00 00 00 00 00 00 00 00 00 00 00 00 00 00 00 00 00 00 00 00
					29 01 00 00 00 00 1C CB F0 FF FF FF 00 00 00 00 00 00 00 50 10 00 00 00 00 00 00 00 00 00 00 00 00 00 00
					29 01 00 00 00 00 03 CC 28 00
					29 01 00 00 00 00 27 CD 1D 00 22 00 22 00 5C 02 AE AE A0 A0 A0 A0 A0 A0 01 00 00 00 00 00 00 00 00 00 00 00 00 00 00 00 00 00 00 00 00 A2
					29 01 00 00 00 00 1A CE 5D 40 49 53 59 5E 63 68 6E 74 7E 8A 98 A8 BB D0 FF 04 00 04 04 42 00 69 5A
					29 01 00 00 00 00 03 CF 48 1D
					29 01 00 00 00 00 14 D0 33 59 CF 31 01 10 10 10 19 19 00 00 00 00 00 00 00 6D 65
					29 01 00 00 00 00 02 D1 00
					29 01 00 00 00 00 16 D3 1B 3B BB 77 77 77 BB B3 33 00 00 6E 65 DB DB 33 BB F2 FD C6 0B
					29 01 00 00 00 00 0B D5 03 00 00 02 49 02 49 01 00 00
					29 01 00 00 00 00 02 D6 C1
					29 01 00 00 00 00 22 D7 F6 FF 03 05 41 24 80 1F C7 1F 1B 00 0C 07 20 00 00 00 00 00 0C F0 1F 00 0C 00 00 AA 67 7E 1D 06 00
					29 01 00 00 00 00 08 D9 00 3E 14 3F 0F 77 02
					29 01 00 00 00 00 05 DD 30 06 23 65
					29 01 00 00 00 00 05 DE 00 33 FB 50
					29 01 00 00 00 00 02 EA 1F
					29 01 00 00 00 00 04 EE 41 51 00
					29 01 00 00 00 00 04 F1 00 00 00
					29 01 00 00 00 00 02 B0 03
					29 01 00 00 00 00 02 B0 00
					29 01 00 00 00 00 02 D6 01
					29 01 00 00 00 00 02 B0 03
					15 01 00 00 00 00 02 51 FF
					15 01 00 00 00 00 02 53 0C
					15 01 00 00 00 00 02 55 00
					05 01 00 00 C8 00 02 11 00
					05 01 00 00 14 00 02 29 00];
		qcom,mdss-dsi-off-command = [05 01 00 00 20 00 01 28
					05 01 00 00 78 00 01 10];
		qcom,mdss-dsi-on-command-state = "dsi_lp_mode";
		qcom,mdss-dsi-off-command-state = "dsi_hs_mode";
		qcom,mdss-dsi-h-sync-pulse = <1>;
		qcom,mdss-dsi-traffic-mode = "burst_mode";
		qcom,mdss-dsi-lane-map = "lane_map_0123";
		qcom,mdss-dsi-bllp-eof-power-mode;
		qcom,mdss-dsi-bllp-power-mode;
		qcom,mdss-dsi-lane-0-state;
		qcom,mdss-dsi-lane-1-state;
		qcom,mdss-dsi-lane-2-state;
		qcom,mdss-dsi-lane-3-state;
		qcom,mdss-dsi-te-pin-select = <1>;
		qcom,mdss-dsi-te-v-sync-rd-ptr-irq-line = <0x2c>;
		qcom,mdss-dsi-te-dcs-command = <1>;
		qcom,mdss-dsi-te-check-enable;
		qcom,mdss-dsi-te-using-te-pin;
		qcom,mdss-dsi-panel-timings = [E6 38 26 00 68 6E 2A 3C 2C 03 04 00];
		qcom,mdss-dsi-t-clk-post = <0x2C>;
		qcom,mdss-dsi-t-clk-pre = <0xF6>;
		qcom,mdss-dsi-bl-min-level = <30>;
		qcom,mdss-dsi-bl-max-level = <4095>;
		qcom,mdss-brightness-max-level = <4095>;
		qcom,mdss-dsi-dma-trigger = "trigger_sw";
		qcom,mdss-dsi-mdp-trigger = "none";
		qcom,mdss-dsi-bl-pmic-control-type = "bl_ctrl_wled";
		qcom,panel-column-inversion-mode-cmds = [29 01 00 00 00 00 02 B0 00
					29 01 00 00 00 00 19 C2 01 F7 80 12 68 08 0C 10 00 08 60 00 00 00 00 00 00 00 00 08 00 00 00 00];
		qcom,column-inversion-cmds-dsi-state = "dsi_lp_mode";
		qcom,mdss-dsi-lp11-init;
		qcom,mdss-dsi-tx-eot-append;
		qcom,mdss-dsi-rx-eot-ignore;
		qcom,mdss-pan-physical-width-dimension = <62>;
		qcom,mdss-pan-physical-height-dimension = <110>;
		huawei,delaytime-before-bl = <80>;
		huawei,long-read-flag = <1>;
		huawei,reg-read-expect-value = <0x1C>;
		huawei,reg-long-read-count = <3>;
		qcom,mdss-dsi-reset-sequence = <1 10>, <0 5>, <1 170>;

	};
};
