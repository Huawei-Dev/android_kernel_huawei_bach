/{
		huawei_fac_info {
		compatible = "huawei,hw_fac_info";
		fac,product_name = "TRT-L23";
		fac,hardware_ver = "HL1TRTM-L23";
		fac,software_ver = "TRT_L23_VD";
		fac,simcard_adapt = "support";
		status = "ok";
	};
};
