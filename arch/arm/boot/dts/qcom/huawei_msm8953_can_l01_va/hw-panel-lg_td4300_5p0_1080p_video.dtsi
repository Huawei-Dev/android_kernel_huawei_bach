/* Copyright (c) 2013, The Linux Foundation. All rights reserved.
 *
 * This program is free software; you can redistribute it and/or modify
 * it under the terms of the GNU General Public License version 2 and
 * only version 2 as published by the Free Software Foundation.
 *
 * This program is distributed in the hope that it will be useful,
 * but WITHOUT ANY WARRANTY; without even the implied warranty of
 * MERCHANTABILITY or FITNESS FOR A PARTICULAR PURPOSE.  See the
 * GNU General Public License for more details.
 */

/*---------------------------------------------------------------------------
 * This file is autogenerated file using gcdb parser. Please do not edit it.
 * Update input XML file to add a new entry or update variable in this file
 * VERSION = "1.0"
 *---------------------------------------------------------------------------*/
&mdss_mdp {
	dsi_lg_td4300_5p0_1080p_video: qcom,mdss_dsi_lg_td4300_5p0_1080p_video {
		qcom,mdss-dsi-panel-name = "LG_TD4300_1080P_VIDEO";
		qcom,cont-splash-enabled;
		qcom,mdss-dsi-panel-controller = <&mdss_dsi0>;
		qcom,panel-supply-entries = <&dsi_panel_pwr_supply>;
		qcom,mdss-dsi-panel-type = "dsi_video_mode";
		qcom,mdss-dsi-panel-destination = "display_1";
		qcom,mdss-dsi-panel-clockrate = <900000000>;
		qcom,mdss-dsi-panel-framerate = <60>;
		qcom,mdss-dsi-virtual-channel-id = <0>;
		qcom,mdss-dsi-stream = <0>;
		qcom,mdss-dsi-panel-width = <1080>;
		qcom,mdss-dsi-panel-height = <1920>;
		qcom,mdss-dsi-h-front-porch = <107>;
		qcom,mdss-dsi-h-back-porch = <50>;
		qcom,mdss-dsi-h-pulse-width = <2>;
		qcom,mdss-dsi-h-sync-skew = <0>;
		qcom,mdss-dsi-v-back-porch = <6>;
		qcom,mdss-dsi-v-front-porch = <10>;
		qcom,mdss-dsi-v-pulse-width = <2>;
		qcom,mdss-dsi-h-left-border = <0>;
		qcom,mdss-dsi-h-right-border = <0>;
		qcom,mdss-dsi-v-top-border = <0>;
		qcom,mdss-dsi-v-bottom-border = <0>;
		qcom,mdss-dsi-bpp = <24>;
		qcom,mdss-dsi-underflow-color = <0x00>;
		qcom,mdss-dsi-border-color = <0>;
		qcom,mdss-dsi-color-order = "rgb_swap_rgb";
		qcom,mdss-dsi-on-command = [23 01 00 00 00 00 02 B0 04
					29 01 00 00 00 00 04 B3 31 00 06
					29 01 00 00 00 00 02 B4 04
					29 01 00 00 00 00 06 B6 33 D3 80 FF FF
					29 01 00 00 00 00 2E C1 80 08 01 EF FF 4F A7 8C F7 98 a5 Fe 67 CD B9 C6 FE 57 CB 9C 2B 06 29 FF 7F 00 10 10 10 10 10 10 10 10 40 02 62 01 06 05 84 00 01 00 01
					29 01 00 00 00 00 11 C2 01 F7 80 0D 69 08 0C 10 00 08 60 00 00 00 00 00
					29 01 00 00 00 00 3F C3 78 77 87 78 70 00 00 00 00 00 3B 63 B6 3B 60 3F C3 FC 3F C0 01 01 03 28 00 01 00 01 11 01 13 00 13 00 13 00 13 00 13 00 13 00 13 00 13 00 13 00 2B 00 2B 00 2B 00 00 00 00 00 00 00 40 20
					29 01 00 00 00 00 11 C4 70 00 00 00 00 00 00 00 00 02 02 25 01 00 00 00
					29 01 00 00 00 00 17 C6 62 05 54 05 54 01 0E 01 02 01 02 01 02 01 02 01 02 08 15 06 7F FF
					29 01 00 00 00 00 1F C7 00 12 1B 27 37 44 4D 5A 3c 45 52 60 69 70 7A 00 12 1B 27 37 44 4D 5A 3c 45 52 60 69 70 7A
					29 01 00 00 00 00 14 C8 00 00 00 00 00 FC 00 00 00 00 00 FC 00 00 00 00 00 FC 00
					29 01 00 00 00 00 14 C9 00 00 00 00 00 FC 00 00 00 00 00 FC 00 00 00 00 00 FC 00
					29 01 00 00 00 00 12 CB F1 9F 9F FF 08 00 10 80 00 00 00 98 9F 01 00 00 40
					29 01 00 00 00 00 02 CC 1E
					29 01 00 00 00 00 14 CD 00 00 22 00 22 00 22 00 AC AC A0 A0 A0 A0 A0 A0 15 00 00
					29 01 00 00 00 00 12 D0 33 59 D9 31 01 10 10 10 19 19 00 00 00 00 00 00 00
					29 01 00 00 00 00 15 D3 1B 3B BB 77 77 77 BB B3 33 00 00 6D 6D D3 D3 33 BB F2 FD C6
					29 01 00 00 00 00 08 D5 03 00 00 00 34 00 34
					29 01 00 00 00 00 02 D6 01
					15 01 00 00 00 00 02 36 C0
					29 01 00 00 00 00 04 F3 02 00 B4
					29 01 00 00 00 00 2C CA 1D FC FC FC 00 00 00 E0 00 E0 E9 E9 00 E9 00 00 00 00 00 00 00 00 9F 6E 61 9F 66 5A 4D 9F 6E 61 9D 64 57 00 67 7E 38 FF 00 00 00
					05 01 00 00 64 00 02 11 00
					05 01 00 00 14 00 02 29 00];
		qcom,mdss-dsi-off-command = [05 01 00 00 20 00 02 28 00
					05 01 00 00 78 00 02 10 00];
		qcom,mdss-dsi-on-command-state = "dsi_lp_mode";
		qcom,mdss-dsi-off-command-state = "dsi_hs_mode";
		qcom,mdss-dsi-h-sync-pulse = <1>;
		qcom,mdss-dsi-traffic-mode = "burst_mode";
		qcom,mdss-dsi-lane-map = "lane_map_0123";
		qcom,mdss-dsi-bllp-eof-power-mode;
		qcom,mdss-dsi-bllp-power-mode;
		qcom,mdss-dsi-lane-0-state;
		qcom,mdss-dsi-lane-1-state;
		qcom,mdss-dsi-lane-2-state;
		qcom,mdss-dsi-lane-3-state;
		qcom,mdss-dsi-te-pin-select = <1>;
		qcom,mdss-dsi-te-v-sync-rd-ptr-irq-line = <0x2c>;
		qcom,mdss-dsi-te-dcs-command = <1>;
		qcom,mdss-dsi-te-check-enable;
		qcom,mdss-dsi-te-using-te-pin;
		qcom,mdss-dsi-panel-timings = [24 1f 08 09 05 03 04 a0
		24 1f 08 09 05 03 04 a0
		24 1f 08 09 05 03 04 a0
		24 1f 08 09 05 03 04 a0
		24 1b 08 09 05 03 04 a0];
		qcom,mdss-dsi-t-clk-post = <0x2C>;
		qcom,mdss-dsi-t-clk-pre = <0xF6>;
		qcom,mdss-dsi-bl-min-level = <33>;
		qcom,mdss-dsi-bl-max-level = <3750>;
		qcom,mdss-brightness-max-level = <3750>;
		qcom,mdss-dsi-dma-trigger = "trigger_sw";
		qcom,mdss-dsi-mdp-trigger = "none";
		qcom,mdss-dsi-bl-pmic-control-type = "bl_ctrl_wled";
		qcom,panel-dot-inversion-mode-cmds = [29 01 00 00 00 00 02 FF 24
					29 01 00 00 00 00 02 FB 01
					29 01 00 00 00 00 02 9B 00
					29 01 00 00 00 00 02 FF 10
					29 01 00 00 00 00 02 FB 01];
		qcom,panel-column-inversion-mode-cmds = [29 01 00 00 00 00 02 FF 24
					29 01 00 00 00 00 02 FB 01
					29 01 00 00 00 00 02 9B 0F
					29 01 00 00 00 00 02 FF 10
					29 01 00 00 00 00 02 FB 01];
		qcom,dot-inversion-cmds-dsi-state = "dsi_lp_mode";
		qcom,column-inversion-cmds-dsi-state = "dsi_lp_mode";
		qcom,panel-esd-check-enabled;
		qcom,panel-esd-read-commands = [06 01 00 01 05 00 02 0A 1C];
		qcom,panel-dsm-check-enabled;
		qcom,panel-dsm-read-commands = [06 01 00 01 05 00 02 05 00
                               06 01 00 01 05 00 02 0A 1C
                               06 01 00 01 05 00 02 0B C0
                               06 01 00 01 05 00 02 0C 77
                               06 01 00 01 05 00 02 0D 00
                               06 01 00 01 05 00 02 0E 00
                               06 01 00 01 05 00 02 0F 40];
		qcom,esd-read-cmds-state = "dsi_hs_mode";
		qcom,dsm-read-cmds-state = "dsi_hs_mode";
		qcom,mdss-dsi-lp11-init;
		qcom,mdss-dsi-tx-eot-append;
		qcom,mdss-dsi-rx-eot-ignore;
		qcom,mdss-pan-physical-width-dimension = <62>;
		qcom,mdss-pan-physical-height-dimension = <110>;
		huawei,delaytime-before-bl = <80>;
		huawei,long-read-flag = <1>;
		huawei,reg-read-expect-value = <0x1C>;
		huawei,reg-long-read-count = <3>;
		qcom,mdss-dsi-reset-sequence = <1 10>, <0 5>, <1 170>;

	};
};
