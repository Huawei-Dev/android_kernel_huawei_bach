/* Copyright (c) 2014-2016, The Linux Foundation. All rights reserved.
 *
 * This program is free software; you can redistribute it and/or modify
 * it under the terms of the GNU General Public License version 2 and
 * only version 2 as published by the Free Software Foundation.
 *
 * This program is distributed in the hope that it will be useful,
 * but WITHOUT ANY WARRANTY; without even the implied warranty of
 * MERCHANTABILITY or FITNESS FOR A PARTICULAR PURPOSE.  See the
 * GNU General Public License for more details.
 */

/{
       huawei_audio_info {
               compatible = "hw,hw_audio_info";
               product-identifier = "kobe";
               builtin-master-mic-exist;
               hand_held_master_mic_strategy;
               loud_speaker_master_mic_strategy;
               audio-ce-param-inside;
               voice-lvm-mode = "1";
               status = "ok";
       };
};

/* delete node for wsa spk config of qcom */
&i2c_2 {
        /delete-node/ wsa881x-i2c-codec@e;
        /delete-node/ wsa881x-i2c-codec@44;
        /delete-node/ wsa881x-i2c-codec@f;
        /delete-node/ wsa881x-i2c-codec@45;
};

&int_codec {
       /delete-property/ qcom,msm-micbias1-ext-cap;
       status = "ok";
      qcom,msm-mbhc-butt-threshold-cust = <87 87 120 120 210 215 425 450 460 460>;
      qcom,config_v_hs_max = <1600>;
       qcom,audio-routing =
               "RX_BIAS", "MCLK",
               "SPK_RX_BIAS", "MCLK",
               "INT_LDO_H", "MCLK",
               "MIC BIAS Internal1", "Handset Mic",
               "MIC BIAS Internal2", "Headset Mic",
               "AMIC1", "MIC BIAS Internal1",
               "AMIC2", "MIC BIAS Internal2";
};

