 / {
        huawei_wifi_info {
                  compatible = "huawei,hw_wifi_info";
                  status = "ok";
                  wifi,chiptype = "WIFI_QUALCOMM_WCN3615";
                  wifi,pubfile_id = "kob_l09";
                  wifi,fw_ver = "QCOM_WCN3615_2.0.2";
                  wifi,ini_type = "kobe";
        };
};
