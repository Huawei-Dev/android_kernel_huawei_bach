/{
		huawei_fac_info {
		compatible = "huawei,hw_fac_info";
		fac,product_name = "CPN-L09";
		fac,hardware_ver = "SH1CHOPINL09M";
		fac,software_ver = "CPN_L09_VA";
		fac,simcard_adapt = "support";
		status = "ok";
	};
};
