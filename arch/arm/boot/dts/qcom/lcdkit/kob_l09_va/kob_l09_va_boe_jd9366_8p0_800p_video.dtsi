/* Copyright (c) 2013, The Linux Foundation. All rights reserved.
 *
 * This program is free software; you can redistribute it and/or modify
 * it under the terms of the GNU General Public License version 2 and
 * only version 2 as published by the Free Software Foundation.
 *
 * This program is distributed in the hope that it will be useful,
 * but WITHOUT ANY WARRANTY; without even the implied warranty of
 * MERCHANTABILITY or FITNESS FOR A PARTICULAR PURPOSE.  See the
 * GNU General Public License for more details.
 */

/*-------------------------------------------------------------------------
 * This file is autogenerated file using gcdb parser. Please do not edit it.
 * Update input XML file to add a new entry or update variable in this file
 * VERSION = 1.1
 *-----------------------------------------------------------------------*/
/ {
	dsi_kob_l09_va_boe_jd9366_8p0_800p_video: lcdkit_kob_l09_va_boe_jd9366_8p0_800p_video {
		compatible = "boe_jd9366_8p0_800p_video";
		hw,lcdkit-panel-name = "BOE_JD9366 8P0 VIDEO TFT 800 x 1280";
		hw,lcdkit-panel-type = <0x1>;
		hw,lcdkit-panel-xres = <800>;
		hw,lcdkit-panel-yres = <1280>;
		hw,lcdkit-panel-width = <108>;
		hw,lcdkit-panel-height = <173>;
		hw,lcdkit-panel-on-command = [39 01 00 00 00 00 02 E0 00
					39 01 00 00 00 00 02 E1 93
					39 01 00 00 00 00 02 E2 65
					39 01 00 00 00 00 02 E3 F8
					39 01 00 00 00 00 02 80 03
					39 01 00 00 00 00 02 78 93
					39 01 00 00 00 00 02 79 66
					39 01 00 00 00 00 02 7A FF
					39 01 00 00 00 00 02 7B FF
					39 01 00 00 00 00 02 E0 01
					39 01 00 00 00 00 02 00 00
					39 01 00 00 00 00 02 01 A0
					39 01 00 00 00 00 02 03 00
					39 01 00 00 00 00 02 04 A0
					39 01 00 00 00 00 02 17 00
					39 01 00 00 00 00 02 18 B1
					39 01 00 00 00 00 02 19 01
					39 01 00 00 00 00 02 1A 00
					39 01 00 00 00 00 02 1B B1
					39 01 00 00 00 00 02 1C 01
					39 01 00 00 00 00 02 1F 3E
					39 01 00 00 00 00 02 20 28
					39 01 00 00 00 00 02 21 28
					39 01 00 00 00 00 02 22 0E
					39 01 00 00 00 00 02 37 19
					39 01 00 00 00 00 02 38 05
					39 01 00 00 00 00 02 39 08
					39 01 00 00 00 00 02 3A 12
					39 01 00 00 00 00 02 3C 78
					39 01 00 00 00 00 02 3D FF
					39 01 00 00 00 00 02 3E FF
					39 01 00 00 00 00 02 3F FF
					39 01 00 00 00 00 02 40 06
					39 01 00 00 00 00 02 41 A0
					39 01 00 00 00 00 02 43 08
					39 01 00 00 00 00 02 44 07
					39 01 00 00 00 00 02 45 40
					39 01 00 00 00 00 02 4B 04
					39 01 00 00 00 00 02 55 00
					39 01 00 00 00 00 02 56 01
					39 01 00 00 00 00 02 57 89
					39 01 00 00 00 00 02 58 0A
					39 01 00 00 00 00 02 59 0A
					39 01 00 00 00 00 02 5A 28
					39 01 00 00 00 00 02 5B 14
					39 01 00 00 00 00 02 5D 7C
					39 01 00 00 00 00 02 5E 66
					39 01 00 00 00 00 02 5F 57
					39 01 00 00 00 00 02 60 49
					39 01 00 00 00 00 02 61 46
					39 01 00 00 00 00 02 62 38
					39 01 00 00 00 00 02 63 3C
					39 01 00 00 00 00 02 64 25
					39 01 00 00 00 00 02 65 3E
					39 01 00 00 00 00 02 66 3B
					39 01 00 00 00 00 02 67 3A
					39 01 00 00 00 00 02 68 55
					39 01 00 00 00 00 02 69 40
					39 01 00 00 00 00 02 6A 47
					39 01 00 00 00 00 02 6B 38
					39 01 00 00 00 00 02 6C 31
					39 01 00 00 00 00 02 6D 22
					39 01 00 00 00 00 02 6E 11
					39 01 00 00 00 00 02 6F 00
					39 01 00 00 00 00 02 70 7C
					39 01 00 00 00 00 02 71 66
					39 01 00 00 00 00 02 72 57
					39 01 00 00 00 00 02 73 49
					39 01 00 00 00 00 02 74 46
					39 01 00 00 00 00 02 75 38
					39 01 00 00 00 00 02 76 3C
					39 01 00 00 00 00 02 77 25
					39 01 00 00 00 00 02 78 3E
					39 01 00 00 00 00 02 79 3B
					39 01 00 00 00 00 02 7A 3A
					39 01 00 00 00 00 02 7B 55
					39 01 00 00 00 00 02 7C 40
					39 01 00 00 00 00 02 7D 47
					39 01 00 00 00 00 02 7E 38
					39 01 00 00 00 00 02 7F 31
					39 01 00 00 00 00 02 80 22
					39 01 00 00 00 00 02 81 11
					39 01 00 00 00 00 02 82 00
					39 01 00 00 00 00 02 E0 02
					39 01 00 00 00 00 02 00 47
					39 01 00 00 00 00 02 01 47
					39 01 00 00 00 00 02 02 45
					39 01 00 00 00 00 02 03 45
					39 01 00 00 00 00 02 04 4B
					39 01 00 00 00 00 02 05 4B
					39 01 00 00 00 00 02 06 49
					39 01 00 00 00 00 02 07 49
					39 01 00 00 00 00 02 08 41
					39 01 00 00 00 00 02 09 1F
					39 01 00 00 00 00 02 0A 1F
					39 01 00 00 00 00 02 0B 1F
					39 01 00 00 00 00 02 0C 1F
					39 01 00 00 00 00 02 0D 1F
					39 01 00 00 00 00 02 0E 1F
					39 01 00 00 00 00 02 0F 43
					39 01 00 00 00 00 02 10 1F
					39 01 00 00 00 00 02 11 1F
					39 01 00 00 00 00 02 12 1F
					39 01 00 00 00 00 02 13 1F
					39 01 00 00 00 00 02 14 1F
					39 01 00 00 00 00 02 15 1F
					39 01 00 00 00 00 02 16 46
					39 01 00 00 00 00 02 17 46
					39 01 00 00 00 00 02 18 44
					39 01 00 00 00 00 02 19 44
					39 01 00 00 00 00 02 1A 4A
					39 01 00 00 00 00 02 1B 4A
					39 01 00 00 00 00 02 1C 48
					39 01 00 00 00 00 02 1D 48
					39 01 00 00 00 00 02 1E 40
					39 01 00 00 00 00 02 1F 1F
					39 01 00 00 00 00 02 20 1F
					39 01 00 00 00 00 02 21 1F
					39 01 00 00 00 00 02 22 1F
					39 01 00 00 00 00 02 23 1F
					39 01 00 00 00 00 02 24 1F
					39 01 00 00 00 00 02 25 42
					39 01 00 00 00 00 02 26 1F
					39 01 00 00 00 00 02 27 1F
					39 01 00 00 00 00 02 28 1F
					39 01 00 00 00 00 02 29 1F
					39 01 00 00 00 00 02 2A 1F
					39 01 00 00 00 00 02 2B 1F
					39 01 00 00 00 00 02 2C 11
					39 01 00 00 00 00 02 2D 0F
					39 01 00 00 00 00 02 2E 0D
					39 01 00 00 00 00 02 2F 0B
					39 01 00 00 00 00 02 30 09
					39 01 00 00 00 00 02 31 07
					39 01 00 00 00 00 02 32 05
					39 01 00 00 00 00 02 33 18
					39 01 00 00 00 00 02 34 17
					39 01 00 00 00 00 02 35 1F
					39 01 00 00 00 00 02 36 01
					39 01 00 00 00 00 02 37 1F
					39 01 00 00 00 00 02 38 1F
					39 01 00 00 00 00 02 39 1F
					39 01 00 00 00 00 02 3A 1F
					39 01 00 00 00 00 02 3B 1F
					39 01 00 00 00 00 02 3C 1F
					39 01 00 00 00 00 02 3D 1F
					39 01 00 00 00 00 02 3E 1F
					39 01 00 00 00 00 02 3F 13
					39 01 00 00 00 00 02 40 1F
					39 01 00 00 00 00 02 41 1F
					39 01 00 00 00 00 02 42 10
					39 01 00 00 00 00 02 43 0E
					39 01 00 00 00 00 02 44 0C
					39 01 00 00 00 00 02 45 0A
					39 01 00 00 00 00 02 46 08
					39 01 00 00 00 00 02 47 06
					39 01 00 00 00 00 02 48 04
					39 01 00 00 00 00 02 49 18
					39 01 00 00 00 00 02 4A 17
					39 01 00 00 00 00 02 4B 1F
					39 01 00 00 00 00 02 4C 00
					39 01 00 00 00 00 02 4D 1F
					39 01 00 00 00 00 02 4E 1F
					39 01 00 00 00 00 02 4F 1F
					39 01 00 00 00 00 02 50 1F
					39 01 00 00 00 00 02 51 1F
					39 01 00 00 00 00 02 52 1F
					39 01 00 00 00 00 02 53 1F
					39 01 00 00 00 00 02 54 1F
					39 01 00 00 00 00 02 55 12
					39 01 00 00 00 00 02 56 1F
					39 01 00 00 00 00 02 57 1F
					39 01 00 00 00 00 02 58 40
					39 01 00 00 00 00 02 5B 30
					39 01 00 00 00 00 02 5C 02
					39 01 00 00 00 00 02 5D 40
					39 01 00 00 00 00 02 5E 01
					39 01 00 00 00 00 02 5F 02
					39 01 00 00 00 00 02 63 62
					39 01 00 00 00 00 02 64 62
					39 01 00 00 00 00 02 67 74
					39 01 00 00 00 00 02 68 04
					39 01 00 00 00 00 02 69 62
					39 01 00 00 00 00 02 6A 66
					39 01 00 00 00 00 02 6B 08
					39 01 00 00 00 00 02 6C 00
					39 01 00 00 00 00 02 6D 00
					39 01 00 00 00 00 02 6E 00
					39 01 00 00 00 00 02 6F 08
					39 01 00 00 00 00 02 E0 03
					39 01 00 00 00 00 02 AF 20
					39 01 00 00 00 00 02 98 3E
					39 01 00 00 00 00 02 E0 04
					39 01 00 00 00 00 02 09 14
					39 01 00 00 00 00 02 41 FF
					39 01 00 00 00 00 02 4B FF
					39 01 00 00 00 00 02 2B 2B
					39 01 00 00 00 00 02 2E 44
					39 01 00 00 00 00 02 E0 00
					39 01 00 00 00 00 02 E6 02
					39 01 00 00 00 00 02 E7 06
					39 01 00 00 00 00 02 E0 03
					39 01 00 00 00 00 02 9B 04
					39 01 00 00 00 00 02 E0 00
					39 01 00 00 00 00 02 55 01
					39 01 00 00 00 00 02 53 24
					39 01 00 00 78 00 02 11 00
					39 01 00 00 20 00 02 29 00
					39 01 00 00 00 00 02 E0 03
					39 01 00 00 00 00 02 AB 0E
					39 01 00 00 00 00 02 E0 00];
		hw,lcdkit-panel-on-command-state = "dsi_lp_mode";
		hw,lcdkit-panel-display-on-command = [05 01 00 00 64 00 02 29 00];
		hw,lcdkit-panel-off-command = [39 01 00 00 20 00 02 28 00
					39 01 00 00 78 00 02 10 00];
		hw,lcdkit-panel-off-command-state = "dsi_lp_mode";
		hw,lcdkit-panel-backlight-command = [39 01 00 00 00 00 02 51 00];
		hw,lcdkit-panel-backlight-command-state = "dsi_lp_mode";
		hw,lcdkit-panel-cabc-off-command = [39 01 00 00 0a 00 02 55 00];
		hw,lcdkit-panel-cabc-off-command-state = "dsi_lp_mode";
		hw,lcdkit-panel-cabc-ui-command = [39 01 00 00 0a 00 02 55 01
					39 01 00 00 0a 00 02 53 24
					39 01 00 00 00 00 02 E0 03
					39 01 00 00 00 00 02 AB 0E
					39 01 00 00 00 00 02 E0 00];
		hw,lcdkit-panel-cabc-ui-command-state = "dsi_lp_mode";
		hw,lcdkit-panel-cabc-still-command = [39 01 00 00 0a 00 02 55 02
					39 01 00 00 0a 00 02 53 24
					39 01 00 00 00 00 02 E0 03
					39 01 00 00 00 00 02 AB 0E
					39 01 00 00 00 00 02 AC 66
					39 01 00 00 00 00 02 E0 00];
		hw,lcdkit-panel-cabc-still-command-state = "dsi_lp_mode";
		hw,lcdkit-panel-cabc-moving-command = [39 01 00 00 0a 00 02 55 03
					39 01 00 00 0a 00 02 53 24
					39 01 00 00 00 00 02 E0 03
					39 01 00 00 00 00 02 AC 66
					39 01 00 00 00 00 02 E0 00];
		hw,lcdkit-panel-cabc-moving-command-state = "dsi_lp_mode";
		hw,lcdkit-panel-cabc-support = <1>;
		hw,lcdkit-panel-inversion-support = <0>;
		hw,lcdkit-panel-forword-scan-command = [39 01 00 00 00 00 02 E0 01
					39 01 00 00 00 00 02 37 19
					39 01 00 00 00 00 02 E0 00];
		hw,lcdkit-panel-forword-scan-command-state = "dsi_lp_mode";
		hw,lcdkit-panel-revert-scan-command = [39 01 00 00 00 00 02 E0 01
					39 01 00 00 00 00 02 37 1d
					39 01 00 00 00 00 02 E0 00];
		hw,lcdkit-panel-revert-scan-command-state = "dsi_lp_mode";
		hw,lcdkit-panel-scan-support = <0>;
		hw,lcdkit-panel-display-region-command = [];
		hw,lcdkit-panel-display-region-command-state = "dsi_lp_mode";
		hw,lcdkit-panel-display-region-support = <0>;
		hw,lcdkit-panel-checksum-support = <0>;
		hw,lcdkit-panel-esd-reg-command = [06 01 00 00 05 00 01 0a];
		hw,lcdkit-panel-esd-reg-command-state = "dsi_lp_mode";
		hw,lcdkit-panel-esd-value = [9c];
		hw,lcdkit-panel-esd-support = <0>;
		hw,lcdkit-panel-check-reg-command = [06 01 00 00 0a 00 01 0a];
		hw,lcdkit-panel-check-reg-value = [9c];
		hw,lcdkit-panel-check-reg-command-state = "dsi_lp_mode";
		hw,lcdkit-panel-check-reg-support = <0>;
		hw,lcdkit-panel-mipi-detect-command = [];
		hw,lcdkit-panel-mipi-detect-value = [];
		hw,lcdkit-panel-mipi-detect-mask = [];
		hw,lcdkit-panel-mipi-detect-command-state = "dsi_lp_mode";
		hw,lcdkit-panel-mipi-detect-support = <0>;
		hw,lcdkit-panel-shutdown-sleep-support = <0>;
		hw,lcdkit-dsi-bpp = <24>;
		hw,lcdkit-panel-cmd-type = <0>;
		hw,lcdkit-pixel-packing = <0>;
		hw,lcdkit-underflow-color = <0x00>;
		hw,lcdkit-border-color = <0>;
		hw,lcdkit-panel-orientation = <0>;
		hw,lcdkit-brightness-max-level = <2047>;
		hw,lcdkit-bl-min-level = <20>;
		hw,lcdkit-bl-max-level = <2047>;
		hw,lcdkit-interleave-mode = <0>;
		hw,lcdkit-te-using-te-pin;
		hw,lcdkit-h-sync-pulse = <1>;
		hw,lcdkit-bllp-power-mode;
		hw,lcdkit-bllp-eof-power-mode;
		hw,lcdkit-traffic-mode = "burst_mode";
		hw,lcdkit-te-dcs-command = <1>;
		hw,lcdkit-te-pin-select = <1>;
		hw,lcdkit-virtual-channel-id = <0>;
		hw,lcdkit-color-order = "rgb_swap_rgb";
		hw,lcdkit-lane-0-state;
		hw,lcdkit-lane-1-state;
		hw,lcdkit-lane-2-state;
		hw,lcdkit-lane-3-state;
		hw,lcdkit-h-left-border = <0>;
		hw,lcdkit-h-right-border = <0>;
		hw,lcdkit-v-top-border = <0>;
		hw,lcdkit-v-bottom-border = <0>;
		hw,lcdkit-panel-framerate = <60>;
		hw,lcdkit-panel-clockrate = <406840000>;
		hw,lcdkit-panel-timings = [7B 1A 10 00 3C 40 14 1C 15 03 04 00];
		hw,lcdkit-t-clk-pre = <0x1A>;
		hw,lcdkit-t-clk-post = <0x04>;
		hw,lcdkit-tx-eot-append;
		hw,lcdkit-stream = <0>;
		hw,lcdkit-lp11-init;
		hw,lcdkit-mdp-trigger = "none";
		hw,lcdkit-dma-trigger = "trigger_sw";
		hw,lcdkit-bl-pmic-control-type = "bl_ctrl_ic_ti";
		qcom,panel-supply-entries = <&dsi_panel_pwr_supply>;
		hw,lcdkit-lane-map = "lane_map_0123";
		hw,lcdkit-delay-before-bl = <0>;
		hw,lcdkit-mipi-regulator-mode = <0>;
		hw,lcdkit-bl-en-gpio = <93>;
		hw,lcdkit-bl-chip-init = <36923>;
		hw,lcdkit-delay-af-rst-off = <120>;
		hw,lcdkit-delay-af-blic-init = <0>;
		hw,lcdkit-bl-level-limit-percent = <88>;
		hw,lcdkit-use-second-ic-for-esd = <0>;
		hw,lcdkit-esd-check-num = <3>;
		hw,lcdkit-h-back-porch = <20>;
		hw,lcdkit-h-front-porch = <32>;
		hw,lcdkit-h-pulse-width = <20>;
		hw,lcdkit-v-back-porch = <4>;
		hw,lcdkit-v-pulse-width = <4>;
		hw,lcdkit-v-front-porch = <8>;
		hw,lcdkit-h-sync-skew = <0>;
		hw,lcdkit-lcd-type = <1>;
		hw,lcdkit-panel-pt-test-support = <1>;
		hw,lcdkit-bias-power-ctrl-mode = <0x0>;
		hw,lcdkit-iovcc-power-ctrl-mode = <0x02>;
		hw,lcdkit-vci-power-ctrl-mode = <0x01>;
		hw,lcdkit-id0-gpio = <59>;
		hw,lcdkit-id1-gpio = <48>;
		hw,lcdkit-reset-gpio = <60>;
		hw,lcdkit-te-gpio = <0>;
		hw,lcdkit-vsp-gpio = <0>;
		hw,lcdkit-vsn-gpio = <0>;
		hw,lcdkit-iovcc-gpio = <8>;
		hw,lcdkit-vci-gpio = <0>;
		hw,lcdkit-bl-gpio = <45>;
		hw,lcdkit-iovcc-on-is-need-reset = <0x1>;
		hw,lcdkit-vsn-on-is-need-reset = <0>;
		hw,lcdkit-lcd-vsp = <5500000>;
		hw,lcdkit-lcd-vsn = <5500000>;
		hw,lcdkit-lcd-rst-first-high = <15>;
		hw,lcdkit-lcd-rst-low = <10>;
		hw,lcdkit-lcd-rst-second-high = <20>;
		hw,lcdkit-delay-af-vci-on = <6>;
		hw,lcdkit-delay-af-iovcc-on = <6>;
		hw,lcdkit-delay-af-bias-on = <0>;
		hw,lcdkit-delay-af-vsp-on = <0>;
		hw,lcdkit-delay-af-vsn-on = <3>;
		hw,lcdkit-delay-af-lp11 = <0>;
		hw,lcdkit-delay-af-tp-reset = <25>;
		hw,lcdkit-delay-af-vsn-off = <3>;
		hw,lcdkit-delay-af-vsp-off = <0>;
		hw,lcdkit-delay-af-bias-off = <0>;
		hw,lcdkit-delay-af-iovcc-off = <0>;
		hw,lcdkit-delay-af-vci-off = <0>;
		hw,lcdkit-panel-off-reset-high = <0>;
    };
};