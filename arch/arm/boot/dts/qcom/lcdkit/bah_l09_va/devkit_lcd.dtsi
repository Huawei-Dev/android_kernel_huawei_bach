/*---------------------------------------------------------------------------
 * This file is autogenerated file using huawei LCD parser. Please do not edit it.
 * Update input XML file to add a new entry or update variable in this file
 * Parser location: vendor/huawei/chipset_common/devkit/lcdkit/tools 
 *---------------------------------------------------------------------------*/


#include "bah_l09_va_boe_nt51021_10p1_1200p_video.dtsi"
#include "bah_l09_va_inx_nt51021_10p1_1200p_video.dtsi"