/* Copyright (c) 2013, The Linux Foundation. All rights reserved.
 *
 * This program is free software; you can redistribute it and/or modify
 * it under the terms of the GNU General Public License version 2 and
 * only version 2 as published by the Free Software Foundation.
 *
 * This program is distributed in the hope that it will be useful,
 * but WITHOUT ANY WARRANTY; without even the implied warranty of
 * MERCHANTABILITY or FITNESS FOR A PARTICULAR PURPOSE.  See the
 * GNU General Public License for more details.
 */

/*-------------------------------------------------------------------------
 * This file is autogenerated file using gcdb parser. Please do not edit it.
 * Update input XML file to add a new entry or update variable in this file
 * VERSION = 1.1
 *-----------------------------------------------------------------------*/
/ {
	dsi_cpn_l03_va_inx_nt51021_8p0_1200p_video: lcdkit_cpn_l03_va_inx_nt51021_8p0_1200p_video {
		compatible = "inx_nt51021_8p0_1200p_video";
		hw,lcdkit-panel-name = "INX_NT51021 8P0 VIDEO TFT 1200 x 1920";
		hw,lcdkit-panel-type = <0x1>;
		hw,lcdkit-panel-xres = <1200>;
		hw,lcdkit-panel-yres = <1920>;
		hw,lcdkit-panel-width = <108>;
		hw,lcdkit-panel-height = <173>;
		hw,lcdkit-panel-on-command = [15 01 00 00 06 00 02 8F A5
				15 01 00 00 18 00 02 01 00
				15 01 00 00 00 00 02 8F A5
				15 01 00 00 00 00 02 83 BB
				15 01 00 00 00 00 02 84 22
				15 01 00 00 00 00 02 A1 FF
				15 01 00 00 00 00 02 A2 F9
				15 01 00 00 00 00 02 A3 F2
				15 01 00 00 00 00 02 A4 ED
				15 01 00 00 00 00 02 A5 E8
				15 01 00 00 00 00 02 A6 E1
				15 01 00 00 00 00 02 A7 DE
				15 01 00 00 00 00 02 A8 DA
				15 01 00 00 00 00 02 A9 D3
				15 01 00 00 00 00 02 AA CF
				15 01 00 00 00 00 02 B4 20
				15 01 00 00 00 00 02 B5 32
				15 01 00 00 00 00 02 B6 29
				15 01 00 00 00 00 02 AD 06
				15 01 00 00 00 00 02 9A 10
				15 01 00 00 00 00 02 94 B8
				15 01 00 00 00 00 02 95 00
				15 01 00 00 00 00 02 9A 10
				15 01 00 00 00 00 02 96 00
				15 01 00 00 00 00 02 90 00
				15 01 00 00 00 00 02 83 AA
				15 01 00 00 00 00 02 84 11
				15 01 00 00 00 00 02 A9 4B
				15 01 00 00 00 00 02 83 00
				15 01 00 00 00 00 02 84 00
				15 01 00 00 00 00 02 8C 04
				15 01 00 00 00 00 02 FD 53
				15 01 00 00 00 00 02 FA 0E
				15 01 00 00 00 00 02 83 AA
				15 01 00 00 00 00 02 84 11
				15 01 00 00 00 00 02 C0 00
				15 01 00 00 00 00 02 C1 01
				15 01 00 00 00 00 02 C2 0B
				15 01 00 00 00 00 02 C3 17
				15 01 00 00 00 00 02 C4 22
				15 01 00 00 00 00 02 C5 2A
				15 01 00 00 00 00 02 C6 32
				15 01 00 00 00 00 02 C7 38
				15 01 00 00 00 00 02 C8 3E
				15 01 00 00 00 00 02 C9 8D
				15 01 00 00 00 00 02 CA 8D
				15 01 00 00 00 00 02 CB A0
				15 01 00 00 00 00 02 CC AF
				15 01 00 00 00 00 02 CD B3
				15 01 00 00 00 00 02 CE AC
				15 01 00 00 00 00 02 CF AF
				15 01 00 00 00 00 02 D0 AD
				15 01 00 00 00 00 02 D1 B1
				15 01 00 00 00 00 02 D2 BB
				15 01 00 00 00 00 02 D3 CF
				15 01 00 00 00 00 02 D4 CF
				15 01 00 00 00 00 02 D5 6B
				15 01 00 00 00 00 02 D6 70
				15 01 00 00 00 00 02 D7 73
				15 01 00 00 00 00 02 D8 7C
				15 01 00 00 00 00 02 D9 80
				15 01 00 00 00 00 02 DA 89
				15 01 00 00 00 00 02 DB 95
				15 01 00 00 00 00 02 DC B3
				15 01 00 00 00 00 02 DD B4
				15 01 00 00 00 00 02 DE 00
				15 01 00 00 00 00 02 DF 20
				15 01 00 00 00 00 02 E0 39
				15 01 00 00 00 00 02 E1 3A
				15 01 00 00 00 00 02 E2 44
				15 01 00 00 00 00 02 E3 4E
				15 01 00 00 00 00 02 E4 5B
				15 01 00 00 00 00 02 E5 65
				15 01 00 00 00 00 02 E6 6B
				15 01 00 00 00 00 02 E7 71
				15 01 00 00 00 00 02 E8 77
				15 01 00 00 00 00 02 E9 D7
				15 01 00 00 00 00 02 EA D4
				15 01 00 00 00 00 02 EB EB
				15 01 00 00 00 00 02 EC FC
				15 01 00 00 00 00 02 ED FF
				15 01 00 00 00 00 02 EE F9
				15 01 00 00 00 00 02 EF FB
				15 01 00 00 00 00 02 F0 F9
				15 01 00 00 00 00 02 F1 FD
				15 01 00 00 00 00 02 F2 06
				15 01 00 00 00 00 02 F3 1C
				15 01 00 00 00 00 02 F4 1B
				15 01 00 00 00 00 02 F5 91
				15 01 00 00 00 00 02 F6 96
				15 01 00 00 00 00 02 F7 99
				15 01 00 00 00 00 02 F8 A2
				15 01 00 00 00 00 02 F9 A7
				15 01 00 00 00 00 02 FA AD
				15 01 00 00 00 00 02 FB B1
				15 01 00 00 00 00 02 FC B3
				15 01 00 00 00 00 02 FD B4
				15 01 00 00 00 00 02 FE 00
				15 01 00 00 00 00 02 FF 2E
				15 01 00 00 00 00 02 83 BB
				15 01 00 00 00 00 02 84 22
				15 01 00 00 00 00 02 C0 00
				15 01 00 00 00 00 02 C1 01
				15 01 00 00 00 00 02 C2 0B
				15 01 00 00 00 00 02 C3 17
				15 01 00 00 00 00 02 C4 22
				15 01 00 00 00 00 02 C5 2A
				15 01 00 00 00 00 02 C6 32
				15 01 00 00 00 00 02 C7 38
				15 01 00 00 00 00 02 C8 3E
				15 01 00 00 00 00 02 C9 8D
				15 01 00 00 00 00 02 CA 90
				15 01 00 00 00 00 02 CB A3
				15 01 00 00 00 00 02 CC B2
				15 01 00 00 00 00 02 CD B6
				15 01 00 00 00 00 02 CE B2
				15 01 00 00 00 00 02 CF B5
				15 01 00 00 00 00 02 D0 B3
				15 01 00 00 00 00 02 D1 BF
				15 01 00 00 00 00 02 D2 CE
				15 01 00 00 00 00 02 D3 E7
				15 01 00 00 00 00 02 D4 EC
				15 01 00 00 00 00 02 D5 7C
				15 01 00 00 00 00 02 D6 82
				15 01 00 00 00 00 02 D7 88
				15 01 00 00 00 00 02 D8 90
				15 01 00 00 00 00 02 D9 98
				15 01 00 00 00 00 02 DA 9F
				15 01 00 00 00 00 02 DB AA
				15 01 00 00 00 00 02 DC C7
				15 01 00 00 00 00 02 DD CA
				15 01 00 00 00 00 02 DE 00
				15 01 00 00 00 00 02 DF 20
				15 01 00 00 00 00 02 E0 39
				15 01 00 00 00 00 02 E1 3A
				15 01 00 00 00 00 02 E2 44
				15 01 00 00 00 00 02 E3 4E
				15 01 00 00 00 00 02 E4 5B
				15 01 00 00 00 00 02 E5 65
				15 01 00 00 00 00 02 E6 6B
				15 01 00 00 00 00 02 E7 71
				15 01 00 00 00 00 02 E8 77
				15 01 00 00 00 00 02 E9 D7
				15 01 00 00 00 00 02 EA D7
				15 01 00 00 00 00 02 EB EE
				15 01 00 00 00 00 02 EC FF
				15 01 00 00 00 00 02 ED 02
				15 01 00 00 00 00 02 EE FF
				15 01 00 00 00 00 02 EF 01
				15 01 00 00 00 00 02 F0 FF
				15 01 00 00 00 00 02 F1 0B
				15 01 00 00 00 00 02 F2 19
				15 01 00 00 00 00 02 F3 34
				15 01 00 00 00 00 02 F4 38
				15 01 00 00 00 00 02 F5 A2
				15 01 00 00 00 00 02 F6 A8
				15 01 00 00 00 00 02 F7 AE
				15 01 00 00 00 00 02 F8 B6
				15 01 00 00 00 00 02 F9 BF
				15 01 00 00 00 00 02 FA C4
				15 01 00 00 00 00 02 FB C7
				15 01 00 00 00 00 02 FC C7
				15 01 00 00 00 00 02 FD CA
				15 01 00 00 00 00 02 FE 50
				15 01 00 00 00 00 02 FF 2F
				15 01 00 00 00 00 02 83 CC
				15 01 00 00 00 00 02 84 33
				15 01 00 00 00 00 02 C0 00
				15 01 00 00 00 00 02 C1 01
				15 01 00 00 00 00 02 C2 0B
				15 01 00 00 00 00 02 C3 17
				15 01 00 00 00 00 02 C4 22
				15 01 00 00 00 00 02 C5 2A
				15 01 00 00 00 00 02 C6 32
				15 01 00 00 00 00 02 C7 38
				15 01 00 00 00 00 02 C8 3E
				15 01 00 00 00 00 02 C9 8D
				15 01 00 00 00 00 02 CA 90
				15 01 00 00 00 00 02 CB A5
				15 01 00 00 00 00 02 CC B4
				15 01 00 00 00 00 02 CD BB
				15 01 00 00 00 00 02 CE B8
				15 01 00 00 00 00 02 CF BB
				15 01 00 00 00 00 02 D0 BD
				15 01 00 00 00 00 02 D1 CC
				15 01 00 00 00 00 02 D2 DF
				15 01 00 00 00 00 02 D3 FE
				15 01 00 00 00 00 02 D4 08
				15 01 00 00 00 00 02 D5 90
				15 01 00 00 00 00 02 D6 97
				15 01 00 00 00 00 02 D7 9E
				15 01 00 00 00 00 02 D8 A8
				15 01 00 00 00 00 02 D9 B1
				15 01 00 00 00 00 02 DA BC
				15 01 00 00 00 00 02 DB D8
				15 01 00 00 00 00 02 DC EF
				15 01 00 00 00 00 02 DD FF
				15 01 00 00 00 00 02 DE 00
				15 01 00 00 00 00 02 DF 28
				15 01 00 00 00 00 02 E0 39
				15 01 00 00 00 00 02 E1 3A
				15 01 00 00 00 00 02 E2 44
				15 01 00 00 00 00 02 E3 4E
				15 01 00 00 00 00 02 E4 5B
				15 01 00 00 00 00 02 E5 65
				15 01 00 00 00 00 02 E6 6B
				15 01 00 00 00 00 02 E7 71
				15 01 00 00 00 00 02 E8 77
				15 01 00 00 00 00 02 E9 D7
				15 01 00 00 00 00 02 EA D7
				15 01 00 00 00 00 02 EB F0
				15 01 00 00 00 00 02 EC 02
				15 01 00 00 00 00 02 ED 07
				15 01 00 00 00 00 02 EE 05
				15 01 00 00 00 00 02 EF 07
				15 01 00 00 00 00 02 F0 09
				15 01 00 00 00 00 02 F1 18
				15 01 00 00 00 00 02 F2 2A
				15 01 00 00 00 00 02 F3 4B
				15 01 00 00 00 00 02 F4 54
				15 01 00 00 00 00 02 F5 B6
				15 01 00 00 00 00 02 F6 BD
				15 01 00 00 00 00 02 F7 C4
				15 01 00 00 00 00 02 F8 CE
				15 01 00 00 00 00 02 F9 D8
				15 01 00 00 00 00 02 FA E1
				15 01 00 00 00 00 02 FB ED
				15 01 00 00 00 00 02 FC EF
				15 01 00 00 00 00 02 FD FF
				15 01 00 00 00 00 02 FE F8
				15 01 00 00 00 00 02 FF 2F
				15 01 00 00 00 00 02 83 00
				15 01 00 00 00 00 02 84 00
				05 01 00 00 05 00 02 11 00];
		hw,lcdkit-panel-on-command-state = "dsi_lp_mode";
		hw,lcdkit-panel-off-command = [15 01 00 00 05 00 02 10 00];
		hw,lcdkit-panel-off-command-state = "dsi_hs_mode";
		hw,lcdkit-panel-backlight-command = [23 01 00 00 00 00 02 9F 00];
		hw,lcdkit-panel-backlight-command-state = "dsi_lp_mode";
		hw,lcdkit-panel-cabc-off-command = [23 01 00 00 00 00 02 83 BB
				23 01 00 00 00 00 02 84 22
				23 01 00 00 00 00 02 90 C0];
		hw,lcdkit-panel-cabc-off-command-state = "dsi_hs_mode";
		hw,lcdkit-panel-cabc-ui-command = [23 01 00 00 00 00 02 83 BB
				23 01 00 00 00 00 02 84 22
				23 01 00 00 00 00 02 A1 FF
				23 01 00 00 00 00 02 A2 F9
				23 01 00 00 00 00 02 A3 F2
				23 01 00 00 00 00 02 A4 ED
				23 01 00 00 00 00 02 A5 E8
				23 01 00 00 00 00 02 A6 E1
				23 01 00 00 00 00 02 A7 DE
				23 01 00 00 00 00 02 A8 DA
				23 01 00 00 00 00 02 A9 D3
				23 01 00 00 00 00 02 AA CF
				23 01 00 00 00 00 02 B4 20
				23 01 00 00 00 00 02 B5 32
				23 01 00 00 00 00 02 B6 29
				23 01 00 00 00 00 02 AD 06
				23 01 00 00 00 00 02 9A 10
				23 01 00 00 00 00 02 94 B8
				23 01 00 00 00 00 02 95 00
				23 01 00 00 00 00 02 9A 10
				23 01 00 00 00 00 02 96 00
				23 01 00 00 00 00 02 90 00];
		hw,lcdkit-panel-cabc-ui-command-state = "dsi_hs_mode";
		hw,lcdkit-panel-cabc-still-command = [23 01 00 00 00 00 02 83 BB
				23 01 00 00 00 00 02 84 22
				23 01 00 00 00 00 02 A1 FF
				23 01 00 00 00 00 02 A2 FE
				23 01 00 00 00 00 02 A3 FA
				23 01 00 00 00 00 02 A4 F7
				23 01 00 00 00 00 02 A5 F3
				23 01 00 00 00 00 02 A6 F1
				23 01 00 00 00 00 02 A7 EE
				23 01 00 00 00 00 02 A8 EC
				23 01 00 00 00 00 02 A9 EB
				23 01 00 00 00 00 02 AA E6
				23 01 00 00 00 00 02 B4 0D
				23 01 00 00 00 00 02 B5 1A
				23 01 00 00 00 00 02 B6 16
				23 01 00 00 00 00 02 9A 10
				23 01 00 00 00 00 02 9B 00
				23 01 00 00 00 00 02 99 00
				23 01 00 00 00 00 02 96 00
				23 01 00 00 00 00 02 AF 12
				23 01 00 00 00 00 02 B0 36
				23 01 00 00 00 00 02 B1 56
				23 01 00 00 00 00 02 B2 67
				23 01 00 00 00 00 02 B3 6A
				23 01 00 00 00 00 02 96 00
				23 01 00 00 00 00 02 90 40];
		hw,lcdkit-panel-cabc-still-command-state = "dsi_hs_mode";
		hw,lcdkit-panel-cabc-moving-command = [23 01 00 00 00 00 02 83 BB
				23 01 00 00 00 00 02 84 22
				23 01 00 00 00 00 02 A1 FF
				23 01 00 00 00 00 02 A2 F9
				23 01 00 00 00 00 02 A3 F2
				23 01 00 00 00 00 02 A4 ED
				23 01 00 00 00 00 02 A5 E8
				23 01 00 00 00 00 02 A6 E1
				23 01 00 00 00 00 02 A7 DE
				23 01 00 00 00 00 02 A8 DA
				23 01 00 00 00 00 02 A9 D3
				23 01 00 00 00 00 02 AA CF
				23 01 00 00 00 00 02 B4 20
				23 01 00 00 00 00 02 B5 32
				23 01 00 00 00 00 02 B6 29
				23 01 00 00 00 00 02 AD 06
				23 01 00 00 00 00 02 9A 10
				23 01 00 00 00 00 02 94 B8
				23 01 00 00 00 00 02 95 00
				23 01 00 00 00 00 02 9A 10
				23 01 00 00 00 00 02 96 00
				23 01 00 00 00 00 02 90 00];
		hw,lcdkit-panel-cabc-moving-command-state = "dsi_hs_mode";
		hw,lcdkit-panel-cabc-support = <1>;
		hw,lcdkit-panel-inversion-support = <0>;
		hw,lcdkit-panel-scan-support = <0>;
		hw,lcdkit-panel-display-region-command = [];
		hw,lcdkit-panel-display-region-command-state = "dsi_lp_mode";
		hw,lcdkit-panel-display-region-support = <0>;
		hw,lcdkit-panel-checksum-support = <0>;
		hw,lcdkit-panel-esd-support = <0>;
		hw,lcdkit-panel-check-reg-support = <0>;
		hw,lcdkit-panel-mipi-detect-command = [];
		hw,lcdkit-panel-mipi-detect-value = [];
		hw,lcdkit-panel-mipi-detect-mask = [];
		hw,lcdkit-panel-mipi-detect-command-state = "dsi_lp_mode";
		hw,lcdkit-panel-mipi-detect-support = <0>;
		hw,lcdkit-panel-shutdown-sleep-support = <0>;
		hw,lcdkit-dsi-bpp = <24>;
		hw,lcdkit-panel-cmd-type = <0>;
		hw,lcdkit-pixel-packing = <0>;
		hw,lcdkit-underflow-color = <0x00>;
		hw,lcdkit-border-color = <0>;
		hw,lcdkit-panel-orientation = <0>;
		hw,lcdkit-brightness-max-level = <255>;
		hw,lcdkit-bl-min-level = <2>;
		hw,lcdkit-bl-max-level = <255>;
		hw,lcdkit-interleave-mode = <0>;
		hw,lcdkit-down-reset-enable;
		hw,lcdkit-te-using-te-pin;
		hw,lcdkit-h-sync-pulse = <1>;
		hw,lcdkit-bllp-power-mode;
		hw,lcdkit-bllp-eof-power-mode;
		hw,lcdkit-traffic-mode = "burst_mode";
		hw,lcdkit-te-dcs-command = <1>;
		hw,lcdkit-te-pin-select = <1>;
		hw,lcdkit-virtual-channel-id = <0>;
		hw,lcdkit-color-order = "rgb_swap_rgb";
		hw,lcdkit-lane-0-state;
		hw,lcdkit-lane-1-state;
		hw,lcdkit-lane-2-state;
		hw,lcdkit-lane-3-state;
		hw,lcdkit-h-left-border = <0>;
		hw,lcdkit-h-right-border = <0>;
		hw,lcdkit-v-top-border = <0>;
		hw,lcdkit-v-bottom-border = <0>;
		hw,lcdkit-panel-framerate = <60>;
		hw,lcdkit-panel-clockrate = <960470000>;
		hw,lcdkit-panel-timings = [F8 3C 28 00 6E 72 2E 40 30 03 04 00];
		hw,lcdkit-t-clk-pre = <0x2d>;
		hw,lcdkit-t-clk-post = <0x02>;
		hw,lcdkit-tx-eot-append;
		hw,lcdkit-stream = <0>;
		hw,lcdkit-lp11-init;
		hw,lcdkit-mdp-trigger = "none";
		hw,lcdkit-dma-trigger = "trigger_sw";
		hw,lcdkit-force-clock-lane-hs;
		hw,lcdkit-bl-pmic-control-type = "bl_ctrl_ic_ti";
		qcom,panel-supply-entries = <&dsi_panel_pwr_supply>;
		hw,lcdkit-lane-map = "lane_map_0123";
		hw,lcdkit-delay-before-bl = <0>;
		hw,lcdkit-mipi-regulator-mode = <0>;
		hw,lcdkit-bl-chip-init = <8556>;
		hw,lcdkit-delay-af-rst-off = <20>;
		hw,lcdkit-delay-af-blic-init = <80>;
		hw,lcdkit-bl-level-limit-percent = <100>;
		hw,lcdkit-use-second-ic-for-esd = <0>;
		hw,lcdkit-esd-check-num = <3>;
		hw,lcdkit-lp8556-bl-channel-config = <3>;
		hw,lcdkit-lp8556-bl-max-vboost-select = <1>;
		hw,lcdkit-h-back-porch = <36>;
		hw,lcdkit-h-front-porch = <64>;
		hw,lcdkit-h-pulse-width = <4>;
		hw,lcdkit-v-back-porch = <22>;
		hw,lcdkit-v-pulse-width = <2>;
		hw,lcdkit-v-front-porch = <102>;
		hw,lcdkit-h-sync-skew = <0>;
		hw,lcdkit-lcd-type = <1>;
		hw,lcdkit-panel-pt-test-support = <1>;
		hw,lcdkit-bias-power-ctrl-mode = <0x0>;
		hw,lcdkit-iovcc-power-ctrl-mode = <0x02>;
		hw,lcdkit-vci-power-ctrl-mode = <0x02>;
		hw,lcdkit-id0-gpio = <59>;
		hw,lcdkit-id1-gpio = <48>;
		hw,lcdkit-reset-gpio = <1>;
		hw,lcdkit-te-gpio = <0>;
		hw,lcdkit-vsp-gpio = <0>;
		hw,lcdkit-vsn-gpio = <0>;
		hw,lcdkit-iovcc-gpio = <38>;
		hw,lcdkit-vci-gpio = <33>;
		hw,lcdkit-bl-gpio = <50>;
		hw,lcdkit-iovcc-on-is-need-reset = <0x1>;
		hw,lcdkit-vsn-on-is-need-reset = <0>;
		hw,lcdkit-lcd-vsp = <5500000>;
		hw,lcdkit-lcd-vsn = <5500000>;
		hw,lcdkit-lcd-rst-first-high = <5>;
		hw,lcdkit-lcd-rst-low = <5>;
		hw,lcdkit-lcd-rst-second-high = <5>;
		hw,lcdkit-delay-af-vci-on = <0>;
		hw,lcdkit-delay-af-iovcc-on = <30>;
		hw,lcdkit-delay-af-bias-on = <0>;
		hw,lcdkit-delay-af-vsp-on = <0>;
		hw,lcdkit-delay-af-vsn-on = <3>;
		hw,lcdkit-delay-af-lp11 = <0>;
		hw,lcdkit-delay-af-tp-reset = <25>;
		hw,lcdkit-delay-af-vsn-off = <3>;
		hw,lcdkit-delay-af-vsp-off = <0>;
		hw,lcdkit-delay-af-bias-off = <0>;
		hw,lcdkit-delay-af-iovcc-off = <0>;
		hw,lcdkit-delay-af-vci-off = <500>;
		hw,lcdkit-panel-off-reset-high = <0>;
    };
};