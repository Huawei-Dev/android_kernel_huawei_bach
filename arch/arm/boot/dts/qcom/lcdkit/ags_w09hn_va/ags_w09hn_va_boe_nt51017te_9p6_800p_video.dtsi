/* Copyright (c) 2013, The Linux Foundation. All rights reserved.
 *
 * This program is free software; you can redistribute it and/or modify
 * it under the terms of the GNU General Public License version 2 and
 * only version 2 as published by the Free Software Foundation.
 *
 * This program is distributed in the hope that it will be useful,
 * but WITHOUT ANY WARRANTY; without even the implied warranty of
 * MERCHANTABILITY or FITNESS FOR A PARTICULAR PURPOSE.  See the
 * GNU General Public License for more details.
 */

/*-------------------------------------------------------------------------
 * This file is autogenerated file using gcdb parser. Please do not edit it.
 * Update input XML file to add a new entry or update variable in this file
 * VERSION = 1.1
 *-----------------------------------------------------------------------*/
/ {
	dsi_ags_w09hn_va_boe_nt51017te_9p6_800p_video: lcdkit_ags_w09hn_va_boe_nt51017te_9p6_800p_video {
		compatible = "boe_nt51017te_9p6_800p_video";
		hw,lcdkit-panel-name = "BOE_NT51017TE 9P6 VIDEO TFT 800 x 1280";
		hw,lcdkit-panel-type = <0x1>;
		hw,lcdkit-panel-xres = <800>;
		hw,lcdkit-panel-yres = <1280>;
		hw,lcdkit-panel-width = <129>;
		hw,lcdkit-panel-height = <207>;
		hw,lcdkit-panel-on-command = [23 01 00 00 00 00 02 83 aa
					23 01 00 00 00 00 02 84 55
					23 01 00 00 14 00 02 01 00
					23 01 00 00 00 00 02 83 96
					23 01 00 00 00 00 02 84 69
					23 01 00 00 00 00 02 A9 ff
					23 01 00 00 00 00 02 AA fe
					23 01 00 00 00 00 02 AB fa
					23 01 00 00 00 00 02 AC f7
					23 01 00 00 00 00 02 AD f3
					23 01 00 00 00 00 02 AE f1
					23 01 00 00 00 00 02 AF ed
					23 01 00 00 00 00 02 B0 eb
					23 01 00 00 00 00 02 B1 e9
					23 01 00 00 00 00 02 B2 e6
					23 01 00 00 00 00 02 BD 1C
					23 01 00 00 00 00 02 BE 30
					23 01 00 00 00 00 02 BF 30
					23 01 00 00 00 00 02 98 0C
					23 01 00 00 00 00 02 97 80
					23 01 00 00 00 00 02 96 63
					23 01 00 00 00 00 02 95 00
					23 01 00 00 00 00 02 83 00
					23 01 00 00 00 00 02 84 00
					23 01 00 00 00 00 02 96 C0
					23 01 00 00 00 00 02 10 00];
		hw,lcdkit-panel-on-command-state = "dsi_lp_mode";
		hw,lcdkit-panel-off-command = [23 01 00 00 64 00 02 11 00];
		hw,lcdkit-panel-off-command-state = "dsi_lp_mode";
		hw,lcdkit-panel-backlight-command = [23 01 00 00 00 00 02 f5 00];
		hw,lcdkit-panel-backlight-command-state = "dsi_lp_mode";
		hw,lcdkit-panel-cabc-off-command = [23 01 00 00 00 00 02 83 00
					23 01 00 00 00 00 02 84 00
					23 01 00 00 00 00 02 96 00];
		hw,lcdkit-panel-cabc-off-command-state = "dsi_lp_mode";
		hw,lcdkit-panel-cabc-ui-command = [23 01 00 00 00 00 02 83 00
					23 01 00 00 00 00 02 84 00
					23 01 00 00 00 00 02 96 C0];
		hw,lcdkit-panel-cabc-ui-command-state = "dsi_lp_mode";
		hw,lcdkit-panel-cabc-still-command = [23 01 00 00 00 00 02 83 00
					23 01 00 00 00 00 02 84 00
					23 01 00 00 00 00 02 96 C0];
		hw,lcdkit-panel-cabc-still-command-state = "dsi_lp_mode";
		hw,lcdkit-panel-cabc-moving-command = [23 01 00 00 00 00 02 83 00
					23 01 00 00 00 00 02 84 00
					23 01 00 00 00 00 02 96 C0];
		hw,lcdkit-panel-cabc-moving-command-state = "dsi_lp_mode";
		hw,lcdkit-panel-cabc-support = <1>;
		hw,lcdkit-panel-inversion-support = <0>;
		hw,lcdkit-panel-scan-support = <0>;
		hw,lcdkit-panel-display-region-command = [];
		hw,lcdkit-panel-display-region-command-state = "dsi_lp_mode";
		hw,lcdkit-panel-display-region-support = <0>;
		hw,lcdkit-panel-checksum-support = <0>;
		hw,lcdkit-panel-esd-reg-command = [06 01 00 00 05 00 01 0a
						06 01 00 00 05 00 01 0d];
		hw,lcdkit-panel-esd-reg-command-state = "dsi_lp_mode";
		hw,lcdkit-panel-esd-value = [11 00];
		hw,lcdkit-panel-esd-support = <1>;
		hw,lcdkit-panel-check-reg-command = [06 01 00 00 0a 00 01 0a];
		hw,lcdkit-panel-check-reg-value = [11];
		hw,lcdkit-panel-check-reg-command-state = "dsi_lp_mode";
		hw,lcdkit-panel-check-reg-support = <0>;
		hw,lcdkit-panel-mipi-detect-command = [];
		hw,lcdkit-panel-mipi-detect-value = [];
		hw,lcdkit-panel-mipi-detect-mask = [];
		hw,lcdkit-panel-mipi-detect-command-state = "dsi_lp_mode";
		hw,lcdkit-panel-mipi-detect-support = <0>;
		hw,lcdkit-panel-shutdown-sleep-support = <0>;
		hw,lcdkit-dsi-bpp = <24>;
		hw,lcdkit-panel-cmd-type = <0>;
		hw,lcdkit-pixel-packing = <0>;
		hw,lcdkit-underflow-color = <0x00>;
		hw,lcdkit-border-color = <0>;
		hw,lcdkit-panel-orientation = <0>;
		hw,lcdkit-brightness-max-level = <255>;
		hw,lcdkit-bl-min-level = <3>;
		hw,lcdkit-bl-max-level = <255>;
		hw,lcdkit-interleave-mode = <0>;
		hw,lcdkit-down-reset-enable;
		hw,lcdkit-te-using-te-pin;
		hw,lcdkit-h-sync-pulse = <1>;
		hw,lcdkit-bllp-power-mode;
		hw,lcdkit-bllp-eof-power-mode;
		hw,lcdkit-traffic-mode = "burst_mode";
		hw,lcdkit-te-dcs-command = <1>;
		hw,lcdkit-te-pin-select = <1>;
		hw,lcdkit-virtual-channel-id = <0>;
		hw,lcdkit-color-order = "rgb_swap_rgb";
		hw,lcdkit-lane-0-state;
		hw,lcdkit-lane-1-state;
		hw,lcdkit-lane-2-state;
		hw,lcdkit-lane-3-state;
		hw,lcdkit-h-left-border = <0>;
		hw,lcdkit-h-right-border = <0>;
		hw,lcdkit-v-top-border = <0>;
		hw,lcdkit-v-bottom-border = <0>;
		hw,lcdkit-panel-framerate = <60>;
		hw,lcdkit-panel-clockrate = <551230000>;
		hw,lcdkit-panel-timings = [98 22 16 00 4a 4c 1c 26 1a 03 04 00];
		hw,lcdkit-t-clk-pre = <0x1e>;
		hw,lcdkit-t-clk-post = <0x04>;
		hw,lcdkit-tx-eot-append;
		hw,lcdkit-stream = <0>;
		hw,lcdkit-lp11-init;
		hw,lcdkit-mdp-trigger = "none";
		hw,lcdkit-dma-trigger = "trigger_sw";
		hw,lcdkit-force-clock-lane-hs;
		hw,lcdkit-bl-pmic-control-type = "bl_ctrl_ic_ti";
		qcom,panel-supply-entries = <&dsi_panel_pwr_supply>;
		hw,lcdkit-lane-map = "lane_map_0123";
		hw,lcdkit-delay-before-bl = <0>;
		hw,lcdkit-mipi-regulator-mode = <0>;
		hw,lcdkit-bl-chip-init = <8556>;
		hw,lcdkit-delay-af-rst-off = <20>;
		hw,lcdkit-delay-af-blic-init = <80>;
		hw,lcdkit-bl-level-limit-percent = <100>;
		hw,lcdkit-panel-esd-reg-curic-command = [39 01 00 00 00 00 02 89 23];
		hw,lcdkit-panel-esd-reg-curic-command-state ="dsi_lp_mode";
		hw,lcdkit-panel-esd-reg-oriic-command = [39 01 00 00 00 00 02 89 a3];
		hw,lcdkit-panel-esd-reg-oriic-command-state ="dsi_lp_mode";
		hw,lcdkit-use-second-ic-for-esd = <1>;
		hw,lcdkit-esd-check-num = <1>;
		hw,lcdkit-h-back-porch = <136>;
		hw,lcdkit-h-front-porch = <92>;
		hw,lcdkit-h-pulse-width = <8>;
		hw,lcdkit-v-back-porch = <42>;
		hw,lcdkit-v-pulse-width = <4>;
		hw,lcdkit-v-front-porch = <152>;
		hw,lcdkit-h-sync-skew = <0>;
		hw,lcdkit-lcd-type = <1>;
		hw,lcdkit-panel-pt-test-support = <1>;
		hw,lcdkit-bias-power-ctrl-mode = <0x0>;
		hw,lcdkit-iovcc-power-ctrl-mode = <0x01>;
		hw,lcdkit-vci-power-ctrl-mode = <0x02>;
		hw,lcdkit-id0-gpio = <59>;
		hw,lcdkit-id1-gpio = <48>;
		hw,lcdkit-reset-gpio = <60>;
		hw,lcdkit-te-gpio = <0>;
		hw,lcdkit-vsp-gpio = <0>;
		hw,lcdkit-vsn-gpio = <0>;
		hw,lcdkit-iovcc-gpio = <0>;
		hw,lcdkit-vci-gpio = <8>;
		hw,lcdkit-bl-gpio = <93>;
		hw,lcdkit-iovcc-on-is-need-reset = <0x1>;
		hw,lcdkit-vsn-on-is-need-reset = <0>;
		hw,lcdkit-lcd-vsp = <5500000>;
		hw,lcdkit-lcd-vsn = <5500000>;
		hw,lcdkit-lcd-rst-first-high = <15>;
		hw,lcdkit-lcd-rst-low = <10>;
		hw,lcdkit-lcd-rst-second-high = <20>;
		hw,lcdkit-delay-af-vci-on = <0>;
		hw,lcdkit-delay-af-iovcc-on = <0>;
		hw,lcdkit-delay-af-bias-on = <0>;
		hw,lcdkit-delay-af-vsp-on = <0>;
		hw,lcdkit-delay-af-vsn-on = <3>;
		hw,lcdkit-delay-af-lp11 = <0>;
		hw,lcdkit-delay-af-tp-reset = <25>;
		hw,lcdkit-delay-af-vsn-off = <3>;
		hw,lcdkit-delay-af-vsp-off = <0>;
		hw,lcdkit-delay-af-bias-off = <0>;
		hw,lcdkit-delay-af-iovcc-off = <0>;
		hw,lcdkit-delay-af-vci-off = <500>;
		hw,lcdkit-panel-off-reset-high = <0>;
    };
};