/* Copyright (c) 2013, The Linux Foundation. All rights reserved.
 *
 * This program is free software; you can redistribute it and/or modify
 * it under the terms of the GNU General Public License version 2 and
 * only version 2 as published by the Free Software Foundation.
 *
 * This program is distributed in the hope that it will be useful,
 * but WITHOUT ANY WARRANTY; without even the implied warranty of
 * MERCHANTABILITY or FITNESS FOR A PARTICULAR PURPOSE.  See the
 * GNU General Public License for more details.
 */

/*-------------------------------------------------------------------------
 * This file is autogenerated file using gcdb parser. Please do not edit it.
 * Update input XML file to add a new entry or update variable in this file
 * VERSION = 1.1
 *-----------------------------------------------------------------------*/
/ {
	dsi_bah_al00_va_inx_nt51021_10p1_1200p_video: lcdkit_bah_al00_va_inx_nt51021_10p1_1200p_video {
		compatible = "inx_nt51021_10p1_1200p_video";
		hw,lcdkit-panel-name = "INX_NT51021 10P1 VIDEO TFT 1200 x 1920";
		hw,lcdkit-panel-type = <0x1>;
		hw,lcdkit-panel-xres = <1200>;
		hw,lcdkit-panel-yres = <1920>;
		hw,lcdkit-panel-width = <136>;
		hw,lcdkit-panel-height = <217>;
		hw,lcdkit-panel-on-command = [15 01 00 00 14 00 02 01 00
					15 01 00 00 00 00 02 8c 80
					15 01 00 00 00 00 02 c7 50
					15 01 00 00 00 00 02 c5 50
					15 01 00 00 00 00 02 85 04
					15 01 00 00 00 00 02 86 08
					15 01 00 00 00 00 02 83 00
					15 01 00 00 00 00 02 84 00
					15 01 00 00 00 00 02 a9 0a
					15 01 00 00 00 00 02 83 bb
					15 01 00 00 00 00 02 84 22
					15 01 00 00 00 00 02 90 00
					15 01 00 00 00 00 02 a1 ff
					15 01 00 00 00 00 02 a2 fc
					15 01 00 00 00 00 02 a3 f7
					15 01 00 00 00 00 02 a4 f3
					15 01 00 00 00 00 02 a5 e9
					15 01 00 00 00 00 02 a6 e2
					15 01 00 00 00 00 02 a7 dc
					15 01 00 00 00 00 02 a8 d7
					15 01 00 00 00 00 02 a9 d1
					15 01 00 00 00 00 02 aa cc
					15 01 00 00 00 00 02 b4 42
					15 01 00 00 00 00 02 b5 5b
					15 01 00 00 00 00 02 b6 51
					15 01 00 00 00 00 02 AD 03
					15 01 00 00 00 00 02 9a 10
					15 01 00 00 00 00 02 94 b8
					15 01 00 00 00 00 02 95 00
					15 01 00 00 00 00 02 99 00
					15 01 00 00 00 00 02 96 00
					15 01 00 00 00 00 02 83 aa
					15 01 00 00 00 00 02 84 11
					15 01 00 00 00 00 02 9c 10
                    15 01 00 00 64 00 02 a9 4b];
		hw,lcdkit-panel-on-command-state = "dsi_lp_mode";
		hw,lcdkit-panel-off-command = [15 01 00 00 64 00 02 10 00];
		hw,lcdkit-panel-off-command-state = "dsi_lp_mode";
		hw,lcdkit-panel-backlight-command = [23 01 00 00 00 00 02 9f 00];
		hw,lcdkit-panel-backlight-command-state = "dsi_lp_mode";
		hw,lcdkit-panel-cabc-off-command = [23 01 00 00 00 00 02 83 bb
		                   23 01 00 00 00 00 02 84 22
						23 01 00 00 00 00 02 90 C0];
		hw,lcdkit-panel-cabc-off-command-state = "dsi_hs_mode";
		hw,lcdkit-panel-cabc-ui-command = [23 01 00 00 00 00 02 83 bb
							23 01 00 00 00 00 02 84 22
							23 01 00 00 00 00 02 a1 ff
							23 01 00 00 00 00 02 a2 fc
							23 01 00 00 00 00 02 a3 f7
							23 01 00 00 00 00 02 a4 f3
							23 01 00 00 00 00 02 a5 e9
							23 01 00 00 00 00 02 a6 e2
							23 01 00 00 00 00 02 a7 dc
							23 01 00 00 00 00 02 a8 d7
							23 01 00 00 00 00 02 a9 d1
							23 01 00 00 00 00 02 aa cc
							23 01 00 00 00 00 02 b4 42
							23 01 00 00 00 00 02 b5 5b
							23 01 00 00 00 00 02 b6 51
							23 01 00 00 00 00 02 AD 03
							23 01 00 00 00 00 02 9a 10
							23 01 00 00 00 00 02 94 b8
							23 01 00 00 00 00 02 95 00
							23 01 00 00 00 00 02 99 00
							23 01 00 00 00 00 02 96 00
							23 01 00 00 00 00 02 90 00];
		hw,lcdkit-panel-cabc-ui-command-state = "dsi_hs_mode";
		hw,lcdkit-panel-cabc-still-command = [23 01 00 00 00 00 02 83 bb
							23 01 00 00 00 00 02 84 22
							23 01 00 00 00 00 02 a1 ff
							23 01 00 00 00 00 02 a2 fe
							23 01 00 00 00 00 02 a3 fa
							23 01 00 00 00 00 02 a4 f7
							23 01 00 00 00 00 02 a5 f3
							23 01 00 00 00 00 02 a6 f1
							23 01 00 00 00 00 02 a7 ed
							23 01 00 00 00 00 02 a8 eb
							23 01 00 00 00 00 02 a9 e9
							23 01 00 00 00 00 02 aa e6
							23 01 00 00 00 00 02 b4 0d
							23 01 00 00 00 00 02 b5 1a
							23 01 00 00 00 00 02 b6 16
							23 01 00 00 00 00 02 9a 10
							23 01 00 00 00 00 02 9b 00
							23 01 00 00 00 00 02 99 00
							23 01 00 00 00 00 02 96 00
							23 01 00 00 00 00 02 90 40];
		hw,lcdkit-panel-cabc-still-command-state = "dsi_hs_mode";
		hw,lcdkit-panel-cabc-moving-command = [23 01 00 00 00 00 02 83 bb
							23 01 00 00 00 00 02 84 22
							23 01 00 00 00 00 02 a1 ff
							23 01 00 00 00 00 02 a2 fc
							23 01 00 00 00 00 02 a3 f7
							23 01 00 00 00 00 02 a4 f3
							23 01 00 00 00 00 02 a5 e9
							23 01 00 00 00 00 02 a6 e2
							23 01 00 00 00 00 02 a7 dc
							23 01 00 00 00 00 02 a8 d7
							23 01 00 00 00 00 02 a9 d1
							23 01 00 00 00 00 02 aa cc
							23 01 00 00 00 00 02 b4 42
							23 01 00 00 00 00 02 b5 5b
							23 01 00 00 00 00 02 b6 51
							23 01 00 00 00 00 02 AD 03
							23 01 00 00 00 00 02 9a 10
							23 01 00 00 00 00 02 94 b8
							23 01 00 00 00 00 02 95 00
							23 01 00 00 00 00 02 99 00
							23 01 00 00 00 00 02 96 00
							23 01 00 00 00 00 02 90 00];
		hw,lcdkit-panel-cabc-moving-command-state = "dsi_hs_mode";
		hw,lcdkit-panel-cabc-support = <1>;
		hw,lcdkit-panel-inversion-support = <0>;
		hw,lcdkit-panel-scan-support = <0>;
		hw,lcdkit-panel-display-region-command = [];
		hw,lcdkit-panel-display-region-command-state = "dsi_lp_mode";
		hw,lcdkit-panel-display-region-support = <0>;
		hw,lcdkit-panel-checksum-support = <0>;
		hw,lcdkit-panel-esd-support = <0>;
		hw,lcdkit-panel-check-reg-support = <0>;
		hw,lcdkit-panel-mipi-detect-command = [];
		hw,lcdkit-panel-mipi-detect-value = [];
		hw,lcdkit-panel-mipi-detect-mask = [];
		hw,lcdkit-panel-mipi-detect-command-state = "dsi_lp_mode";
		hw,lcdkit-panel-mipi-detect-support = <0>;
		hw,lcdkit-panel-shutdown-sleep-support = <0>;
		hw,lcdkit-dsi-bpp = <24>;
		hw,lcdkit-panel-cmd-type = <0>;
		hw,lcdkit-pixel-packing = <0>;
		hw,lcdkit-underflow-color = <0x00>;
		hw,lcdkit-border-color = <0>;
		hw,lcdkit-panel-orientation = <0>;
		hw,lcdkit-brightness-max-level = <255>;
		hw,lcdkit-bl-min-level = <1>;
		hw,lcdkit-bl-max-level = <255>;
		hw,lcdkit-interleave-mode = <0>;
		hw,lcdkit-down-reset-enable;
		hw,lcdkit-te-using-te-pin;
		hw,lcdkit-h-sync-pulse = <1>;
		hw,lcdkit-hfp-power-mode = <>;
		hw,lcdkit-bllp-power-mode;
		hw,lcdkit-bllp-eof-power-mode;
		hw,lcdkit-traffic-mode = "burst_mode";
		hw,lcdkit-te-dcs-command = <1>;
		hw,lcdkit-te-pin-select = <1>;
		hw,lcdkit-virtual-channel-id = <0>;
		hw,lcdkit-color-order = "rgb_swap_rgb";
		hw,lcdkit-lane-0-state;
		hw,lcdkit-lane-1-state;
		hw,lcdkit-lane-2-state;
		hw,lcdkit-lane-3-state;
		hw,lcdkit-h-left-border = <0>;
		hw,lcdkit-h-right-border = <0>;
		hw,lcdkit-v-top-border = <0>;
		hw,lcdkit-v-bottom-border = <0>;
		hw,lcdkit-panel-framerate = <60>;
		hw,lcdkit-panel-clockrate = <989760000>;
		hw,lcdkit-panel-timings = [5d 42 2a 01 70 7a 2e 42 4a 03 04 00];
		hw,lcdkit-t-clk-pre = <0x1b>;
		hw,lcdkit-t-clk-post = <0x04>;
		hw,lcdkit-tx-eot-append;
		hw,lcdkit-stream = <0>;
		hw,lcdkit-lp11-init;
		hw,lcdkit-mdp-trigger = "none";
		hw,lcdkit-dma-trigger = "trigger_sw";
		hw,lcdkit-force-clock-lane-hs;
		hw,lcdkit-bl-pmic-control-type = "bl_ctrl_ic_ti";
		qcom,panel-supply-entries = <&dsi_panel_pwr_supply>;
		hw,lcdkit-lane-map = "lane_map_0123";
		hw,lcdkit-delay-before-bl = <0>;
		hw,lcdkit-mipi-regulator-mode = <0>;
		hw,lcdkit-bl-chip-init = <8556>;
		hw,lcdkit-delay-af-rst-off = <20>;
		hw,lcdkit-delay-af-blic-init = <0>;
		hw,lcdkit-bl-level-limit-percent = <100>;
		hw,lcdkit-use-second-ic-for-esd = <0>;
		hw,lcdkit-esd-check-num = <3>;
		hw,lcdkit-h-back-porch = <32>;
		hw,lcdkit-h-front-porch = <168>;
		hw,lcdkit-h-pulse-width = <2>;
		hw,lcdkit-v-back-porch = <14>;
		hw,lcdkit-v-pulse-width = <2>;
		hw,lcdkit-v-front-porch = <25>;
		hw,lcdkit-h-sync-skew = <0>;
		hw,lcdkit-lcd-type = <1>;
		hw,lcdkit-panel-pt-test-support = <1>;
		hw,lcdkit-bias-power-ctrl-mode = <0x0>;
		hw,lcdkit-iovcc-power-ctrl-mode = <0x02>;
		hw,lcdkit-vci-power-ctrl-mode = <0x02>;
		hw,lcdkit-id0-gpio = <59>;
		hw,lcdkit-id1-gpio = <48>;
		hw,lcdkit-reset-gpio = <1>;
		hw,lcdkit-te-gpio = <0>;
		hw,lcdkit-vsp-gpio = <0>;
		hw,lcdkit-vsn-gpio = <0>;
		hw,lcdkit-iovcc-gpio = <38>;
		hw,lcdkit-vci-gpio = <33>;
		hw,lcdkit-bl-gpio = <50>;
		hw,lcdkit-iovcc-on-is-need-reset = <0x1>;
		hw,lcdkit-vsn-on-is-need-reset = <0>;
		hw,lcdkit-lcd-vsp = <5500000>;
		hw,lcdkit-lcd-vsn = <5500000>;
		hw,lcdkit-lcd-rst-first-high = <15>;
		hw,lcdkit-lcd-rst-low = <10>;
		hw,lcdkit-lcd-rst-second-high = <20>;
		hw,lcdkit-delay-af-vci-on = <0>;
		hw,lcdkit-delay-af-iovcc-on = <30>;
		hw,lcdkit-delay-af-bias-on = <0>;
		hw,lcdkit-delay-af-vsp-on = <0>;
		hw,lcdkit-delay-af-vsn-on = <3>;
		hw,lcdkit-delay-af-lp11 = <0>;
		hw,lcdkit-delay-af-tp-reset = <25>;
		hw,lcdkit-delay-af-vsn-off = <3>;
		hw,lcdkit-delay-af-vsp-off = <0>;
		hw,lcdkit-delay-af-bias-off = <0>;
		hw,lcdkit-delay-af-iovcc-off = <0>;
		hw,lcdkit-delay-af-vci-off = <500>;
		hw,lcdkit-panel-off-reset-high = <0>;
    };
};