/*---------------------------------------------------------------------------
 * This file is autogenerated file using huawei LCD parser. Please do not edit it.
 * Update input XML file to add a new entry or update variable in this file
 * Parser location: vendor/huawei/chipset_common/devkit/lcdkit/tools 
 *---------------------------------------------------------------------------*/


#include "trt_l22_vd_inx_ft8607_5p5_720p_video.dtsi"
#include "trt_l22_vd_boe_td4100_5p5_720p_video.dtsi"
#include "trt_l22_vd_boeg6_td4100_5p5_720p_video.dtsi"
#include "trt_l22_vd_tm_td4100_5p5_720p_video.dtsi"