/* Copyright (c) 2013, The Linux Foundation. All rights reserved.
 *
 * This program is free software; you can redistribute it and/or modify
 * it under the terms of the GNU General Public License version 2 and
 * only version 2 as published by the Free Software Foundation.
 *
 * This program is distributed in the hope that it will be useful,
 * but WITHOUT ANY WARRANTY; without even the implied warranty of
 * MERCHANTABILITY or FITNESS FOR A PARTICULAR PURPOSE.  See the
 * GNU General Public License for more details.
 */

/*-------------------------------------------------------------------------
 * This file is autogenerated file using gcdb parser. Please do not edit it.
 * Update input XML file to add a new entry or update variable in this file
 * VERSION = 1.1
 *-----------------------------------------------------------------------*/
/ {
	dsi_cpn_l09_va_auo_nt51021_8p0_1200p_video: lcdkit_cpn_l09_va_auo_nt51021_8p0_1200p_video {
		compatible = "auo_nt51021_8p0_1200p_video";
		hw,lcdkit-panel-name = "AUO_NT51021 8P0 VIDEO TFT 1200 x 1920";
		hw,lcdkit-panel-type = <0x1>;
		hw,lcdkit-panel-xres = <1200>;
		hw,lcdkit-panel-yres = <1920>;
		hw,lcdkit-panel-width = <108>;
		hw,lcdkit-panel-height = <173>;
		hw,lcdkit-panel-on-command = [15 01 00 00 06 00 02 8F A5
				15 01 00 00 18 00 02 01 00
				15 01 00 00 00 00 02 8F A5
				15 01 00 00 00 00 02 83 BB
				15 01 00 00 00 00 02 84 22
				15 01 00 00 00 00 02 A1 FF
				15 01 00 00 00 00 02 A2 F9
				15 01 00 00 00 00 02 A3 F2
				15 01 00 00 00 00 02 A4 ED
				15 01 00 00 00 00 02 A5 E5
				15 01 00 00 00 00 02 A6 DF
				15 01 00 00 00 00 02 A7 DE
				15 01 00 00 00 00 02 A8 DA
				15 01 00 00 00 00 02 A9 D3
				15 01 00 00 00 00 02 AA CF
				15 01 00 00 00 00 02 B4 20
				15 01 00 00 00 00 02 B5 32
				15 01 00 00 00 00 02 B6 29
				15 01 00 00 00 00 02 AD 06
				15 01 00 00 00 00 02 9A 10
				15 01 00 00 00 00 02 94 B8
				15 01 00 00 00 00 02 95 00
				15 01 00 00 00 00 02 9A 10
				15 01 00 00 00 00 02 96 00
				15 01 00 00 00 00 02 90 00
				15 01 00 00 00 00 02 83 AA
				15 01 00 00 00 00 02 84 11
				15 01 00 00 00 00 02 A9 4B
				15 01 00 00 00 00 02 83 00
				15 01 00 00 00 00 02 84 00
				05 01 00 00 05 00 02 11 00];
		hw,lcdkit-panel-on-command-state = "dsi_lp_mode";
		hw,lcdkit-panel-off-command = [15 01 00 00 05 00 02 10 00];
		hw,lcdkit-panel-off-command-state = "dsi_hs_mode";
		hw,lcdkit-panel-backlight-command = [23 01 00 00 00 00 02 9F 00];
		hw,lcdkit-panel-backlight-command-state = "dsi_lp_mode";
		hw,lcdkit-panel-cabc-off-command = [23 01 00 00 00 00 02 83 BB
				23 01 00 00 00 00 02 84 22
				23 01 00 00 00 00 02 90 C0];
		hw,lcdkit-panel-cabc-off-command-state = "dsi_hs_mode";
		hw,lcdkit-panel-cabc-ui-command = [23 01 00 00 00 00 02 83 BB
				23 01 00 00 00 00 02 84 22
				23 01 00 00 00 00 02 A1 FF
				23 01 00 00 00 00 02 A2 F9
				23 01 00 00 00 00 02 A3 F2
				23 01 00 00 00 00 02 A4 ED
				23 01 00 00 00 00 02 A5 E5
				23 01 00 00 00 00 02 A6 DF
				23 01 00 00 00 00 02 A7 DE
				23 01 00 00 00 00 02 A8 DA
				23 01 00 00 00 00 02 A9 D3
				23 01 00 00 00 00 02 AA CF
				23 01 00 00 00 00 02 B4 20
				23 01 00 00 00 00 02 B5 32
				23 01 00 00 00 00 02 B6 29
				23 01 00 00 00 00 02 AD 06
				23 01 00 00 00 00 02 9A 10
				23 01 00 00 00 00 02 94 B8
				23 01 00 00 00 00 02 95 00
				23 01 00 00 00 00 02 9A 10
				23 01 00 00 00 00 02 96 00
				23 01 00 00 00 00 02 90 00];
		hw,lcdkit-panel-cabc-ui-command-state = "dsi_hs_mode";
		hw,lcdkit-panel-cabc-still-command = [23 01 00 00 00 00 02 83 BB
				23 01 00 00 00 00 02 84 22
				23 01 00 00 00 00 02 A1 FF
				23 01 00 00 00 00 02 A2 FE
				23 01 00 00 00 00 02 A3 FA
				23 01 00 00 00 00 02 A4 F7
				23 01 00 00 00 00 02 A5 F3
				23 01 00 00 00 00 02 A6 F1
				23 01 00 00 00 00 02 A7 EE
				23 01 00 00 00 00 02 A8 EC
				23 01 00 00 00 00 02 A9 EB
				23 01 00 00 00 00 02 AA E6
				23 01 00 00 00 00 02 B4 0D
				23 01 00 00 00 00 02 B5 1A
				23 01 00 00 00 00 02 B6 16
				23 01 00 00 00 00 02 9A 10
				23 01 00 00 00 00 02 9B 00
				23 01 00 00 00 00 02 99 00
				23 01 00 00 00 00 02 AF 12
				23 01 00 00 00 00 02 B0 36
				23 01 00 00 00 00 02 B1 56
				23 01 00 00 00 00 02 B2 67
				23 01 00 00 00 00 02 B3 6A
				23 01 00 00 00 00 02 90 40
				23 01 00 00 00 00 02 96 00];
		hw,lcdkit-panel-cabc-still-command-state = "dsi_hs_mode";
		hw,lcdkit-panel-cabc-moving-command = [23 01 00 00 00 00 02 83 BB
				23 01 00 00 00 00 02 84 22
				23 01 00 00 00 00 02 A1 FF
				23 01 00 00 00 00 02 A2 F9
				23 01 00 00 00 00 02 A3 F2
				23 01 00 00 00 00 02 A4 ED
				23 01 00 00 00 00 02 A5 E5
				23 01 00 00 00 00 02 A6 DF
				23 01 00 00 00 00 02 A7 DE
				23 01 00 00 00 00 02 A8 DA
				23 01 00 00 00 00 02 A9 D3
				23 01 00 00 00 00 02 AA CF
				23 01 00 00 00 00 02 B4 20
				23 01 00 00 00 00 02 B5 32
				23 01 00 00 00 00 02 B6 29
				23 01 00 00 00 00 02 AD 06
				23 01 00 00 00 00 02 9A 10
				23 01 00 00 00 00 02 94 B8
				23 01 00 00 00 00 02 95 00
				23 01 00 00 00 00 02 9A 10
				23 01 00 00 00 00 02 96 00
				23 01 00 00 00 00 02 90 00];
		hw,lcdkit-panel-cabc-moving-command-state = "dsi_hs_mode";
		hw,lcdkit-panel-cabc-support = <1>;
		hw,lcdkit-panel-inversion-support = <0>;
		hw,lcdkit-panel-scan-support = <0>;
		hw,lcdkit-panel-display-region-command = [];
		hw,lcdkit-panel-display-region-command-state = "dsi_lp_mode";
		hw,lcdkit-panel-display-region-support = <0>;
		hw,lcdkit-panel-checksum-support = <0>;
		hw,lcdkit-panel-esd-support = <0>;
		hw,lcdkit-panel-check-reg-support = <0>;
		hw,lcdkit-panel-mipi-detect-command = [];
		hw,lcdkit-panel-mipi-detect-value = [];
		hw,lcdkit-panel-mipi-detect-mask = [];
		hw,lcdkit-panel-mipi-detect-command-state = "dsi_lp_mode";
		hw,lcdkit-panel-mipi-detect-support = <0>;
		hw,lcdkit-panel-shutdown-sleep-support = <0>;
		hw,lcdkit-dsi-bpp = <24>;
		hw,lcdkit-panel-cmd-type = <0>;
		hw,lcdkit-pixel-packing = <0>;
		hw,lcdkit-underflow-color = <0x00>;
		hw,lcdkit-border-color = <0>;
		hw,lcdkit-panel-orientation = <0>;
		hw,lcdkit-brightness-max-level = <255>;
		hw,lcdkit-bl-min-level = <2>;
		hw,lcdkit-bl-max-level = <255>;
		hw,lcdkit-interleave-mode = <0>;
		hw,lcdkit-down-reset-enable;
		hw,lcdkit-te-using-te-pin;
		hw,lcdkit-h-sync-pulse = <1>;
		hw,lcdkit-bllp-power-mode;
		hw,lcdkit-bllp-eof-power-mode;
		hw,lcdkit-traffic-mode = "burst_mode";
		hw,lcdkit-te-dcs-command = <1>;
		hw,lcdkit-te-pin-select = <1>;
		hw,lcdkit-virtual-channel-id = <0>;
		hw,lcdkit-color-order = "rgb_swap_rgb";
		hw,lcdkit-lane-0-state;
		hw,lcdkit-lane-1-state;
		hw,lcdkit-lane-2-state;
		hw,lcdkit-lane-3-state;
		hw,lcdkit-h-left-border = <0>;
		hw,lcdkit-h-right-border = <0>;
		hw,lcdkit-v-top-border = <0>;
		hw,lcdkit-v-bottom-border = <0>;
		hw,lcdkit-panel-framerate = <60>;
		hw,lcdkit-panel-clockrate = <964230000>;
		hw,lcdkit-panel-timings = [F8 3C 28 00 6E 72 2E 40 30 03 04 00];
		hw,lcdkit-t-clk-pre = <0x2d>;
		hw,lcdkit-t-clk-post = <0x02>;
		hw,lcdkit-tx-eot-append;
		hw,lcdkit-stream = <0>;
		hw,lcdkit-lp11-init;
		hw,lcdkit-mdp-trigger = "none";
		hw,lcdkit-dma-trigger = "trigger_sw";
		hw,lcdkit-force-clock-lane-hs;
		hw,lcdkit-bl-pmic-control-type = "bl_ctrl_ic_ti";
		qcom,panel-supply-entries = <&dsi_panel_pwr_supply>;
		hw,lcdkit-lane-map = "lane_map_0123";
		hw,lcdkit-delay-before-bl = <0>;
		hw,lcdkit-mipi-regulator-mode = <0>;
		hw,lcdkit-bl-chip-init = <8556>;
		hw,lcdkit-delay-af-rst-off = <20>;
		hw,lcdkit-delay-af-blic-init = <80>;
		hw,lcdkit-bl-level-limit-percent = <100>;
		hw,lcdkit-use-second-ic-for-esd = <0>;
		hw,lcdkit-esd-check-num = <3>;
		hw,lcdkit-lp8556-bl-channel-config = <3>;
		hw,lcdkit-lp8556-bl-max-vboost-select = <1>;
		hw,lcdkit-h-back-porch = <36>;
		hw,lcdkit-h-front-porch = <64>;
		hw,lcdkit-h-pulse-width = <4>;
		hw,lcdkit-v-back-porch = <26>;
		hw,lcdkit-v-pulse-width = <2>;
		hw,lcdkit-v-front-porch = <106>;
		hw,lcdkit-h-sync-skew = <0>;
		hw,lcdkit-lcd-type = <1>;
		hw,lcdkit-panel-pt-test-support = <1>;
		hw,lcdkit-bias-power-ctrl-mode = <0x0>;
		hw,lcdkit-iovcc-power-ctrl-mode = <0x02>;
		hw,lcdkit-vci-power-ctrl-mode = <0x02>;
		hw,lcdkit-id0-gpio = <59>;
		hw,lcdkit-id1-gpio = <48>;
		hw,lcdkit-reset-gpio = <1>;
		hw,lcdkit-te-gpio = <0>;
		hw,lcdkit-vsp-gpio = <0>;
		hw,lcdkit-vsn-gpio = <0>;
		hw,lcdkit-iovcc-gpio = <38>;
		hw,lcdkit-vci-gpio = <33>;
		hw,lcdkit-bl-gpio = <50>;
		hw,lcdkit-iovcc-on-is-need-reset = <0x1>;
		hw,lcdkit-vsn-on-is-need-reset = <0>;
		hw,lcdkit-lcd-vsp = <5500000>;
		hw,lcdkit-lcd-vsn = <5500000>;
		hw,lcdkit-lcd-rst-first-high = <5>;
		hw,lcdkit-lcd-rst-low = <5>;
		hw,lcdkit-lcd-rst-second-high = <5>;
		hw,lcdkit-delay-af-vci-on = <0>;
		hw,lcdkit-delay-af-iovcc-on = <30>;
		hw,lcdkit-delay-af-bias-on = <0>;
		hw,lcdkit-delay-af-vsp-on = <0>;
		hw,lcdkit-delay-af-vsn-on = <3>;
		hw,lcdkit-delay-af-lp11 = <0>;
		hw,lcdkit-delay-af-tp-reset = <25>;
		hw,lcdkit-delay-af-vsn-off = <3>;
		hw,lcdkit-delay-af-vsp-off = <0>;
		hw,lcdkit-delay-af-bias-off = <0>;
		hw,lcdkit-delay-af-iovcc-off = <0>;
		hw,lcdkit-delay-af-vci-off = <500>;
		hw,lcdkit-panel-off-reset-high = <0>;
    };
};