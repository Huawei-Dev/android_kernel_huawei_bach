/* Copyright (c) 2013, The Linux Foundation. All rights reserved.
 *
 * This program is free software; you can redistribute it and/or modify
 * it under the terms of the GNU General Public License version 2 and
 * only version 2 as published by the Free Software Foundation.
 *
 * This program is distributed in the hope that it will be useful,
 * but WITHOUT ANY WARRANTY; without even the implied warranty of
 * MERCHANTABILITY or FITNESS FOR A PARTICULAR PURPOSE.  See the
 * GNU General Public License for more details.
 */

/*---------------------------------------------------------------------------
 * This file is autogenerated file using gcdb parser. Please do not edit it.
 * Update input XML file to add a new entry or update variable in this file
 * VERSION = "1.0"
 *---------------------------------------------------------------------------*/
&mdss_mdp {
	dsi_boe_otm1906c_5p5_1080p_cmd: qcom,mdss_dsi_boe_otm1906c_5p5_1080p_cmd {
		qcom,mdss-dsi-panel-name = "BOE_OTM1906C_5P5_1080P_CMD";
		qcom,cont-splash-enabled;
		qcom,mdss-dsi-panel-controller = <&mdss_dsi0>;
		qcom,panel-supply-entries = <&dsi_panel_pwr_supply>;
		qcom,mdss-dsi-panel-type = "dsi_cmd_mode";
		qcom,mdss-dsi-panel-destination = "display_1";
		qcom,mdss-dsi-panel-clockrate = <900000000>;
		qcom,mdss-dsi-panel-framerate = <60>;
		qcom,mdss-dsi-virtual-channel-id = <0>;
		qcom,mdss-dsi-stream = <0>;
		qcom,mdss-dsi-panel-width = <1080>;
		qcom,mdss-dsi-panel-height = <1920>;
		qcom,mdss-dsi-h-front-porch = <45>;
		qcom,mdss-dsi-h-back-porch = <45>;
		qcom,mdss-dsi-h-pulse-width = <8>;
		qcom,mdss-dsi-h-sync-skew = <0>;
		qcom,mdss-dsi-v-back-porch = <16>;
		qcom,mdss-dsi-v-front-porch = <16>;
		qcom,mdss-dsi-v-pulse-width = <4>;
		qcom,mdss-dsi-h-left-border = <0>;
		qcom,mdss-dsi-h-right-border = <0>;
		qcom,mdss-dsi-v-top-border = <0>;
		qcom,mdss-dsi-v-bottom-border = <0>;
		qcom,mdss-dsi-bpp = <24>;
		qcom,mdss-dsi-underflow-color = <0x00>;
		qcom,mdss-dsi-border-color = <0>;
		qcom,mdss-dsi-color-order = "rgb_swap_rgb";
		qcom,mdss-dsi-on-command = [29 01 00 00 00 00 02 00 00
                                               29 01 00 00 00 00 04 FF 19 06 01
                                               29 01 00 00 00 00 02 00 80
                                               29 01 00 00 00 00 03 FF 19 06
                                               29 01 00 00 00 00 02 00 b0
                                               29 01 00 00 00 00 04 c5 1F 1F 01
                                               29 01 00 00 00 00 02 00 d0
                                               29 01 00 00 00 00 0B A7 FF FF 1D 00 01 7C 81 7C 0B E0
                                               29 01 00 00 00 00 02 00 83
                                               29 01 00 00 00 00 02 B3 60
                                               29 01 00 00 00 00 02 00 82
                                               29 01 00 00 00 00 02 d6 02
                                               29 01 00 00 00 00 02 00 82
                                               29 01 00 00 00 00 02 c5 c1
                                               29 01 00 00 00 00 02 00 96
                                               29 01 00 00 00 00 03 c5 1E 32
                                               29 01 00 00 00 00 02 00 c1
                                               29 01 00 00 00 00 02 c5 b5
                                               29 01 00 00 00 00 02 00 a7
                                               29 01 00 00 00 00 09 c0 22 00 22 00 22 00 22 00
                                               29 01 00 00 00 00 02 00 00
                                               29 01 00 00 00 00 19 e1 02 07 0e 15 1d 25 32 45 53 66 73 7b 7c 75 6b 5b 47 35 29 22 18 0c 06 00
                                               29 01 00 00 00 00 02 00 00
                                               29 01 00 00 00 00 19 e2 02 07 0e 15 1d 25 32 45 53 66 73 7b 7c 75 6b 5b 47 35 29 22 18 0c 06 00
                                               29 01 00 00 00 00 02 00 00
                                               29 01 00 00 00 00 19 e3 15 19 1c 24 2a 31 3c 4d 58 69 75 7d 7b 74 6b 5b 47 35 29 22 18 0c 06 00
                                               29 01 00 00 00 00 02 00 00
                                               29 01 00 00 00 00 19 e4 15 19 1c 24 2a 31 3c 4d 58 69 75 7d 7b 74 6b 5b 47 35 29 22 18 0c 06 00
                                               29 01 00 00 00 00 02 00 00
                                               29 01 00 00 00 00 19 e5 00 06 0b 14 1c 24 31 45 52 66 73 7b 7c 75 6b 5b 47 35 29 22 18 0c 06 00
                                               29 01 00 00 00 00 02 00 00
                                               29 01 00 00 00 00 19 e6 00 06 0b 14 1c 24 31 45 52 66 73 7b 7c 75 6b 5b 47 35 29 22 18 0c 06 00
                                               29 01 00 00 00 00 02 00 B0
                                               29 01 00 00 00 00 10 c2 82 13 00 00 88 81 13 00 00 88 00 13 00 00 88
                                               29 01 00 00 00 00 02 00 c0
                                               29 01 00 00 00 00 10 c2 01 13 00 00 88 00 00 00 00 00 00 00 00 00 00
                                               29 01 00 00 00 00 02 00 00
                                               29 01 00 00 00 00 b5 D4 00 40 00 40 00 40 00 40 00 40 00 40 00 40 00 40 00 40 00 40 00 40 00 40 00 40 00 40 00 40 00 40 00 40 00 40 00 40 00 40 00 40 00 40 00 40 00 40 00 40 00 40 00 40 00 40 00 40 00 40 00 40 00 40 00 40 00 40 00 40 00 40 00 40 00 40 00 40 00 40 00 40 00 40 00 40 00 40 00 40 00 40 00 40 00 40 00 40 00 40 00 40 00 40 00 40 00 40 00 40 00 40 00 40 00 40 00 40 00 40 00 40 00 40 00 40 00 40 00 40 00 40 00 40 00 40 00 40 00 40 00 40 00 40 00 40 00 40 00 40 00 40 00 40 00 40 00 40 00 40 00 40 00 40 00 40 00 40 00 40 00 40 00 40 00 40 00 40 00 40
                                               29 01 00 00 00 00 b5 D4 00 40 00 40 00 40 00 40 00 40 00 40 00 40 00 40 00 40 00 40 00 40 00 40 00 40 00 40 00 40 00 40 00 40 00 40 00 40 00 40 00 40 00 40 00 40 00 40 00 40 00 40 00 40 00 40 00 40 00 40 00 40 00 40 00 40 00 40 00 40 00 40 00 40 00 40 00 40 00 40 00 40 00 40 00 40 00 40 00 40 00 40 00 40 00 40 00 40 00 40 00 40 00 40 00 40 00 40 00 40 00 40 00 40 00 40 00 40 00 40 00 40 00 40 00 40 00 40 00 40 00 40 00 40 00 40 00 40 00 40 00 40 00 40 00 40 00 40 00 40 00 40 00 40 00 40 00 40 00 40 00 40 00 40 00 40 00 40 00 40 00 40 00 40 00 40 00 40 00 40
                                               29 01 00 00 00 00 b5 D4 fd 3d fd 3e fe 3e fe 3f fe 40 fe 41 ff 42 ff 42 ff 43 ff 44 00 45 00 45 00 46 01 47 01 48 01 48 01 48 01 47 02 46 02 46 02 45 02 44 02 44 02 43 02 42 03 42 03 41 03 40 03 40 03 3f 03 3f 03 3f 03 3f 03 40 02 40 02 40 02 41 02 41 01 42 01 42 01 42 01 43 01 43 00 43 00 44 00 44 00 44 00 43 00 43 00 43 00 42 00 42 00 42 00 42 00 41 00 41 00 41 00 41 00 40 00 40 00 40 00 40 00 40 00 40 00 40 00 40 00 40 00 40 00 40 00 40 00 40 00 40 00 40 00 40 00 40 00 40 00 40 00 40 00 40 00 40 00 40 00 40 00 40 00 40 00 40 00 40 00 40 00 40 00 40 00 40
                                               29 01 00 00 00 00 b5 D4 00 40 00 40 00 40 00 40 00 40 00 40 00 40 00 40 00 40 00 40 00 40 00 40 00 40 00 40 00 40 00 40 00 40 00 40 00 40 00 40 00 40 00 40 00 40 00 40 00 40 00 40 00 40 00 40 00 40 00 40 00 40 01 40 01 41 02 41 02 42 03 42 03 42 04 43 05 43 05 44 06 44 06 44 07 45 07 45 09 46 09 46 08 45 07 45 07 45 06 44 05 44 05 44 04 43 04 43 03 42 02 42 02 42 01 41 01 41 00 40 00 40 00 40 00 40 00 40 00 40 00 40 00 40 00 40 00 40 00 40 00 40 00 40 00 40 00 40 00 40 00 40 00 40 ff 40 ff 3f ff 3f ff 3f ff 3f fe 3e fe 3e fe 3e fe 3e fe 3e fd 3d fd 3d fd 3d
                                               29 01 00 00 00 00 02 00 00
                                               29 01 00 00 00 00 b5 D5 00 40 00 40 00 40 00 40 00 40 00 40 00 40 00 40 00 40 00 40 00 40 00 40 00 40 00 40 00 40 00 40 00 40 00 40 00 40 00 40 00 40 00 40 00 40 00 40 00 40 00 40 00 40 00 40 00 40 00 40 00 40 00 40 00 40 00 40 00 40 00 40 00 40 00 40 00 40 00 40 00 40 00 40 00 40 00 40 00 40 00 40 00 40 00 40 00 40 00 40 00 40 00 40 00 40 00 40 00 40 00 40 00 40 00 40 00 40 00 40 00 40 00 40 00 40 00 40 00 40 00 40 00 40 00 40 00 40 00 40 00 40 00 40 00 40 00 40 00 40 00 40 00 40 00 40 00 40 00 40 00 40 00 40 00 40 00 40 00 40 00 40 00 40 00 40 00 40 00 40
                                               29 01 00 00 00 00 b5 D5 00 40 00 40 00 40 00 40 00 40 00 40 00 40 00 40 00 40 00 40 00 40 00 40 00 40 00 40 00 40 00 40 00 40 00 40 00 40 00 40 00 40 00 40 00 40 00 40 00 40 00 40 00 40 00 40 00 40 00 40 00 40 01 40 02 40 02 40 03 40 04 40 04 40 06 40 06 40 07 40 08 40 08 3f 09 3f 0a 3f 0b 3f 0b 3f 0a 3f 09 3f 09 3f 08 40 07 40 07 40 06 40 05 40 04 40 03 40 03 40 02 40 01 40 01 40 00 40 00 40 00 40 00 40 00 40 00 40 00 40 00 40 00 40 00 40 00 40 00 40 00 40 00 40 00 40 00 40 00 40 00 40 00 40 00 40 00 40 00 40 00 40 00 40 00 40 00 40 00 40 00 40 00 40 00 40
                                               29 01 00 00 00 00 b5 D5 fc 3b fc 3c fc 3c fc 3d fc 3e fc 3e fc 3f fc 40 fd 40 fd 41 fd 42 fd 42 fc 43 fc 44 fc 45 fc 45 fc 45 fc 44 fe 44 fe 44 fe 43 fe 43 fe 43 ff 42 ff 42 ff 42 ff 41 ff 41 00 41 00 40 00 40 00 40 00 41 00 41 00 41 00 41 00 42 00 42 01 42 01 42 01 43 01 43 01 43 01 43 01 44 01 44 01 44 01 43 01 43 01 43 01 42 01 42 01 42 00 42 00 41 00 41 00 41 00 41 00 40 00 40 00 40 00 40 00 40 00 40 00 40 00 40 00 40 00 40 00 40 00 40 00 40 00 40 00 40 00 40 00 40 00 40 00 40 00 40 00 40 00 40 00 40 00 40 00 40 00 40 00 40 00 40 00 40 00 40 00 40 00 40
                                               29 01 00 00 00 00 b5 D5 00 40 00 40 00 40 00 40 00 40 00 40 00 40 00 40 00 40 00 40 00 40 00 40 00 40 00 40 00 40 00 40 00 40 00 40 00 40 00 40 00 40 00 40 00 40 00 40 00 40 00 40 00 40 00 40 00 40 00 40 00 40 ff 40 ff 41 ff 41 fe 42 fe 42 fe 43 fd 43 fc 44 fc 44 fc 44 fb 45 fb 45 fb 46 fa 46 fa 46 fa 46 fb 45 fb 45 fb 45 fc 44 fc 44 fc 43 fe 43 fe 43 fe 42 ff 42 ff 41 ff 41 00 40 00 40 00 40 00 40 00 40 00 40 00 40 00 40 00 40 00 40 00 40 00 40 00 40 00 40 00 40 00 40 00 40 00 40 ff 3f ff 3f ff 3f ff 3e fe 3e fe 3d fe 3d fd 3d fd 3c fd 3c fd 3c fc 3b fc 3b
                                               15 01 00 00 00 00 02 81 80
                                               29 01 00 00 00 00 02 00 80
                                               29 01 00 00 00 00 03 FF 00 00
                                               29 01 00 00 00 00 02 00 00
                                               29 01 00 00 00 00 04 FF 00 00 00
                                               15 01 00 00 00 00 02 35 00
                                               05 01 00 00 78 00 02 11 00
                                               05 01 00 00 00 00 02 29 00
                                               29 01 00 00 05 00 03 99 00 00];
		qcom,mdss-dsi-off-command = [29 01 00 00 05 00 03 99 95 27
                               05 01 00 00 50 00 02 28 00
                               05 01 00 00 78 00 02 10 00];
		qcom,mdss-dsi-on-command-state = "dsi_lp_mode";
		qcom,mdss-dsi-off-command-state = "dsi_lp_mode";
		qcom,mdss-dsi-h-sync-pulse = <1>;
		qcom,mdss-dsi-traffic-mode = "burst_mode";
		qcom,mdss-dsi-lane-map = "lane_map_0123";
		qcom,mdss-dsi-bllp-eof-power-mode;
		qcom,mdss-dsi-bllp-power-mode;
		qcom,mdss-dsi-lane-0-state;
		qcom,mdss-dsi-lane-1-state;
		qcom,mdss-dsi-lane-2-state;
		qcom,mdss-dsi-lane-3-state;
		qcom,mdss-dsi-te-pin-select = <1>;
		qcom,mdss-dsi-te-v-sync-rd-ptr-irq-line = <0x2c>;
		qcom,mdss-dsi-te-dcs-command = <1>;
		qcom,mdss-dsi-te-check-enable;
		qcom,mdss-dsi-te-using-te-pin;
		qcom,mdss-dsi-panel-timings = [23 1E 08 09 05 03 04 A0
	23 1E 08 09 05 03 04 A0
	23 1E 08 09 05 03 04 A0
	23 1E 08 09 05 03 04 A0
	23 1A 08 09 05 03 04 A0];
		qcom,mdss-dsi-t-clk-post = <0x2C>;
		qcom,mdss-dsi-t-clk-pre = <0x2B>;
		qcom,mdss-dsi-bl-min-level = <30>;
		qcom,mdss-dsi-bl-max-level = <4095>;
		qcom,mdss-brightness-max-level = <4095>;
		qcom,mdss-dsi-dma-trigger = "trigger_sw";
		qcom,mdss-dsi-mdp-trigger = "none";
		qcom,mdss-dsi-bl-pmic-control-type = "bl_ctrl_wled";
		qcom,panel-dot-inversion-mode-cmds = [29 01 00 00 00 00 02 00 00
                          29 01 00 00 00 00 04 FF 19 06 01
                          29 01 00 00 00 00 02 00 80
                          29 01 00 00 00 00 03 FF 19 06
                          29 01 00 00 00 00 02 00 b0
                          29 01 00 00 00 00 04 c5 1F 1F 00
                          29 01 00 00 00 00 02 00 B3
                          29 01 00 00 00 00 02 C0 00
                          29 01 00 00 00 00 02 00 00
                          29 01 00 00 00 00 02 FB 01
                          29 01 00 00 00 00 02 00 00
                          29 01 00 00 00 00 04 FF FF FF FF];
		qcom,panel-column-inversion-mode-cmds = [29 01 00 00 00 00 02 00 00
                             29 01 00 00 00 00 04 FF 19 06 01
                             29 01 00 00 00 00 02 00 80
                             29 01 00 00 00 00 03 FF 19 06
                             29 01 00 00 00 00 02 00 b0
                             29 01 00 00 00 00 04 c5 1F 1F 01
                             29 01 00 00 00 00 02 00 B3
                             29 01 00 00 00 00 02 C0 88
                             29 01 00 00 00 00 02 00 00
                             29 01 00 00 00 00 02 FB 01
                             29 01 00 00 00 00 02 00 00
                             29 01 00 00 00 00 04 FF FF FF FF];
		qcom,dot-inversion-cmds-dsi-state = "dsi_lp_mode";
		qcom,column-inversion-cmds-dsi-state = "dsi_lp_mode";
		qcom,panel-esd-check-enabled;
		qcom,panel-esd-read-commands = [06 01 00 01 05 00 02 0A 9C];
		qcom,esd-read-cmds-state = "dsi_hs_mode";
		qcom,mdss-dsi-lp11-init;
		qcom,mdss-pan-physical-width-dimension = <68>;
		qcom,mdss-pan-physical-height-dimension = <121>;
		huawei,delaytime-before-bl = <80>;
		huawei,long-read-flag = <1>;
		huawei,reg-read-expect-value = <0x9C>;
		huawei,reg-long-read-count = <3>;
		qcom,mdss-dsi-reset-sequence = <1 5>, <0 5>, <1 5>;

	};
};
