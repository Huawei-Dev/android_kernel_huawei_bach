/*                                      Regulations
1.The "DTSxxx" just be allowed to  add at the begin and the tail.
2.The dtsi files which belong to a group need to be put together,and will be separated by remarks.
3.When we add one new boardid,it would be inherted from the similar one
 and modify the product name in the files of huawei-fac.dtsi huawei-wifi.dtsi huawei-audio.dtsi,
 and the other groups need to do some modify with DTSxxx.
*/
/*belong to the component group, according to the order of camera begin*/
#include "huawei-camera.dtsi"
/*belong to the component group, according to the order of camera end*/

/*belong to the component group, according to the order of i2c lcd tp camera sensors compass tricolors vibrator begin*/
#include "huawei-vibrate.dtsi"
#include "../lcdkit/kob_w09c_va/devkit_lcd.dtsi"
#include "../lcdkit/default/devkit_lcd.dtsi"
#include "huawei-backlight.dtsi"
#include "huawei-tp.dtsi"
#include "huawei-gpio-led.dtsi"
/*belong to the component group, according to the order of i2c lcd tp camera sensors compass tricolors vibrator end*/

/*belong to the wireless component group, according to the order of wifi bt fm audio begin*/
#include "huawei-audio.dtsi"
#include "huawei-wifi.dtsi"
#include "huawei-wifionly.dtsi"
#include "huawei-bt.dtsi"
/*belong to the wireless component group, according to the order of wifi bt fm audio end*/

/*belong to the factory group, according to the order of fac begin*/
#include "huawei-fac.dtsi"
/*belong to the factory group, according to the order of fac end*/

/*belong to the OS group, according to the order of battery memery begin*/
#include "huawei-smb1360.dtsi"
#include "huawei-usb.dtsi"
#include "huawei-sdcard.dtsi"
#include "huawei-thermal.dtsi"
#include "huawei-gpu.dtsi"
/*belong to the OS group, according to the order of battery memery end*/

/*belong to the sensor group, according to the order of sensor config begin*/
#include "huawei-sensors.dtsi"
/*belong to the sensor group, according to the order of sensor config end*/
