/{
		huawei_fac_info {
		compatible = "huawei,hw_fac_info";
		fac,product_name = "MLA-L02";
		fac,hardware_ver = "HL1MLAL01M";
		fac,software_ver = "MLA_L02_VA";
		fac,simcard_adapt = "support";
		status = "ok";
	};
};
