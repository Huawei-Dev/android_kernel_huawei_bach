/* Copyright (c) 2013, The Linux Foundation. All rights reserved.
 *
 * This program is free software; you can redistribute it and/or modify
 * it under the terms of the GNU General Public License version 2 and
 * only version 2 as published by the Free Software Foundation.
 *
 * This program is distributed in the hope that it will be useful,
 * but WITHOUT ANY WARRANTY; without even the implied warranty of
 * MERCHANTABILITY or FITNESS FOR A PARTICULAR PURPOSE.  See the
 * GNU General Public License for more details.
 */

/*---------------------------------------------------------------------------
 * This file is autogenerated file using gcdb parser. Please do not edit it.
 * Update input XML file to add a new entry or update variable in this file
 * VERSION = "1.0"
 *---------------------------------------------------------------------------*/
&mdss_mdp {
	dsi_tianma_otm1906c_5p5_1080p_cmd: qcom,mdss_dsi_tianma_otm1906c_5p5_1080p_cmd {
		qcom,mdss-dsi-panel-name = "TIANMA_OTM1906C_5P5_1080P_CMD";
		qcom,cont-splash-enabled;
		qcom,mdss-dsi-panel-controller = <&mdss_dsi0>;
		qcom,panel-supply-entries = <&dsi_panel_pwr_supply>;
		qcom,mdss-dsi-panel-type = "dsi_cmd_mode";
		qcom,mdss-dsi-panel-destination = "display_1";
		qcom,mdss-dsi-panel-clockrate = <900000000>;
		qcom,mdss-dsi-panel-framerate = <60>;
		qcom,mdss-dsi-virtual-channel-id = <0>;
		qcom,mdss-dsi-stream = <0>;
		qcom,mdss-dsi-panel-width = <1080>;
		qcom,mdss-dsi-panel-height = <1920>;
		qcom,mdss-dsi-h-front-porch = <45>;
		qcom,mdss-dsi-h-back-porch = <45>;
		qcom,mdss-dsi-h-pulse-width = <8>;
		qcom,mdss-dsi-h-sync-skew = <0>;
		qcom,mdss-dsi-v-back-porch = <16>;
		qcom,mdss-dsi-v-front-porch = <16>;
		qcom,mdss-dsi-v-pulse-width = <4>;
		qcom,mdss-dsi-h-left-border = <0>;
		qcom,mdss-dsi-h-right-border = <0>;
		qcom,mdss-dsi-v-top-border = <0>;
		qcom,mdss-dsi-v-bottom-border = <0>;
		qcom,mdss-dsi-bpp = <24>;
		qcom,mdss-dsi-underflow-color = <0x00>;
		qcom,mdss-dsi-border-color = <0>;
		qcom,mdss-dsi-color-order = "rgb_swap_rgb";
		qcom,mdss-dsi-on-command = [29 01 00 00 00 00 02 00 00
					29 01 00 00 00 00 04 ff 19 06 01
					29 01 00 00 00 00 02 00 80
					29 01 00 00 00 00 03 ff 19 06
					29 01 00 00 00 00 02 00 83
					29 01 00 00 00 00 03 c0 0a0a
					29 01 00 00 00 00 02 00 8C
					29 01 00 00 00 00 03 c0 0a0a
					29 01 00 00 00 00 02 00 C1
					29 01 00 00 00 00 02 C5 B5
					29 01 00 00 00 00 02 00 84
					29 01 00 00 00 00 02 A4 10
					29 01 00 00 00 00 02 00 82
					29 01 00 00 00 00 02 C5 C1
					29 01 00 00 00 00 02 00 91
					29 01 00 00 00 00 02 C5 12
					29 01 00 00 00 00 02 00 96
					29 01 00 00 00 00 03 C5 15 27
					29 01 00 00 00 00 02 00 94
					29 01 00 00 00 00 02 C5 64
					29 01 00 00 00 00 02 00 A7
					29 01 00 00 00 00 09 C0 11 00 11 00 11 00 11 00
					29 01 00 00 00 00 02 00 D7
					29 01 00 00 00 00 09 C0 11 00 11 00 11 00 11 00
					29 01 00 00 00 00 02 00 83
					29 01 00 00 00 00 02 B3 60
					29 01 00 00 00 00 02 00 82
					29 01 00 00 00 00 02 d6 02
					29 01 00 00 00 00 02 00 00
					29 01 00 00 00 00 b5 D4 00 40 00 40 00 40 00 40 00 40 00 40 00 40 00 40 00 40 00 40 00 40 00 40 00 40 00 40 00 40 00 40 00 40 00 40 00 40 00 40 00 40 00 40 00 40 00 40 00 40 00 40 00 40 00 40 00 40 00 40 00 40 00 40 00 40 00 40 00 40 00 40 00 40 00 40 00 40 00 40 00 40 00 40 00 40 00 40 00 40 00 40 00 40 00 40 00 40 00 40 00 40 00 40 00 40 00 40 00 40 00 40 00 40 00 40 00 40 00 40 00 40 00 40 00 40 00 40 00 40 00 40 00 40 00 40 00 40 00 40 00 40 00 40 00 40 00 40 00 40 00 40 00 40 00 40 00 40 00 40 00 40 00 40 00 40 00 40 00 40 00 40 00 40 00 40 00 40 00 40
					29 01 00 00 00 00 b5 D4 00 40 00 40 00 40 00 40 00 40 00 40 00 40 00 40 00 40 00 40 00 40 00 40 00 40 00 40 00 40 00 40 00 40 00 40 00 40 00 40 00 40 00 40 00 40 00 40 00 40 00 40 00 40 00 40 00 40 00 40 00 40 00 40 00 40 00 40 00 40 00 40 00 40 00 40 00 40 00 40 00 40 00 40 00 40 00 40 00 40 00 40 00 40 00 40 00 40 00 40 00 40 00 40 00 40 00 40 00 40 00 40 00 40 00 40 00 40 00 40 00 40 00 40 00 40 00 40 00 40 00 40 00 40 00 40 00 40 00 40 00 40 00 40 00 40 00 40 00 40 00 40 00 40 00 40 00 40 00 40 00 40 00 40 00 40 00 40 00 40 00 40 00 40 00 40 00 40 00 40
					29 01 00 00 00 00 b5 D4 01 45 01 45 01 45 02 44 02 44 02 44 03 44 04 43 04 43 04 43 05 43 05 43 05 42 05 42 06 42 06 42 05 42 05 41 03 41 03 41 02 41 02 41 01 40 01 40 00 40 00 40 ff 40 ff 3f fe 3f fe 3f fd 3f fd 3f fc 3f fc 40 fc 40 fa 40 fa 40 fa 41 f9 41 f9 41 f9 41 f8 42 f8 42 f7 42 f7 42 f7 43 f6 44 f5 45 f5 46 f4 47 f3 48 f3 49 f2 4a f1 4b f1 4c f0 4d ef 4e ef 4f ee 50 ed 51 ed 52 ed 53 ed 54 ed 55 ee 56 ed 57 ed 58 ed 59 ed 5a ee 5c ee 5d ee 5e ee 5f ed 60 ef 61 ef 61 f0 5f f1 5d f3 5b f4 58 f6 56 f7 54 f9 52 fa 50 fb 4d fc 4b fd 49 fe 46 ff 44 ff 42
					29 01 00 00 00 00 b5 D4 00 40 00 40 00 40 00 40 00 40 00 40 00 40 00 40 00 40 00 40 00 40 00 40 00 40 00 40 00 40 00 40 00 40 00 40 00 40 00 40 00 40 00 40 00 40 00 40 00 40 00 40 00 40 00 40 00 40 00 40 00 40 00 40 ff 40 ff 40 ff 40 ff 40 ff 40 fe 40 fe 40 fe 40 fe 40 fe 40 fd 40 fd 40 fd 40 fd 40 fd 40 fd 40 fe 40 fe 40 fe 40 fe 40 fe 40 ff 40 ff 40 ff 40 ff 40 00 40 00 40 00 40 00 40 00 40 00 41 00 41 00 41 00 41 00 41 00 42 00 42 00 42 00 42 00 43 ff 43 ff 43 ff 43 ff 43 ff 44 ff 44 00 44 00 44 00 44 00 44 00 44 00 44 00 44 00 45 00 45 00 45 01 45 01 45
					29 01 00 00 00 00 02 00 00
					29 01 00 00 00 00 b5 D5 00 40 00 40 00 40 00 40 00 40 00 40 00 40 00 40 00 40 00 40 00 40 00 40 00 40 00 40 00 40 ff 40 ff 41 ff 41 ff 42 ff 42 ff 43 fe 44 fe 44 fe 45 fe 45 fe 46 fe 46 fd 47 fc 47 fc 48 fc 48 fc 49 fb 49 fb 4a fb 4a f9 4b f9 4b f9 4b f8 4c f8 4c f7 4d f7 4d f6 4e f6 4e f5 4e f5 4f f5 4e f5 4e f5 4e f5 4e f5 4e f5 4e f4 4d f4 4d f4 4d f4 4d f4 4c f4 4c f4 4c f4 4c f4 4c f4 4c f4 4d f4 4d f4 4e f4 4e f4 4e f4 4f f3 4f f3 50 f3 50 f3 51 f3 51 f3 51 f3 52 f3 52 f5 51 f5 50 f6 4e f7 4d f8 4c f9 4b fa 4a fb 48 fc 47 fc 46 fe 45 fe 43 ff 42 ff 41
					29 01 00 00 00 00 b5 D5 00 40 00 40 00 40 00 40 00 40 00 40 00 40 00 40 00 40 00 40 00 40 00 40 00 40 00 40 00 40 00 40 00 40 00 40 00 40 00 40 00 40 00 40 00 40 00 40 00 40 00 40 00 40 00 40 00 40 00 40 00 40 00 40 00 40 00 40 00 40 00 40 00 40 00 40 00 40 00 40 00 40 00 40 00 40 00 40 00 40 00 40 00 40 00 40 00 40 00 40 00 40 00 40 00 40 00 40 00 40 00 40 00 40 00 40 00 40 00 40 00 40 00 41 00 42 01 43 01 45 01 46 01 47 01 48 01 49 01 4a 01 4b 02 4c 03 4d 03 4e 03 4f 03 50 03 4f 03 4e 03 4c 01 4b 01 4a 01 49 01 48 01 47 01 46 01 45 01 44 00 43 00 42 00 41
					29 01 00 00 00 00 b5 D5 04 50 04 4f 04 4e 04 4d 04 4c 04 4b 04 4a 04 49 04 48 04 47 05 46 05 45 05 44 05 43 05 42 04 41 05 41 04 40 04 40 04 3f 04 3f 04 3e 04 3e 04 3d 05 3d 05 3c 05 3c 05 3b 05 3b 05 3a 05 3a 04 3a 03 3a 02 3a 02 3b 01 3b ff 3b ff 3b fe 3b fd 3b fc 3b fb 3c fa 3c f9 3c f9 3c f8 3c f8 3c f8 3c f8 3b f7 3b f7 3b f7 3b f7 3b f7 3b f7 3b f6 3b f6 3b f6 3b f6 3a f6 3a f6 3a f6 3a f6 3a f6 3a f6 3a f6 3a f5 39 f5 39 f5 39 f5 39 f5 39 f5 39 f5 39 f5 39 f5 38 f5 38 f6 39 f7 3a f7 3a f8 3b f9 3b f9 3c fa 3c fb 3d fc 3d fc 3e fd 3e fe 3f ff 3f ff 40
					29 01 00 00 00 00 b5 D5 00 40 00 40 00 40 00 40 00 40 00 40 00 40 00 40 00 40 00 40 00 40 00 40 00 40 00 40 00 40 00 40 00 40 00 40 00 40 00 40 00 40 00 40 00 40 00 40 00 40 00 40 00 40 00 40 00 40 00 40 00 40 ff 40 ff 40 ff 40 fe 40 fe 40 fe 40 fd 40 fd 40 fd 40 fc 40 fc 40 fc 40 fb 40 fa 40 fa 40 fa 40 fc 40 fc 40 fc 40 fd 40 fd 40 fd 40 fe 40 fe 40 fe 40 ff 40 ff 40 ff 40 ff 40 00 40 00 41 00 42 00 43 00 43 01 44 01 45 01 46 01 47 01 48 01 48 01 49 02 4a 03 4b 03 4c 03 4c 03 4c 03 4d 03 4d 03 4d 03 4d 03 4e 03 4e 04 4e 04 4e 04 4f 04 4f 04 4f 04 4f 04 50
					15 01 00 00 00 00 02 81 80
					29 01 00 00 00 00 02 00 80
					29 01 00 00 00 00 03 FF 00 00
					29 01 00 00 00 00 02 00 00
					29 01 00 00 00 00 04 FF 00 00 00
					29 01 00 00 00 00 03 44 07 70
					15 01 00 00 00 00 02 35 00
					05 01 00 00 78 00 02 11 00
					05 01 00 00 00 00 02 29 00
					29 01 00 00 05 00 03 99 00 00];
		qcom,mdss-dsi-off-command = [29 01 00 00 05 00 03 99 95 27
                               05 01 00 00 14 00 02 28 00
                               05 01 00 00 78 00 02 10 00];
		qcom,mdss-dsi-on-command-state = "dsi_lp_mode";
		qcom,mdss-dsi-off-command-state = "dsi_lp_mode";
		qcom,mdss-dsi-h-sync-pulse = <1>;
		qcom,mdss-dsi-traffic-mode = "burst_mode";
		qcom,mdss-dsi-lane-map = "lane_map_0123";
		qcom,mdss-dsi-bllp-eof-power-mode;
		qcom,mdss-dsi-bllp-power-mode;
		qcom,mdss-dsi-lane-0-state;
		qcom,mdss-dsi-lane-1-state;
		qcom,mdss-dsi-lane-2-state;
		qcom,mdss-dsi-lane-3-state;
		qcom,mdss-dsi-te-pin-select = <1>;
		qcom,mdss-dsi-te-v-sync-rd-ptr-irq-line = <0x2c>;
		qcom,mdss-dsi-te-dcs-command = <1>;
		qcom,mdss-dsi-te-check-enable;
		qcom,mdss-dsi-te-using-te-pin;
		qcom,mdss-dsi-panel-timings = [23 1E 08 09 05 03 04 A0
	23 1E 08 09 05 03 04 A0
	23 1E 08 09 05 03 04 A0
	23 1E 08 09 05 03 04 A0
	23 1A 08 09 05 03 04 A0];
		qcom,mdss-dsi-t-clk-post = <0x2C>;
		qcom,mdss-dsi-t-clk-pre = <0x2B>;
		qcom,mdss-dsi-bl-min-level = <30>;
		qcom,mdss-dsi-bl-max-level = <3800>;
		qcom,mdss-brightness-max-level = <3800>;
		qcom,mdss-dsi-dma-trigger = "trigger_sw";
		qcom,mdss-dsi-mdp-trigger = "none";
		qcom,mdss-dsi-bl-pmic-control-type = "bl_ctrl_wled";
		qcom,panel-dot-inversion-mode-cmds = [29 01 00 00 00 00 02 00 00
                          29 01 00 00 00 00 04 FF 19 06 01
                          29 01 00 00 00 00 02 00 80
                          29 01 00 00 00 00 03 FF 19 06
                          29 01 00 00 00 00 02 00 B3
                          29 01 00 00 00 00 02 C0 00
                          29 01 00 00 00 00 02 00 00
                          29 01 00 00 00 00 02 FB 01
                          29 01 00 00 00 00 02 00 00
                          29 01 00 00 00 00 04 FF FF FF FF];
		qcom,panel-column-inversion-mode-cmds = [29 01 00 00 00 00 02 00 00
                             29 01 00 00 00 00 04 FF 19 06 01
                             29 01 00 00 00 00 02 00 80
                             29 01 00 00 00 00 03 FF 19 06
                             29 01 00 00 00 00 02 00 B3
                             29 01 00 00 00 00 02 C0 88
                             29 01 00 00 00 00 02 00 00
                             29 01 00 00 00 00 02 FB 01
                             29 01 00 00 00 00 02 00 00
                             29 01 00 00 00 00 04 FF FF FF FF];
		qcom,dot-inversion-cmds-dsi-state = "dsi_lp_mode";
		qcom,column-inversion-cmds-dsi-state = "dsi_lp_mode";
		qcom,panel-esd-check-enabled;
		qcom,panel-esd-read-commands = [06 01 00 01 05 00 02 0A 9C];
		qcom,esd-read-cmds-state = "dsi_hs_mode";
		qcom,mdss-dsi-lp11-init;
		qcom,mdss-dsi-tp-pre-lcd-enable;
		qcom,mdss-pan-physical-width-dimension = <68>;
		qcom,mdss-pan-physical-height-dimension = <121>;
		huawei,delaytime-before-bl = <80>;
		huawei,long-read-flag = <1>;
		huawei,reg-read-expect-value = <0x9C>;
		huawei,reg-long-read-count = <3>;
		qcom,mdss-dsi-reset-sequence = <1 5>, <0 5>, <1 5>;

	};
};
