#include "huawei-battery.dtsi"
#include "usb_short_circuit_protect.dtsi"
#include "huawei-tp.dtsi"
#include "huawei-fac.dtsi"
#include "huawei-audio.dtsi"
#include "huawei-wifi.dtsi"
#include "huawei-camera.dtsi"
#include "gpio-led.dtsi"
#include "huawei-i2c-detect-va.dtsi"
#include "huawei-sensors.dtsi"
#include "huawei-bt.dtsi"
#include "huawei-usb.dtsi"
#include "huawei-antenna-boardid-gpio.dtsi"
#include "huawei-fm.dtsi"
