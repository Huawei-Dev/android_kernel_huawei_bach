/* Copyright (c) 2013, The Linux Foundation. All rights reserved.
 *
 * This program is free software; you can redistribute it and/or modify
 * it under the terms of the GNU General Public License version 2 and
 * only version 2 as published by the Free Software Foundation.
 *
 * This program is distributed in the hope that it will be useful,
 * but WITHOUT ANY WARRANTY; without even the implied warranty of
 * MERCHANTABILITY or FITNESS FOR A PARTICULAR PURPOSE.  See the
 * GNU General Public License for more details.
 */

/*---------------------------------------------------------------------------
 * This file is autogenerated file using gcdb parser. Please do not edit it.
 * Update input XML file to add a new entry or update variable in this file
 * VERSION = "1.0"
 *---------------------------------------------------------------------------*/
&mdss_mdp {
	dsi_ctc_nt35596s_5p5_1080p_video: qcom,mdss_dsi_ctc_nt35596s_5p5_1080p_video {
		qcom,mdss-dsi-panel-name = "CTC_NT35596S_5P5_1080P_VIDEO";
		qcom,cont-splash-enabled;
		qcom,mdss-dsi-panel-controller = <&mdss_dsi0>;
		qcom,panel-supply-entries = <&dsi_panel_pwr_supply>;
		qcom,mdss-dsi-panel-type = "dsi_video_mode";
		qcom,mdss-dsi-panel-destination = "display_1";
		qcom,mdss-dsi-panel-clockrate = <898000000>;
		qcom,mdss-dsi-panel-framerate = <60>;
		qcom,mdss-dsi-virtual-channel-id = <0>;
		qcom,mdss-dsi-stream = <0>;
		qcom,mdss-dsi-panel-width = <1080>;
		qcom,mdss-dsi-panel-height = <1920>;
		qcom,mdss-dsi-h-front-porch = <114>;
		qcom,mdss-dsi-h-back-porch = <80>;
		qcom,mdss-dsi-h-pulse-width = <8>;
		qcom,mdss-dsi-h-sync-skew = <0>;
		qcom,mdss-dsi-v-back-porch = <6>;
		qcom,mdss-dsi-v-front-porch = <8>;
		qcom,mdss-dsi-v-pulse-width = <4>;
		qcom,mdss-dsi-h-left-border = <0>;
		qcom,mdss-dsi-h-right-border = <0>;
		qcom,mdss-dsi-v-top-border = <0>;
		qcom,mdss-dsi-v-bottom-border = <0>;
		qcom,mdss-dsi-bpp = <24>;
		qcom,mdss-dsi-underflow-color = <0x00>;
		qcom,mdss-dsi-border-color = <0>;
		qcom,mdss-dsi-color-order = "rgb_swap_rgb";
		qcom,mdss-dsi-on-command = [39 01 00 00 00 00 02 FF E0
									39 01 00 00 00 00 02 FB 01
									39 01 00 00 00 00 02 16 C0
									39 01 00 00 00 00 02 FF F0
									39 01 00 00 00 00 02 FB 01
									39 01 00 00 00 00 02 E5 02
									39 01 00 00 00 00 02 FF F0
									29 01 00 00 00 00 02 FB 01
									29 01 00 00 00 00 02 E5 02
									29 01 00 00 00 00 02 FF E0
									29 01 00 00 00 00 02 FB 01
									29 01 00 00 00 00 02 15 80
									29 01 00 00 00 00 02 16 C0
									29 01 00 00 00 00 02 6F E0
									29 01 00 00 00 00 02 FF 20
									29 01 00 00 00 00 02 FB 01
									29 01 00 00 00 00 02 75 00
									29 01 00 00 00 00 02 76 00
									29 01 00 00 00 00 02 77 00
									29 01 00 00 00 00 02 78 16
									29 01 00 00 00 00 02 79 00
									29 01 00 00 00 00 02 7A 3A
									29 01 00 00 00 00 02 7B 00
									29 01 00 00 00 00 02 7C 58
									29 01 00 00 00 00 02 7D 00
									29 01 00 00 00 00 02 7E 72
									29 01 00 00 00 00 02 7F 00
									29 01 00 00 00 00 02 80 88
									29 01 00 00 00 00 02 81 00
									29 01 00 00 00 00 02 82 9C
									29 01 00 00 00 00 02 83 00
									29 01 00 00 00 00 02 84 B2
									29 01 00 00 00 00 02 85 00
									29 01 00 00 00 00 02 86 C4
									29 01 00 00 00 00 02 87 00
									29 01 00 00 00 00 02 88 F9
									29 01 00 00 00 00 02 89 01
									29 01 00 00 00 00 02 8A 25
									29 01 00 00 00 00 02 8B 01
									29 01 00 00 00 00 02 8C 63
									29 01 00 00 00 00 02 8D 01
									29 01 00 00 00 00 02 8E 97
									29 01 00 00 00 00 02 8F 01
									29 01 00 00 00 00 02 90 DE
									29 01 00 00 00 00 02 91 02
									29 01 00 00 00 00 02 92 1B
									29 01 00 00 00 00 02 93 02
									29 01 00 00 00 00 02 94 1C
									29 01 00 00 00 00 02 95 02
									29 01 00 00 00 00 02 96 5C
									29 01 00 00 00 00 02 97 02
									29 01 00 00 00 00 02 98 A2
									29 01 00 00 00 00 02 99 02
									29 01 00 00 00 00 02 9A CF
									29 01 00 00 00 00 02 9B 03
									29 01 00 00 00 00 02 9C 03
									29 01 00 00 00 00 02 9D 03
									29 01 00 00 00 00 02 9E 21
									29 01 00 00 00 00 02 9F 03
									29 01 00 00 00 00 02 A0 4A
									29 01 00 00 00 00 02 A2 03
									29 01 00 00 00 00 02 A3 55
									29 01 00 00 00 00 02 A4 03
									29 01 00 00 00 00 02 A5 65
									29 01 00 00 00 00 02 A6 03
									29 01 00 00 00 00 02 A7 77
									29 01 00 00 00 00 02 A9 03
									29 01 00 00 00 00 02 AA 8D
									29 01 00 00 00 00 02 AB 03
									29 01 00 00 00 00 02 AC A6
									29 01 00 00 00 00 02 AD 03
									29 01 00 00 00 00 02 AE C3
									29 01 00 00 00 00 02 AF 03
									29 01 00 00 00 00 02 B0 E6
									29 01 00 00 00 00 02 B1 03
									29 01 00 00 00 00 02 B2 EC
									29 01 00 00 00 00 02 B3 00
									29 01 00 00 00 00 02 B4 00
									29 01 00 00 00 00 02 B5 00
									29 01 00 00 00 00 02 B6 17
									29 01 00 00 00 00 02 B7 00
									29 01 00 00 00 00 02 B8 3B
									29 01 00 00 00 00 02 B9 00
									29 01 00 00 00 00 02 BA 59
									29 01 00 00 00 00 02 BB 00
									29 01 00 00 00 00 02 BC 73
									29 01 00 00 00 00 02 BD 00
									29 01 00 00 00 00 02 BE 89
									29 01 00 00 00 00 02 BF 00
									29 01 00 00 00 00 02 C0 9D
									29 01 00 00 00 00 02 C1 00
									29 01 00 00 00 00 02 C2 B3
									29 01 00 00 00 00 02 C3 00
									29 01 00 00 00 00 02 C4 C5
									29 01 00 00 00 00 02 C5 00
									29 01 00 00 00 00 02 C6 FA
									29 01 00 00 00 00 02 C7 01
									29 01 00 00 00 00 02 C8 28
									29 01 00 00 00 00 02 C9 01
									29 01 00 00 00 00 02 CA 66
									29 01 00 00 00 00 02 CB 01
									29 01 00 00 00 00 02 CC 9C
									29 01 00 00 00 00 02 CD 01
									29 01 00 00 00 00 02 CE E4
									29 01 00 00 00 00 02 CF 02
									29 01 00 00 00 00 02 D0 22
									29 01 00 00 00 00 02 D1 02
									29 01 00 00 00 00 02 D2 24
									29 01 00 00 00 00 02 D3 02
									29 01 00 00 00 00 02 D4 61
									29 01 00 00 00 00 02 D5 02
									29 01 00 00 00 00 02 D6 A3
									29 01 00 00 00 00 02 D7 02
									29 01 00 00 00 00 02 D8 CF
									29 01 00 00 00 00 02 D9 03
									29 01 00 00 00 00 02 DA 03
									29 01 00 00 00 00 02 DB 03
									29 01 00 00 00 00 02 DC 21
									29 01 00 00 00 00 02 DD 03
									29 01 00 00 00 00 02 DE 4A
									29 01 00 00 00 00 02 DF 03
									29 01 00 00 00 00 02 E0 55
									29 01 00 00 00 00 02 E1 03
									29 01 00 00 00 00 02 E2 65
									29 01 00 00 00 00 02 E3 03
									29 01 00 00 00 00 02 E4 74
									29 01 00 00 00 00 02 E5 03
									29 01 00 00 00 00 02 E6 82
									29 01 00 00 00 00 02 E7 03
									29 01 00 00 00 00 02 E8 93
									29 01 00 00 00 00 02 E9 03
									29 01 00 00 00 00 02 EA A8
									29 01 00 00 00 00 02 EB 03
									29 01 00 00 00 00 02 EC C3
									29 01 00 00 00 00 02 ED 03
									29 01 00 00 00 00 02 EE C5
									29 01 00 00 00 00 02 EF 00
									29 01 00 00 00 00 02 F0 00
									29 01 00 00 00 00 02 F1 00
									29 01 00 00 00 00 02 F2 16
									29 01 00 00 00 00 02 F3 00
									29 01 00 00 00 00 02 F4 3A
									29 01 00 00 00 00 02 F5 00
									29 01 00 00 00 00 02 F6 58
									29 01 00 00 00 00 02 F7 00
									29 01 00 00 00 00 02 F8 72
									29 01 00 00 00 00 02 F9 00
									29 01 00 00 00 00 02 FA 88
									29 01 00 00 00 00 02 FF 21
									29 01 00 00 00 00 02 FB 01
									29 01 00 00 00 00 02 00 00
									29 01 00 00 00 00 02 01 9C
									29 01 00 00 00 00 02 02 00
									29 01 00 00 00 00 02 03 B2
									29 01 00 00 00 00 02 04 00
									29 01 00 00 00 00 02 05 C4
									29 01 00 00 00 00 02 06 00
									29 01 00 00 00 00 02 07 F9
									29 01 00 00 00 00 02 08 01
									29 01 00 00 00 00 02 09 25
									29 01 00 00 00 00 02 0A 01
									29 01 00 00 00 00 02 0B 63
									29 01 00 00 00 00 02 0C 01
									29 01 00 00 00 00 02 0D 97
									29 01 00 00 00 00 02 0E 01
									29 01 00 00 00 00 02 0F DE
									29 01 00 00 00 00 02 10 02
									29 01 00 00 00 00 02 11 1B
									29 01 00 00 00 00 02 12 02
									29 01 00 00 00 00 02 13 1C
									29 01 00 00 00 00 02 14 02
									29 01 00 00 00 00 02 15 5C
									29 01 00 00 00 00 02 16 02
									29 01 00 00 00 00 02 17 A2
									29 01 00 00 00 00 02 18 02
									29 01 00 00 00 00 02 19 CF
									29 01 00 00 00 00 02 1A 03
									29 01 00 00 00 00 02 1B 03
									29 01 00 00 00 00 02 1C 03
									29 01 00 00 00 00 02 1D 21
									29 01 00 00 00 00 02 1E 03
									29 01 00 00 00 00 02 1F 4A
									29 01 00 00 00 00 02 20 03
									29 01 00 00 00 00 02 21 55
									29 01 00 00 00 00 02 22 03
									29 01 00 00 00 00 02 23 65
									29 01 00 00 00 00 02 24 03
									29 01 00 00 00 00 02 25 77
									29 01 00 00 00 00 02 26 03
									29 01 00 00 00 00 02 27 8D
									29 01 00 00 00 00 02 28 03
									29 01 00 00 00 00 02 29 A6
									29 01 00 00 00 00 02 2A 03
									29 01 00 00 00 00 02 2B C3
									29 01 00 00 00 00 02 2D 03
									29 01 00 00 00 00 02 2F E6
									29 01 00 00 00 00 02 30 03
									29 01 00 00 00 00 02 31 EC
									29 01 00 00 00 00 02 32 00
									29 01 00 00 00 00 02 33 00
									29 01 00 00 00 00 02 34 00
									29 01 00 00 00 00 02 35 17
									29 01 00 00 00 00 02 36 00
									29 01 00 00 00 00 02 37 3B
									29 01 00 00 00 00 02 38 00
									29 01 00 00 00 00 02 39 59
									29 01 00 00 00 00 02 3A 00
									29 01 00 00 00 00 02 3B 73
									29 01 00 00 00 00 02 3D 00
									29 01 00 00 00 00 02 3F 89
									29 01 00 00 00 00 02 40 00
									29 01 00 00 00 00 02 41 9D
									29 01 00 00 00 00 02 42 00
									29 01 00 00 00 00 02 43 B3
									29 01 00 00 00 00 02 44 00
									29 01 00 00 00 00 02 45 C5
									29 01 00 00 00 00 02 46 00
									29 01 00 00 00 00 02 47 FA
									29 01 00 00 00 00 02 48 01
									29 01 00 00 00 00 02 49 28
									29 01 00 00 00 00 02 4A 01
									29 01 00 00 00 00 02 4B 66
									29 01 00 00 00 00 02 4C 01
									29 01 00 00 00 00 02 4D 9C
									29 01 00 00 00 00 02 4E 01
									29 01 00 00 00 00 02 4F E4
									29 01 00 00 00 00 02 50 02
									29 01 00 00 00 00 02 51 22
									29 01 00 00 00 00 02 52 02
									29 01 00 00 00 00 02 53 24
									29 01 00 00 00 00 02 54 02
									29 01 00 00 00 00 02 55 61
									29 01 00 00 00 00 02 56 02
									29 01 00 00 00 00 02 58 A3
									29 01 00 00 00 00 02 59 02
									29 01 00 00 00 00 02 5A CF
									29 01 00 00 00 00 02 5B 03
									29 01 00 00 00 00 02 5C 03
									29 01 00 00 00 00 02 5D 03
									29 01 00 00 00 00 02 5E 21
									29 01 00 00 00 00 02 5F 03
									29 01 00 00 00 00 02 60 4A
									29 01 00 00 00 00 02 61 03
									29 01 00 00 00 00 02 62 55
									29 01 00 00 00 00 02 63 03
									29 01 00 00 00 00 02 64 65
									29 01 00 00 00 00 02 65 03
									29 01 00 00 00 00 02 66 74
									29 01 00 00 00 00 02 67 03
									29 01 00 00 00 00 02 68 82
									29 01 00 00 00 00 02 69 03
									29 01 00 00 00 00 02 6A 93
									29 01 00 00 00 00 02 6B 03
									29 01 00 00 00 00 02 6C A8
									29 01 00 00 00 00 02 6D 03
									29 01 00 00 00 00 02 6E C3
									29 01 00 00 00 00 02 6F 03
									29 01 00 00 00 00 02 70 C5
									29 01 00 00 00 00 02 71 00
									29 01 00 00 00 00 02 72 00
									29 01 00 00 00 00 02 73 00
									29 01 00 00 00 00 02 74 16
									29 01 00 00 00 00 02 75 00
									29 01 00 00 00 00 02 76 3A
									29 01 00 00 00 00 02 77 00
									29 01 00 00 00 00 02 78 58
									29 01 00 00 00 00 02 79 00
									29 01 00 00 00 00 02 7A 72
									29 01 00 00 00 00 02 7B 00
									29 01 00 00 00 00 02 7C 88
									29 01 00 00 00 00 02 7D 00
									29 01 00 00 00 00 02 7E 9C
									29 01 00 00 00 00 02 7F 00
									29 01 00 00 00 00 02 80 B2
									29 01 00 00 00 00 02 81 00
									29 01 00 00 00 00 02 82 C4
									29 01 00 00 00 00 02 83 00
									29 01 00 00 00 00 02 84 F9
									29 01 00 00 00 00 02 85 01
									29 01 00 00 00 00 02 86 25
									29 01 00 00 00 00 02 87 01
									29 01 00 00 00 00 02 88 63
									29 01 00 00 00 00 02 89 01
									29 01 00 00 00 00 02 8A 97
									29 01 00 00 00 00 02 8B 01
									29 01 00 00 00 00 02 8C DE
									29 01 00 00 00 00 02 8D 02
									29 01 00 00 00 00 02 8E 1B
									29 01 00 00 00 00 02 8F 02
									29 01 00 00 00 00 02 90 1C
									29 01 00 00 00 00 02 91 02
									29 01 00 00 00 00 02 92 5C
									29 01 00 00 00 00 02 93 02
									29 01 00 00 00 00 02 94 A2
									29 01 00 00 00 00 02 95 02
									29 01 00 00 00 00 02 96 CF
									29 01 00 00 00 00 02 97 03
									29 01 00 00 00 00 02 98 03
									29 01 00 00 00 00 02 99 03
									29 01 00 00 00 00 02 9A 21
									29 01 00 00 00 00 02 9B 03
									29 01 00 00 00 00 02 9C 4A
									29 01 00 00 00 00 02 9D 03
									29 01 00 00 00 00 02 9E 55
									29 01 00 00 00 00 02 9F 03
									29 01 00 00 00 00 02 A0 65
									29 01 00 00 00 00 02 A2 03
									29 01 00 00 00 00 02 A3 77
									29 01 00 00 00 00 02 A4 03
									29 01 00 00 00 00 02 A5 8D
									29 01 00 00 00 00 02 A6 03
									29 01 00 00 00 00 02 A7 A6
									29 01 00 00 00 00 02 A9 03
									29 01 00 00 00 00 02 AA C3
									29 01 00 00 00 00 02 AB 03
									29 01 00 00 00 00 02 AC E6
									29 01 00 00 00 00 02 AD 03
									29 01 00 00 00 00 02 AE EC
									29 01 00 00 00 00 02 AF 00
									29 01 00 00 00 00 02 B0 00
									29 01 00 00 00 00 02 B1 00
									29 01 00 00 00 00 02 B2 17
									29 01 00 00 00 00 02 B3 00
									29 01 00 00 00 00 02 B4 3B
									29 01 00 00 00 00 02 B5 00
									29 01 00 00 00 00 02 B6 59
									29 01 00 00 00 00 02 B7 00
									29 01 00 00 00 00 02 B8 73
									29 01 00 00 00 00 02 B9 00
									29 01 00 00 00 00 02 BA 89
									29 01 00 00 00 00 02 BB 00
									29 01 00 00 00 00 02 BC 9D
									29 01 00 00 00 00 02 BD 00
									29 01 00 00 00 00 02 BE B3
									29 01 00 00 00 00 02 BF 00
									29 01 00 00 00 00 02 C0 C5
									29 01 00 00 00 00 02 C1 00
									29 01 00 00 00 00 02 C2 FA
									29 01 00 00 00 00 02 C3 01
									29 01 00 00 00 00 02 C4 28
									29 01 00 00 00 00 02 C5 01
									29 01 00 00 00 00 02 C6 66
									29 01 00 00 00 00 02 C7 01
									29 01 00 00 00 00 02 C8 9C
									29 01 00 00 00 00 02 C9 01
									29 01 00 00 00 00 02 CA E4
									29 01 00 00 00 00 02 CB 02
									29 01 00 00 00 00 02 CC 22
									29 01 00 00 00 00 02 CD 02
									29 01 00 00 00 00 02 CE 24
									29 01 00 00 00 00 02 CF 02
									29 01 00 00 00 00 02 D0 61
									29 01 00 00 00 00 02 D1 02
									29 01 00 00 00 00 02 D2 A3
									29 01 00 00 00 00 02 D3 02
									29 01 00 00 00 00 02 D4 CF
									29 01 00 00 00 00 02 D5 03
									29 01 00 00 00 00 02 D6 03
									29 01 00 00 00 00 02 D7 03
									29 01 00 00 00 00 02 D8 21
									29 01 00 00 00 00 02 D9 03
									29 01 00 00 00 00 02 DA 4A
									29 01 00 00 00 00 02 DB 03
									29 01 00 00 00 00 02 DC 55
									29 01 00 00 00 00 02 DD 03
									29 01 00 00 00 00 02 DE 65
									29 01 00 00 00 00 02 DF 03
									29 01 00 00 00 00 02 E0 74
									29 01 00 00 00 00 02 E1 03
									29 01 00 00 00 00 02 E2 82
									29 01 00 00 00 00 02 E3 03
									29 01 00 00 00 00 02 E4 93
									29 01 00 00 00 00 02 E5 03
									29 01 00 00 00 00 02 E6 A8
									29 01 00 00 00 00 02 E7 03
									29 01 00 00 00 00 02 E8 C3
									29 01 00 00 00 00 02 E9 03
									29 01 00 00 00 00 02 EA C5
									29 01 00 00 00 00 02 FF 20
									29 01 00 00 00 00 02 FB 01
									29 01 00 00 00 00 02 30 10
									29 01 00 00 00 00 02 68 03
									29 01 00 00 00 00 02 01 55
									29 01 00 00 00 00 02 02 55
									29 01 00 00 00 00 02 05 50
									29 01 00 00 00 00 02 06 28
									29 01 00 00 00 00 02 07 14
									29 01 00 00 00 00 02 0B F5
									29 01 00 00 00 00 02 0C F5
									29 01 00 00 00 00 02 0E B5
									29 01 00 00 00 00 02 0F AE
									29 01 00 00 00 00 02 11 A5
									29 01 00 00 00 00 02 12 A5
									29 01 00 00 00 00 02 13 00
									29 01 00 00 00 00 02 1F FC
									29 01 00 00 00 00 02 20 03
									29 01 00 00 00 00 02 58 00
									29 01 00 00 00 00 02 59 00
									29 01 00 00 00 00 02 5A 00
									29 01 00 00 00 00 02 5B 00
									29 01 00 00 00 00 02 5C 82
									29 01 00 00 00 00 02 5D 82
									29 01 00 00 00 00 02 5E 00
									29 01 00 00 00 00 02 5F 02
									29 01 00 00 00 00 02 60 00
									29 01 00 00 00 00 02 61 00
									29 01 00 00 00 00 02 62 02
									29 01 00 00 00 00 02 63 02
									29 01 00 00 00 00 02 15 01
									29 01 00 00 00 00 02 FF 24
									29 01 00 00 00 00 02 FB 01
									29 01 00 00 00 00 02 00 9C
									29 01 00 00 00 00 02 01 10
									29 01 00 00 00 00 02 02 01
									29 01 00 00 00 00 02 03 06
									29 01 00 00 00 00 02 04 05
									29 01 00 00 00 00 02 05 04
									29 01 00 00 00 00 02 06 03
									29 01 00 00 00 00 02 07 11
									29 01 00 00 00 00 02 08 92
									29 01 00 00 00 00 02 09 00
									29 01 00 00 00 00 02 0A 14
									29 01 00 00 00 00 02 0B 16
									29 01 00 00 00 00 02 0C 18
									29 01 00 00 00 00 02 0D 13
									29 01 00 00 00 00 02 0E 15
									29 01 00 00 00 00 02 0F 17
									29 01 00 00 00 00 02 10 9C
									29 01 00 00 00 00 02 11 10
									29 01 00 00 00 00 02 12 01
									29 01 00 00 00 00 02 13 06
									29 01 00 00 00 00 02 14 05
									29 01 00 00 00 00 02 15 04
									29 01 00 00 00 00 02 16 03
									29 01 00 00 00 00 02 17 11
									29 01 00 00 00 00 02 18 92
									29 01 00 00 00 00 02 19 00
									29 01 00 00 00 00 02 1A 14
									29 01 00 00 00 00 02 1B 16
									29 01 00 00 00 00 02 1C 18
									29 01 00 00 00 00 02 1D 13
									29 01 00 00 00 00 02 1E 15
									29 01 00 00 00 00 02 1F 17
									29 01 00 00 00 00 02 20 09
									29 01 00 00 00 00 02 21 01
									29 01 00 00 00 00 02 22 01
									29 01 00 00 00 00 02 23 03
									29 01 00 00 00 00 02 24 63
									29 01 00 00 00 00 02 25 5D
									29 01 00 00 00 00 02 26 03
									29 01 00 00 00 00 02 27 63
									29 01 00 00 00 00 02 2F 00
									29 01 00 00 00 00 02 30 02
									29 01 00 00 00 00 02 31 49
									29 01 00 00 00 00 02 32 48
									29 01 00 00 00 00 02 33 01
									29 01 00 00 00 00 02 34 03
									29 01 00 00 00 00 02 35 63
									29 01 00 00 00 00 02 36 00
									29 01 00 00 00 00 02 37 1D
									29 01 00 00 00 00 02 38 08
									29 01 00 00 00 00 02 39 03
									29 01 00 00 00 00 02 3A 63
									29 01 00 00 00 00 02 3B 48
									29 01 00 00 00 00 02 5B 00
									29 01 00 00 00 00 02 5F 4D
									29 01 00 00 00 00 02 63 00
									29 01 00 00 00 00 02 68 04
									29 01 00 00 00 00 02 5C 00
									29 01 00 00 00 00 02 60 6D
									29 01 00 00 00 00 02 64 00
									29 01 00 00 00 00 02 69 04
									29 01 00 00 00 00 02 5E 00
									29 01 00 00 00 00 02 62 0D
									29 01 00 00 00 00 02 66 00
									29 01 00 00 00 00 02 6B 04
									29 01 00 00 00 00 02 74 03
									29 01 00 00 00 00 02 75 1F
									29 01 00 00 00 00 02 76 04
									29 01 00 00 00 00 02 77 00
									29 01 00 00 00 00 02 78 00
									29 01 00 00 00 00 02 79 00
									29 01 00 00 00 00 02 7A 00
									29 01 00 00 00 00 02 7B 00
									29 01 00 00 00 00 02 7C D8
									29 01 00 00 00 00 02 7D 10
									29 01 00 00 00 00 02 7E 03
									29 01 00 00 00 00 02 7F 1F
									29 01 00 00 00 00 02 80 00
									29 01 00 00 00 00 02 81 04
									29 01 00 00 00 00 02 82 00
									29 01 00 00 00 00 02 83 00
									29 01 00 00 00 00 02 84 03
									29 01 00 00 00 00 02 85 03
									29 01 00 00 00 00 02 86 5B
									29 01 00 00 00 00 02 87 1B
									29 01 00 00 00 00 02 88 1B
									29 01 00 00 00 00 02 89 1B
									29 01 00 00 00 00 02 8A FF
									29 01 00 00 00 00 02 8B F0
									29 01 00 00 00 00 02 8C 00
									29 01 00 00 00 00 02 9B FF
									29 01 00 00 00 00 02 9D 30
									29 01 00 00 00 00 02 B3 00
									29 01 00 00 00 00 02 B4 00
									29 01 00 00 00 00 02 B5 05
									29 01 00 00 00 00 02 72 00
									29 01 00 00 00 00 02 73 00
									29 01 00 00 00 00 02 90 76
									29 01 00 00 00 00 02 91 40
									29 01 00 00 00 00 02 92 76
									29 01 00 00 00 00 02 93 04
									29 01 00 00 00 00 02 94 04
									29 01 00 00 00 00 02 95 FF
									29 01 00 00 00 00 02 97 00
									29 01 00 00 00 00 02 B9 02
									29 01 00 00 00 00 02 BA 82
									29 01 00 00 00 00 02 C4 24
									29 01 00 00 00 00 02 C5 3A
									29 01 00 00 00 00 02 C6 09
									29 01 00 00 00 00 02 DC 21
									29 01 00 00 00 00 02 DD 21
									29 01 00 00 00 00 02 DE 03
									29 01 00 00 00 00 02 DF 68
									29 01 00 00 00 00 02 E0 00
									29 01 00 00 00 00 02 E1 03
									29 01 00 00 00 00 02 E2 68
									29 01 00 00 00 00 02 E3 5D
									29 01 00 00 00 00 02 FF 2E
									29 01 00 00 00 00 02 FB 01
									29 01 00 00 00 00 02 00 29
									29 01 00 00 00 00 02 01 30
									29 01 00 00 00 00 02 02 18
									29 01 00 00 00 00 02 03 0A
									29 01 00 00 00 00 02 04 01
									29 01 00 00 00 00 02 05 25
									29 01 00 00 00 00 02 06 30
									29 01 00 00 00 00 02 07 06
									29 01 00 00 00 00 02 08 88
									29 01 00 00 00 00 02 09 C8
									29 01 00 00 00 00 02 0A 00
									29 01 00 00 00 00 02 F3 91
									29 01 00 00 00 00 02 0B 0C
									29 01 00 00 00 00 02 0C 6C
									29 01 00 00 00 00 02 0D 1E
									29 01 00 00 00 00 02 0E 1E
									29 01 00 00 00 00 02 0F 01
									29 01 00 00 00 00 02 10 BA
									29 01 00 00 00 00 02 11 09
									29 01 00 00 00 00 02 13 00
									29 01 00 00 00 00 02 14 10
									29 01 00 00 00 00 02 15 01
									29 01 00 00 00 00 02 16 00
									29 01 00 00 00 00 02 17 00
									29 01 00 00 00 00 02 18 44
									29 01 00 00 00 00 02 19 00
									29 01 00 00 00 00 02 1A 22
									29 01 00 00 00 00 02 1B 00
									29 01 00 00 00 00 02 1C 11
									29 01 00 00 00 00 02 1D 9B
									29 01 00 00 00 00 02 1E 1E
									29 01 00 00 00 00 02 1F 22
									29 01 00 00 00 00 02 20 40
									29 01 00 00 00 00 02 21 00
									29 01 00 00 00 00 02 1E 40
									29 01 00 00 00 00 02 1F 00
									29 01 00 00 00 00 02 20 1E
									29 01 00 00 00 00 02 21 22
									29 01 00 00 00 00 02 22 00
									29 01 00 00 00 00 02 23 00
									29 01 00 00 00 00 02 24 00
									29 01 00 00 00 00 02 25 00
									29 01 00 00 00 00 02 26 00
									29 01 00 00 00 00 02 27 00
									29 01 00 00 00 00 02 28 00
									29 01 00 00 00 00 02 29 00
									29 01 00 00 00 00 02 2A 00
									29 01 00 00 00 00 02 2B 30
									29 01 00 00 00 00 02 2D 3F
									29 01 00 00 00 00 02 2F 1C
									29 01 00 00 00 00 02 30 20
									29 01 00 00 00 00 02 31 3B
									29 01 00 00 00 00 02 32 30
									29 01 00 00 00 00 02 33 85
									29 01 00 00 00 00 02 34 01
									29 01 00 00 00 00 02 35 00
									29 01 00 00 00 00 02 36 00
									29 01 00 00 00 00 02 37 00
									29 01 00 00 00 00 02 38 00
									29 01 00 00 00 00 02 39 00
									29 01 00 00 00 00 02 3A 05
									29 01 00 00 00 00 02 3D 05
									29 01 00 00 00 00 02 3B 80
									29 01 00 00 00 00 02 3F 57
									29 01 00 00 00 00 02 40 18
									29 01 00 00 00 00 02 41 07
									29 01 00 00 00 00 02 42 C5
									29 01 00 00 00 00 02 43 CD
									29 01 00 00 00 00 02 44 CD
									29 01 00 00 00 00 02 45 CD
									29 01 00 00 00 00 02 46 CD
									29 01 00 00 00 00 02 47 CD
									29 01 00 00 00 00 02 48 CD
									29 01 00 00 00 00 02 4A 00
									29 01 00 00 00 00 02 4B 22
									29 01 00 00 00 00 02 4C 00
									29 01 00 00 00 00 02 4D 00
									29 01 00 00 00 00 02 4E 30
									29 01 00 00 00 00 02 4F 11
									29 01 00 00 00 00 02 50 9B
									29 01 00 00 00 00 02 51 1E
									29 01 00 00 00 00 02 52 00
									29 01 00 00 00 00 02 53 00
									29 01 00 00 00 00 02 54 03
									29 01 00 00 00 00 02 55 00
									29 01 00 00 00 00 02 56 00
									29 01 00 00 00 00 02 58 00
									29 01 00 00 00 00 02 59 00
									29 01 00 00 00 00 02 5A 00
									29 01 00 00 00 00 02 5B 00
									29 01 00 00 00 00 02 5C 00
									29 01 00 00 00 00 02 5D 00
									29 01 00 00 00 00 02 5E 00
									29 01 00 00 00 00 02 5F 20
									29 01 00 00 00 00 02 60 1D
									29 01 00 00 00 00 02 61 38
									29 01 00 00 00 00 02 62 3C
									29 01 00 00 00 00 02 63 3B
									29 01 00 00 00 00 02 64 20
									29 01 00 00 00 00 02 65 30
									29 01 00 00 00 00 02 66 01
									29 01 00 00 00 00 02 67 00
									29 01 00 00 00 00 02 68 00
									29 01 00 00 00 00 02 69 00
									29 01 00 00 00 00 02 6B 80
									29 01 00 00 00 00 02 6C 57
									29 01 00 00 00 00 02 6D 18
									29 01 00 00 00 00 02 6E 0D
									29 01 00 00 00 00 02 6F 7E
									29 01 00 00 00 00 02 70 CD
									29 01 00 00 00 00 02 71 CD
									29 01 00 00 00 00 02 72 CD
									29 01 00 00 00 00 02 73 CD
									29 01 00 00 00 00 02 74 CD
									29 01 00 00 00 00 02 75 CD
									29 01 00 00 00 00 02 76 CD
									29 01 00 00 00 00 02 77 00
									29 01 00 00 00 00 02 D2 00
									29 01 00 00 00 00 02 D3 00
									29 01 00 00 00 00 02 D4 00
									29 01 00 00 00 00 02 D5 00
									29 01 00 00 00 00 02 D6 30
									29 01 00 00 00 00 02 D7 30
									29 01 00 00 00 00 02 D8 30
									29 01 00 00 00 00 02 D9 30
									29 01 00 00 00 00 02 DB 00
									29 01 00 00 00 00 02 E3 FF
									29 01 00 00 00 00 02 E4 03
									29 01 00 00 00 00 02 E5 00
									29 01 00 00 00 00 02 E6 00
									29 01 00 00 00 00 02 E7 06
									29 01 00 00 00 00 02 E8 00
									29 01 00 00 00 00 02 E9 06
									29 01 00 00 00 00 02 EA 00
									29 01 00 00 00 00 02 EB 06
									29 01 00 00 00 00 02 EC 00
									29 01 00 00 00 00 02 ED 0E
									29 01 00 00 00 00 02 EE 33
									29 01 00 00 00 00 02 EF 03
									29 01 00 00 00 00 02 F0 33
									29 01 00 00 00 00 02 F1 73
									29 01 00 00 00 00 02 FF 2F
									29 01 00 00 00 00 02 FB 01
									29 01 00 00 00 00 02 37 70
									29 01 00 00 00 00 02 00 00
									29 01 00 00 00 00 02 01 00
									29 01 00 00 00 00 02 02 00
									29 01 00 00 00 00 02 03 00
									29 01 00 00 00 00 02 06 00
									29 01 00 00 00 00 02 08 00
									29 01 00 00 00 00 02 0B 00
									29 01 00 00 00 00 02 04 06
									29 01 00 00 00 00 02 05 07
									29 01 00 00 00 00 02 07 02
									29 01 00 00 00 00 02 09 0B
									29 01 00 00 00 00 02 0A 00
									29 01 00 00 00 00 02 0D 00
									29 01 00 00 00 00 02 12 00
									29 01 00 00 00 00 02 0C 0B
									29 01 00 00 00 00 02 0E 00
									29 01 00 00 00 00 02 0F 02
									29 01 00 00 00 00 02 10 07
									29 01 00 00 00 00 02 11 06
									29 01 00 00 00 00 02 13 00
									29 01 00 00 00 00 02 14 44
									29 01 00 00 00 00 02 15 00
									29 01 00 00 00 00 02 16 80
									29 01 00 00 00 00 02 17 80
									29 01 00 00 00 00 02 18 40
									29 01 00 00 00 00 02 19 40
									29 01 00 00 00 00 02 1A 40
									29 01 00 00 00 00 02 1B 40
									29 01 00 00 00 00 02 1C 40
									29 01 00 00 00 00 02 1D 40
									29 01 00 00 00 00 02 1E 40
									29 01 00 00 00 00 02 1F E1
									29 01 00 00 00 00 02 20 E1
									29 01 00 00 00 00 02 21 5A
									29 01 00 00 00 00 02 22 92
									29 01 00 00 00 00 02 23 92
									29 01 00 00 00 00 02 24 00
									29 01 00 00 00 00 02 25 00
									29 01 00 00 00 00 02 26 00
									29 01 00 00 00 00 02 FF 23
									29 01 00 00 00 00 02 FB 01
									29 01 00 00 00 00 02 01 84
									29 01 00 00 00 00 02 05 22
									29 01 00 00 00 00 02 FF 20
									29 01 00 00 00 00 02 FB 01
									29 01 00 00 00 00 02 44 D2
									29 01 00 00 00 00 02 45 3C
									29 01 00 00 00 00 02 FF 10
									29 01 00 00 00 00 06 3B 03 0A 08 0A 0A
									29 01 00 00 00 00 02 35 00
									29 01 00 00 00 00 02 B0 01
									23 01 00 00 78 00 02 11 00
									23 01 00 00 14 00 02 29 00];
		qcom,mdss-dsi-off-command = [39 01 00 00 78 00 02 10 00
					39 01 00 00 20 00 02 28 00];
		qcom,mdss-dsi-on-command-state = "dsi_lp_mode";
		qcom,mdss-dsi-off-command-state = "dsi_lp_mode";
		qcom,mdss-dsi-h-sync-pulse = <1>;
		qcom,mdss-dsi-traffic-mode = "burst_mode";
		qcom,mdss-dsi-lane-map = "lane_map_0123";
		qcom,mdss-dsi-bllp-eof-power-mode;
		qcom,mdss-dsi-bllp-power-mode;
		qcom,mdss-dsi-lane-0-state;
		qcom,mdss-dsi-lane-1-state;
		qcom,mdss-dsi-lane-2-state;
		qcom,mdss-dsi-lane-3-state;
		qcom,mdss-dsi-te-pin-select = <1>;
		qcom,mdss-dsi-te-v-sync-rd-ptr-irq-line = <0x2c>;
		qcom,mdss-dsi-te-dcs-command = <1>;
		qcom,mdss-dsi-te-check-enable;
		qcom,mdss-dsi-te-using-te-pin;
		qcom,mdss-dsi-panel-timings = [E6 38 26 00 68 6E 2A 3C 2C 03 04 00];
		qcom,mdss-dsi-t-clk-post = <0x2C>;
		qcom,mdss-dsi-t-clk-pre = <0xF6>;
		qcom,mdss-dsi-bl-min-level = <30>;
		qcom,mdss-dsi-bl-max-level = <3450>;
		qcom,mdss-brightness-max-level = <3450>;
		qcom,mdss-dsi-dma-trigger = "trigger_sw";
		qcom,mdss-dsi-mdp-trigger = "none";
		qcom,mdss-dsi-bl-pmic-control-type = "bl_ctrl_wled";
		qcom,panel-dot-inversion-mode-cmds = [29 01 00 00 00 00 02 00 00
                          29 01 00 00 00 00 04 FF 19 06 01
                          29 01 00 00 00 00 02 00 80
                          29 01 00 00 00 00 03 FF 19 06
                          29 01 00 00 00 00 02 00 B3
                          29 01 00 00 00 00 02 C0 00
                          29 01 00 00 00 00 02 00 00
                          29 01 00 00 00 00 02 FB 01
                          29 01 00 00 00 00 02 00 00
                          29 01 00 00 00 00 04 FF FF FF FF];
		qcom,panel-column-inversion-mode-cmds = [29 01 00 00 00 00 02 00 00
                             29 01 00 00 00 00 04 FF 19 06 01
                             29 01 00 00 00 00 02 00 80
                             29 01 00 00 00 00 03 FF 19 06
                             29 01 00 00 00 00 02 00 B3
                             29 01 00 00 00 00 02 C0 88
                             29 01 00 00 00 00 02 00 00
                             29 01 00 00 00 00 02 FB 01
                             29 01 00 00 00 00 02 00 00
                             29 01 00 00 00 00 04 FF FF FF FF];
		qcom,dot-inversion-cmds-dsi-state = "dsi_lp_mode";
		qcom,column-inversion-cmds-dsi-state = "dsi_lp_mode";
		qcom,panel-esd-check-enabled;
		qcom,panel-esd-read-commands = [06 01 00 01 05 00 02 0A 9C];
		qcom,esd-read-cmds-state = "dsi_hs_mode";
		qcom,mdss-dsi-lp11-init;
		qcom,mdss-dsi-tp-pre-lcd-enable;
		qcom,mdss-pan-physical-width-dimension = <68>;
		qcom,mdss-pan-physical-height-dimension = <121>;
		huawei,delaytime-before-bl = <80>;
		huawei,long-read-flag = <1>;
		huawei,reg-read-expect-value = <0x9C>;
		huawei,reg-long-read-count = <3>;
		qcom,mdss-dsi-reset-sequence = <1 15>, <0 5>, <1 10>;

	};
};
