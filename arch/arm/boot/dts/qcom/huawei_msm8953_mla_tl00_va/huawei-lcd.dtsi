/*---------------------------------------------------------------------------
 * This file is autogenerated file using huawei LCD parser. Please do not edit it.
 * Update input XML file to add a new entry or update variable in this file
 * Parser location: device/qcom/common/display/tools/huawei_lcd_panel 
 *---------------------------------------------------------------------------*/


#include "hw-panel-boe-otm1906c-5p5-1080p-cmd.dtsi"
#include "hw-panel-boe-td4322-5p5-1080p-cmd.dtsi"
#include "hw-panel-boe-test1906c-5p5-1080p-cmd.dtsi"
#include "hw-panel-ctc_nt35596s_5p5_1080p_video.dtsi"
#include "hw-panel-ctc-otm1906c-5p5-1080p-cmd.dtsi"
#include "hw-panel-jdi-r63452-5p5-1080p-cmd.dtsi"
#include "hw-panel-tianma-focal8716-5p5-1080p-video.dtsi"
#include "hw-panel-tianma-fic8736-5p5-1080p-cmd.dtsi"
#include "hw-panel-tianma-otm1906c-5p5-1080p-cmd.dtsi"
