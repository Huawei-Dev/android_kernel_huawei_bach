#include "../lcdkit/ags_l09_va/devkit_lcd.dtsi"
#include "../lcdkit/default/devkit_lcd.dtsi"
#include "huawei-backlight.dtsi"
#include "huawei-tp.dtsi"
#include "huawei-camera.dtsi"
#include "huawei-sensors.dtsi"
#include "huawei-vibrate.dtsi"
#include "huawei-gpio-led.dtsi"
#include "huawei-wifi.dtsi"
#include "huawei-bt.dtsi"
#include "huawei-audio.dtsi"
#include "huawei-fac.dtsi"
#include "huawei-battery.dtsi"
#include "huawei-usb.dtsi"
#include "huawei-sdcard.dtsi"
#include "huawei-thermal.dtsi"
#include "huawei-gpu.dtsi"

