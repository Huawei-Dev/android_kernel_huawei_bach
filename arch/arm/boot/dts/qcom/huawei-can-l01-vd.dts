/*
 * Copyright (c) 2015, The Linux Foundation. All rights reserved.
 *
 * This program is free software; you can redistribute it and/or modify
 * it under the terms of the GNU General Public License version 2 and
 * only version 2 as published by the Free Software Foundation.
 *
 * This program is distributed in the hope that it will be useful,
 * but WITHOUT ANY WARRANTY; without even the implied warranty of
 * MERCHANTABILITY or FITNESS FOR A PARTICULAR PURPOSE.  See the
 * GNU General Public License for more details.
 */
 /dts-v1/;
#include "huawei_base.dtsi"
#include "huawei_msm8953_can_l01_vd/huawei.dtsi"

/ {
	model = "Huawei Technologies, Inc. CAN-L01";
	qcom,board-id= <8098 0>;
	huawei,modem_id = <0xFBB4018E 0x0>;
};
