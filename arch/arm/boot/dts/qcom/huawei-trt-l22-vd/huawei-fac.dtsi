/{
		huawei_fac_info {
		compatible = "huawei,hw_fac_info";
		fac,product_name = "TRT-L22";
		fac,hardware_ver = "HL1TRTM-L22";
		fac,software_ver = "TRT_L22_VD";
		fac,simcard_adapt = "support";
		status = "ok";
	};
};
