/{
		huawei_fac_info {
		compatible = "huawei,hw_fac_info";
		fac,product_name = "AGS-L03";
		fac,hardware_ver = "SH1AGSL03M";
		fac,software_ver = "AGS_L03_VA";
		fac,simcard_adapt = "support";
		status = "ok";
	};
};
