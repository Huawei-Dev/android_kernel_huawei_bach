qcom,qrd-4v4-2920mAh-gy-data {
	/* #2449149_Huawei_Cannes_2920mAh_averaged_MasterSlave_May5th2016*/
	qcom,max-voltage-uv = <4400000>;
	qcom,nom-batt-capacity-mah = <2920>;
	qcom,batt-id-kohm = <22>;
	qcom,battery-beta = <3435>;
	qcom,battery-type = "HB405979ECW_GY_GY";
	qcom,chg-rslow-comp-c1 = <2914632>;
	qcom,chg-rslow-comp-c2 = <3454646>;
	qcom,chg-rs-to-rslow = <1067939>;
	qcom,chg-rslow-comp-thr = <0x99>;
	qcom,checksum = <0x0875>;
	qcom,gui-version = "PMI8950GUI - 2.0.0.16";
	qcom,fg-profile-data = [
		 A6 83 ED 74
		 A0 7A B1 6F
		 39 83 34 73
		 44 7F EF 7B
		 2C 82 4E 99
		 A6 B7 18 C3
		 BA 0D F5 83
		 0A 7D 14 81
		 FE 76 51 83
		 BD 6B 50 71
		 6D 84 6B 82
		 C2 98 9B B7
		 0F C8 5E 0D
		 02 0C F8 59
		 14 70 71 FD
		 40 3C 43 44
		 CA 41 00 00
		 27 4C D4 30
		 CF 40 00 00
		 00 00 00 00
		 00 00 00 00
		 38 71 68 6B
		 0F 60 9B 89
		 56 7C 90 71
		 E3 6C D9 78
		 C3 74 49 68
		 E9 74 AB A1
		 24 D1 60 0C
		 64 A0 71 0C
		 28 00 FF 36
		 F0 11 30 03
		 00 00 00 0C
	];
};

