/{
		huawei_fac_info {
		compatible = "huawei,hw_fac_info";
		fac,product_name = "CPN-L0J";
		fac,hardware_ver = "SH1CHOPINL0JM";
		fac,software_ver = "CPN_L0J_VA";
		fac,simcard_adapt = "support";
		status = "ok";
	};
};
