/{
		huawei_fac_info {
		compatible = "huawei,hw_fac_info";
		fac,product_name = "CPN-AL00";
		fac,hardware_ver = "SH1CHOPINAL0M-V2";
		fac,software_ver = "CPN_AL00_VA";
		fac,simcard_adapt = "support";
		status = "ok";
	};
};
