## drivers/devkit/audiokit/Kconfig
```kconfig
#
# Audiokit configuration
#
config AUDIOKIT
bool "Audio Kit"
default n
help
 choose y to open Audio Kit
if AUDIOKIT
source "drivers/devkit/audiokit/deviceboxID/Kconfig"
endif
```

## drivers/devkit/tpkit/hostprocessing/Kconfig
```kconfig
#
# huawei hostprocessing ts driver configuration
#

menuconfig JDI_HOST_TS_KIT
	bool "JDI_HOST ts drivers"
	default n
	help
	  If you say yes here you get support for jdi hostprocessing ts touchscreen.
```

## drivers/devkit/tpkit/panel/Kconfig
```kconfig
#
# huawei touchscreen driver configuration
#

source "drivers/devkit/tpkit/panel/himax/Kconfig"
source "drivers/devkit/tpkit/panel/novatek_hybrid/Kconfig"
source "drivers/devkit/tpkit/panel/parade/Kconfig"
```

## drivers/devkit/tpkit/panel/novatek_hybrid/Kconfig
```kconfig
#
# huawei touchscreen driver configuration
#

menuconfig  NOVATEK_HYBRID_TS_KIT
	bool "TS_KIT novatek_hybrid drivers"
	default n
	help
	  If you say yes here you get support for huawei touchscreen.
```

## drivers/dts_eagle/Kconfig
```kconfig
config DTS_EAGLE
	tristate "DTS Eagle driver"
	depends on ARM
	default y if ARM
	help
	  DTS Eagle module.
```

## drivers/huawei/Kconfig
```kconfig
menu "huawei linux device driver support package"

source "drivers/huawei/store_exception/Kconfig"
source "drivers/huawei/memory/Kconfig"

endmenu
```

## drivers/huawei/boottime/Kconfig
```kconfig
config HUAWEI_BOOT_TIME
       default n
	   bool "huawei boot time"
       help
			set beta or commercial version to kernel.
```

## drivers/huawei/memory/Kconfig
```kconfig
menu HUAWEI_VIRT_TO_PHYS

config  HUAWEI_VIRT_TO_PHYS
        default y
	bool "huawei virt address to phys address"
	help
          huawei virt address to phys address

endmenu
```

## drivers/huawei/store_exception/Kconfig
```kconfig
menu HUAWEI_STORE_EXCEPTION

config  HUAWEI_STORE_EXCEPTION
        default y
	bool "huawei store exception"
	help
          huawei store exception control

endmenu
```

## drivers/huawei_cc/Kconfig
```kconfig
menu "huawei linux device driver for qcom"

config HUAWEI_CC_DRV
	bool "Use huawei cc code"
	default n
	help
		use huawei chipsetcommon driver code

source "drivers/huawei_cc/cpuinfo/Kconfig"

endmenu
```

## drivers/huawei_cc/cpuinfo/Kconfig
```kconfig
config HUAWEI_CPU_INFO
       default n
	   bool "huawei cpu info"
       help
			set beta or commercial version to kernel.
```

## drivers/huawei_platform/Kconfig
```kconfig
config HUAWEI_DRIVERS
	bool "huawei drivers"
	default y
	help
	  Say Y here if you want to build the huawei drivers.
	  If unsure, say N here.

config HUAWEI_SENSORS
	bool "huawei sensors"
	default y
	help
	  Say Y here if you want to build the huawei sensor drivers.If unsure, say N here.

source "drivers/huawei_platform/sensor/Kconfig"
source "drivers/huawei_platform/power/Kconfig"
source "drivers/huawei_platform/antenna_board_match/Kconfig"
source "drivers/huawei_platform/antenna_cable/Kconfig"
source "drivers/huawei_platform/log/Kconfig"
source "drivers/huawei_platform/antenna_board_gpio_match/Kconfig"
```

## drivers/huawei_platform/antenna_cable/Kconfig
```kconfig
config RFFE_ANTENNA
	bool "support antenna cable state check function"
	default n
	help
	  Say 'Y' here if you want to support the antenna cable state check.
```

## drivers/huawei_platform/chr/Kconfig
```kconfig
config CHR_NETLINK_MODULE
	tristate "kernel space communicate with user space use chr netlink socket."
    default n
    help
	  This module adds support for data speed slow detecting and web chr statistics
	  funtions based on TCPIP stack.
```

## drivers/huawei_platform/log/Kconfig
```kconfig
config LOG_JANK
	bool "log jank feature support"
	default n
	---help---
	  Say Y here to enable log jank feature support. This allows
	  user to send log to remote server by net.

config HWLOG_KERNEL
        bool "hwlog feature support"
        default n
        ---help---
          Say Y here to enable hwlog kernel feature support. This allows
          user to send log to remote server by net.
```

## drivers/huawei_platform/sensor/Kconfig
```kconfig
config HUAWEI_HALL_SENSORS
        bool "huawei hall sensors"
		default y
        help
          Say Y here if you want to build the huawei hall sensor drivers.
		  If unsure, say N here.

source "drivers/huawei_platform/sensor/hallsensor/Kconfig"
config HUAWEI_LP_SENSORS
        bool "huawei als and proximity sensors"
		default y
        help
          Say Y here if you want to build the huawei als and proximity sensor drivers.
		  If unsure, say N here.

source "drivers/huawei_platform/sensor/lpsensor/Kconfig"
config SENSOR_DEVELOP_TEST
        bool "Support for sensor develop selftest"
		default n
        help
          Say Y here if you want to build develop test sensor connected with ap side.
		  If unsure, say N here.
config HUAWEI_SENSOR_INFO
        tristate "Support for sensor self_adapt"
        depends on HUAWEI_KERNEL
        default n
        help
          Say Y to enable support self-adapt
```

## drivers/huawei_platform/sensor/hallsensor/Kconfig
```kconfig
config HUAWEI_HALL_SENSORS_AK8789
        tristate "Support for hall sensor AK8789"
        depends on HUAWEI_HALL_SENSORS
        default n
        help
          Say Y to enable support ak8789 hall sensor
```

## drivers/huawei_platform/sensor/lpsensor/Kconfig
```kconfig
config HUAWEI_P_SENSORS_PA224
    tristate "pa224 proximity sensors"
    depends on I2C
	default n
	help
	  Say Y here if you want to build a driver for pa224 proximity sensor chip.
	  To compile this driver as a module, choose M here: the module will be called pa224. If unsure, say N here.


config HUAWEI_L_SENSORS_ROHM_RGB_BH1745
	tristate "ROHM RGB_BH1745 als sensors"
	depends on I2C
	default n
	help
	  Say Y here if you want to build a driver for RGB_BH1745 ambient light sensor chip.
	  To compile this driver as a module, choose M here: the module will be called bh1745. If unsure, say N here.
config HUAWEI_L_SENSORS_APDS9251
	tristate "Avago APDS9251  als  sensors"
	depends on I2C
	default n
	help
	  Say Y here if you want to build a driver for Avago APDS9251 ambient light sensor chip.
	  To compile this driver as a module, choose M here: the module will be called apds9251. If unsure, say N here.
config HUAWEI_P_SENSORS_APDS9110
	tristate "Avago APDS9110  ps  sensors"
	depends on I2C
	default n
	help
	  Say Y here if you want to build a driver for Avago APDS9110 proximity sensor chip.
	  To compile this driver as a module, choose M here: the module will be called apds9110. If unsure, say N here.
```

## drivers/huawei_platform/touchscreen/Kconfig
```kconfig
config CYTTSP5_CS445A
	tristate "cypress cs445a touch screen driver"
	default n
	help
	  Say Y here if you have cypress touch device us cyttsp5 to connected to your system and want
	  it to be available to applications.
	  Say N here if you have no cypress touch device use cyttsp5 in your system.
	  If unsure, say Y.
	  To compile this driver as a module, choose M here: the
	  module will be called input.
source "drivers/huawei_platform/touchscreen/cyttsp5_cs445a/Kconfig"
config SYNAPTICS_DSX_S3320
	tristate "synaptics s3320 touch screen driver"
	default n
	help
	  Say Y here if you have synaptics s3320 device connected to your system and want
	  it to be available to applications.
	  Say N here if you have no synaptics s3320 device in your system.
	  If unsure, say Y.
	  To compile this driver as a module, choose M here: the
	  module will be called input.
source "drivers/huawei_platform/touchscreen/synaptics_dsx_s3320/Kconfig"

config FOCALTECH_8736
	tristate "focaltech 6x06 touch screen driver"
	default n
	help
	  Say Y here if you have focaltech 6x06 touch device connected to your system and want
	  it to be available to applications. 
	  Say N here if you have no focaltech 6x06 touch device in your system.
	  If unsure, say Y.
	  To compile this driver as a module, choose M here: the
	  module will be called input.
source "drivers/huawei_platform/touchscreen/focaltech_8736/Kconfig"
config ILITEK_2120
	tristate "ilitek 2120 touch screen driver"
	default n
	help
	  Say Y here if you have ilitek 2120 device connected to your system and want
	  it to be available to applications.
	  Say N here if you have no ilitek 2120 device in your system.
	  If unsure, say Y.
	  To compile this driver as a module, choose M here: the
	  module will be called input.
source "drivers/huawei_platform/touchscreen/ilitek_2120/Kconfig"
```

## drivers/huawei_platform/touchscreen/focaltech_8736/Kconfig
```kconfig
#/*Add Enable Focaltech for Ft6x06-Tp Driver*/
config TOUCHSCREEN_FTS
	tristate "Enable Focaltech for Ft6x06-Tp Driver"
	depends on FOCALTECH_8736
	default y
	help
	  enable the f6x06_tp of focaltech.
```
